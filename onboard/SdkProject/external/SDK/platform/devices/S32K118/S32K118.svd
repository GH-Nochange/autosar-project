# S32K118 register map
Vendor: NXP; Series: S32K; File version: 1.6
S32K118 NXP Microcontroller
CPU: CM0PLUS r0p0, little endian, MPU, FPU, 2 interrupt priority bits
Registers are 32-bit, read-write, reset 0x0 unless marked. A register's access mark holds for its fields unless they carry their own. Offsets are from the block's base; lines under a group give offsets from that group; [hi:lo] are bit positions; {n}, {i} and the like mark numbered series; 'fields as' and 'values as' point back to an identical list; <NAME> marks a mode.

## Memory map
0x14000800 CSE_PRAM size 0x80
0x40000000 AIPS size 0x70 — AIPS-Lite Bridge
0x40001000 MSCM size 0x40C
0x40008000 DMA size 0x1080 — Enhanced Direct Memory Access
0x4000D000 MPU size 0x820 — Memory protection unit
0x40018000 ERM size 0x104
0x40019000 EIM size 0x108 — Error Injection Module
0x40020000 FTFC size 0x30
0x40021000 DMAMUX size 0x4 — DMA channel multiplexor
0x40024000 CAN0 size 0xC0C — Flex Controller Area Network module
0x4002C000 LPSPI0 size 0x78 — The LPSPI Memory Map/Register Definition can be found here.
0x4002D000 LPSPI1 size 0x78 — The LPSPI Memory Map/Register Definition can be found here.
0x40032000 CRC size 0xC — Cyclic Redundancy Check
0x40036000 PDB0 size 0x198 — Programmable Delay Block
0x40037000 LPIT0 size 0x5C — Low Power Periodic Interrupt Timer (LPIT)
0x40038000 FTM0 size 0x224 — FlexTimer Module
0x40039000 FTM1 size 0x224 — FlexTimer Module
0x4003B000 ADC0 size 0xEC — Analog-to-Digital Converter
0x4003D000 RTC size 0x20 — Secure Real Time Clock
0x4003E000 CMU_FC_0 size 0x18 — CMU_FC
0x4003F000 CMU_FC_1 size 0x18 — CMU_FC
0x40040000 LPTMR0 size 0x10 — Low Power Timer
0x40048000 SIM blocks up to offset 0x70 — System Integration Module
0x40049000 PORTA size 0xCC — Pin Control and Interrupts
0x4004A000 PORTB size 0xCC — Pin Control and Interrupts
0x4004B000 PORTC size 0xCC — Pin Control and Interrupts
0x4004C000 PORTD size 0xCC — Pin Control and Interrupts
0x4004D000 PORTE size 0xCC — Pin Control and Interrupts
0x40052000 WDOG size 0x10 — Watchdog timer
0x4005A000 FLEXIO size 0x510 — The FLEXIO Memory Map/Register Definition can be found here.
0x40063000 TRGMUX size 0x68
0x40064000 SCG size 0x30C — System Clock Generator
0x40065000 PCC size 0x1D0
0x40066000 LPI2C0 size 0x174 — The LPI2C Memory Map/Register Definition can be found here.
0x4006A000 LPUART0 size 0x30 — Universal Asynchronous Receiver/Transmitter
0x4006B000 LPUART1 size 0x30 — Universal Asynchronous Receiver/Transmitter
0x40073000 CMP0 size 0xC — High-Speed Comparator (CMP), Voltage Reference (VREF) Digital-to-Analog Converter (DAC), and Analog Mux (ANMUX)
0x4007D000 PMC size 0x5
0x4007E000 SMC size 0x18 — System Mode Controller
0x4007F000 RCM size 0x20 — Reset Control Module
0x400FF000 PTA size 0x1C — General Purpose Input/Output
0x400FF040 PTB size 0x1C — General Purpose Input/Output
0x400FF080 PTC size 0x1C — General Purpose Input/Output
0x400FF0C0 PTD size 0x1C — General Purpose Input/Output
0x400FF100 PTE size 0x1C — General Purpose Input/Output
0xE000E000 S32_SCB blocks up to offset 0xD34 — System Control Registers
0xE000E010 S32_SysTick size 0x10 — System timer
0xE000E100 S32_NVIC size 0x320 — Nested Vectored Interrupt Controller
0xE0082000 LMEM size 0x24 — Local Memory Controller
0xF0001000 MTB_DWT size 0x1000 — MTB data watchpoint and trace
0xF0003000 MCM blocks up to offset 0x4A8 — Core Platform Miscellaneous Control Module

## Interrupts
0 DMA0 (DMA, S32_NVIC)
1 DMA1 (DMA, S32_NVIC)
2 DMA2 (DMA, S32_NVIC)
3 DMA3 (DMA, S32_NVIC)
4 DMA_Error (DMA, S32_NVIC)
5 ERM_fault (ERM, S32_NVIC)
6 RTC (RTC, S32_NVIC)
7 RTC_Seconds (RTC, S32_NVIC)
8 LPTMR0 (LPTMR0, S32_NVIC)
9 PORT (S32_NVIC)
10 CAN0_ORed_Err_Wakeup (CAN0, S32_NVIC)
11 CAN0_ORed_0_31_MB (CAN0, S32_NVIC)
12 FTM0_Ch0_7 (FTM0, S32_NVIC)
13 FTM0_Fault (FTM0, S32_NVIC)
14 FTM0_Ovf_Reload (FTM0, S32_NVIC)
15 FTM1_Ch0_7 (FTM1, S32_NVIC)
16 FTM1_Fault (FTM1, S32_NVIC)
17 FTM1_Ovf_Reload (FTM1, S32_NVIC)
18 FTFC (FTFC, S32_NVIC)
19 PDB0 (PDB0, S32_NVIC)
20 LPIT0 (LPIT0, S32_NVIC)
21 SCG_CMU_LVD_LVWSCG (SCG, PMC, S32_NVIC)
22 WDOG (WDOG, S32_NVIC)
23 RCM (RCM, S32_NVIC)
24 LPI2C0_Master_Slave (LPI2C0, S32_NVIC)
25 FLEXIO (FLEXIO, S32_NVIC)
26 LPSPI0 (LPSPI0, S32_NVIC)
27 LPSPI1 (LPSPI1, S32_NVIC)
28 ADC0 (ADC0, S32_NVIC)
29 CMP0 (CMP0, S32_NVIC)
30 LPUART1_RxTx (LPUART1, S32_NVIC)
31 LPUART0_RxTx (LPUART0, S32_NVIC)

## Licence text in the file
Redistribution and use in source and binary forms, with or without modification, are permitted provided that the following conditions are met: o Redistributions of source code must retain the above copyright notice, this list of conditions and the following disclaimer. o Redistributions in binary form must reproduce the above copyright notice, this list of conditions and the following disclaimer in the documentation and/or other materials provided with the distribution. o Neither the name of Freescale Semiconductor, Inc. nor the names of its contributors may be used to endorse or promote products derived from this software without specific prior written permission. THIS SOFTWARE IS PROVIDED BY THE COPYRIGHT HOLDERS AND CONTRIBUTORS "AS IS" AND. ANY EXPRESS OR IMPLIED WARRANTIES, INCLUDING, BUT NOT LIMITED TO, THE IMPLIED. WARRANTIES OF MERCHANTABILITY AND FITNESS FOR A PARTICULAR PURPOSE ARE. DISCLAIMED. IN NO EVENT SHALL THE COPYRIGHT HOLDER OR CONTRIBUTORS BE LIABLE FOR. ANY DIRECT, INDIRECT, INCIDENTAL, SPECIAL, EXEMPLARY, OR CONSEQUENTIAL DAMAGES (INCLUDING, BUT NOT LIMITED TO, PROCUREMENT OF SUBSTITUTE GOODS OR SERVICES; LOSS OF USE, DATA, OR PROFITS; OR BUSINESS INTERRUPTION) HOWEVER CAUSED AND ON. ANY THEORY OF LIABILITY, WHETHER IN CONTRACT, STRICT LIABILITY, OR TORT (INCLUDING NEGLIGENCE OR OTHERWISE) ARISING IN ANY WAY OUT OF THE USE OF THIS. SOFTWARE, EVEN IF ADVISED OF THE POSSIBILITY OF SUCH DAMAGE.
