AUTOSAR XML (schema 00050)
package /AUTOSAR_Lin_43_LPUART_FLEXIO/BswModuleDescriptions
  bsw module description Lin: module-id=82
    provided-entrys:
      Flexio_Lin_Ip_Deinit
      Lin_CheckWakeup
      Lin_GetStatus
      Lin_GetVersionInfo
      Lin_GoToSleep
      Lin_GoToSleepInternal
      Lin_Init
      Lin_SendFrame
      Lin_SetClockMode
      Lin_Wakeup
      Lin_WakeupInternal
      LPUART0_LIN_IP_ERR_IRQHandler
      LPUART0_LIN_IP_RxTx_IRQHandler
      LPUART10_LIN_IP_ERR_IRQHandler
      LPUART10_LIN_IP_RxTx_IRQHandler
      LPUART11_LIN_IP_ERR_IRQHandler
      LPUART11_LIN_IP_RxTx_IRQHandler
      LPUART12_LIN_IP_ERR_IRQHandler
      LPUART12_LIN_IP_RxTx_IRQHandler
      LPUART13_LIN_IP_ERR_IRQHandler
      LPUART13_LIN_IP_RxTx_IRQHandler
      LPUART14_LIN_IP_ERR_IRQHandler
      LPUART14_LIN_IP_RxTx_IRQHandler
      LPUART15_LIN_IP_ERR_IRQHandler
      LPUART15_LIN_IP_RxTx_IRQHandler
      LPUART1_LIN_IP_ERR_IRQHandler
      LPUART1_LIN_IP_RxTx_IRQHandler
      LPUART2_LIN_IP_ERR_IRQHandler
      LPUART2_LIN_IP_RxTx_IRQHandler
      LPUART3_LIN_IP_ERR_IRQHandler
      LPUART3_LIN_IP_RxTx_IRQHandler
      LPUART4_LIN_IP_ERR_IRQHandler
      LPUART4_LIN_IP_RxTx_IRQHandler
      LPUART5_LIN_IP_ERR_IRQHandler
      LPUART5_LIN_IP_RxTx_IRQHandler
      LPUART6_LIN_IP_ERR_IRQHandler
      LPUART6_LIN_IP_RxTx_IRQHandler
      LPUART7_LIN_IP_ERR_IRQHandler
      LPUART7_LIN_IP_RxTx_IRQHandler
      LPUART8_LIN_IP_ERR_IRQHandler
      LPUART8_LIN_IP_RxTx_IRQHandler
      LPUART9_LIN_IP_ERR_IRQHandler
      LPUART9_LIN_IP_RxTx_IRQHandler
      LPUARTMSC_LIN_IP_ERR_IRQHandler
      LPUARTMSC_LIN_IP_RxTx_IRQHandler
    bsw internal behavior InternalBehavior_0
      18 x exclusive area:
        LIN_EXCLUSIVE_AREA_{08..11}
        LIN_EXCLUSIVE_AREA_13
        LIN_EXCLUSIVE_AREA_{15..27}
      11 x bsw called entity:
        Flexio_Lin_Ip_Deinit: can-enter-exclusive-area=LIN_EXCLUSIVE_AREA_19, implemented-entry=Flexio_Lin_Ip_Deinit
        Lin_43_LPUART_FLEXIO_CheckWakeup: implemented-entry=Lin_CheckWakeup
        Lin_43_LPUART_FLEXIO_GetStatus: implemented-entry=Lin_GetStatus
        Lin_43_LPUART_FLEXIO_GetVersionInfo: implemented-entry=Lin_GetVersionInfo
        Lin_43_LPUART_FLEXIO_GoToSleep: can-enter-exclusive-area=[LIN_EXCLUSIVE_AREA_09, LIN_EXCLUSIVE_AREA_10, LIN_EXCLUSIVE_AREA_11, LIN_EXCLUSIVE_AREA_15], implemented-entry=Lin_GoToSleep
        Lin_43_LPUART_FLEXIO_GoToSleepInternal: can-enter-exclusive-area=[LIN_EXCLUSIVE_AREA_09, LIN_EXCLUSIVE_AREA_09, LIN_EXCLUSIVE_AREA_10, LIN_EXCLUSIVE_AREA_11, LIN_EXCLUSIVE_AREA_15, LIN_EXCLUSIVE_AREA_17, LIN_EXCLUSIVE_AREA_18, LIN_EXCLUSIVE_AREA_24, LIN_EXCLUSIVE_AREA_25], implemented-entry=Lin_GoToSleepInternal
        Lin_43_LPUART_FLEXIO_Init: can-enter-exclusive-area=[LIN_EXCLUSIVE_AREA_08, LIN_EXCLUSIVE_AREA_09, LIN_EXCLUSIVE_AREA_09, LIN_EXCLUSIVE_AREA_10, LIN_EXCLUSIVE_AREA_13, LIN_EXCLUSIVE_AREA_17, LIN_EXCLUSIVE_AREA_18, LIN_EXCLUSIVE_AREA_20, LIN_EXCLUSIVE_AREA_21, LIN_EXCLUSIVE_AREA_23, LIN_EXCLUSIVE_AREA_24, LIN_EXCLUSIVE_AREA_25, LIN_EXCLUSIVE_AREA_25, LIN_EXCLUSIVE_AREA_26, LIN_EXCLUSIVE_AREA_27], implemented-entry=Lin_Init
        Lin_43_LPUART_FLEXIO_SendFrame: can-enter-exclusive-area=[LIN_EXCLUSIVE_AREA_09, LIN_EXCLUSIVE_AREA_09, LIN_EXCLUSIVE_AREA_09, LIN_EXCLUSIVE_AREA_10, LIN_EXCLUSIVE_AREA_11, LIN_EXCLUSIVE_AREA_15, LIN_EXCLUSIVE_AREA_16, LIN_EXCLUSIVE_AREA_24, LIN_EXCLUSIVE_AREA_25, LIN_EXCLUSIVE_AREA_25], implemented-entry=Lin_SendFrame
        Lin_43_LPUART_FLEXIO_SetClockMode: can-enter-exclusive-area=LIN_EXCLUSIVE_AREA_22, implemented-entry=Lin_SetClockMode
        Lin_43_LPUART_FLEXIO_Wakeup: implemented-entry=Lin_Wakeup
        Lin_43_LPUART_FLEXIO_WakeupInternal: implemented-entry=Lin_WakeupInternal
      34 x bsw interrupt entity, all with interrupt-category=CAT-2, interrupt-source=Hardware:
        LPUART0_LIN_IP_ERR_IRQHandler: implemented-entry=LPUART0_LIN_IP_ERR_IRQHandler
        LPUART0_LIN_IP_RxTx_IRQHandler: implemented-entry=LPUART0_LIN_IP_RxTx_IRQHandler
        LPUART10_LIN_IP_ERR_IRQHandler: implemented-entry=LPUART10_LIN_IP_ERR_IRQHandler
        LPUART10_LIN_IP_RxTx_IRQHandler: implemented-entry=LPUART10_LIN_IP_RxTx_IRQHandler
        LPUART11_LIN_IP_ERR_IRQHandler: implemented-entry=LPUART11_LIN_IP_ERR_IRQHandler
        LPUART11_LIN_IP_RxTx_IRQHandler: implemented-entry=LPUART11_LIN_IP_RxTx_IRQHandler
        LPUART12_LIN_IP_ERR_IRQHandler: implemented-entry=LPUART12_LIN_IP_ERR_IRQHandler
        LPUART12_LIN_IP_RxTx_IRQHandler: implemented-entry=LPUART12_LIN_IP_RxTx_IRQHandler
        LPUART13_LIN_IP_ERR_IRQHandler: implemented-entry=LPUART13_LIN_IP_ERR_IRQHandler
        LPUART13_LIN_IP_RxTx_IRQHandler: implemented-entry=LPUART13_LIN_IP_RxTx_IRQHandler
        LPUART14_LIN_IP_ERR_IRQHandler: implemented-entry=LPUART14_LIN_IP_ERR_IRQHandler
        LPUART14_LIN_IP_RxTx_IRQHandler: implemented-entry=LPUART14_LIN_IP_RxTx_IRQHandler
        LPUART15_LIN_IP_ERR_IRQHandler: implemented-entry=LPUART15_LIN_IP_ERR_IRQHandler
        LPUART15_LIN_IP_RxTx_IRQHandler: implemented-entry=LPUART15_LIN_IP_RxTx_IRQHandler
        LPUART1_LIN_IP_ERR_IRQHandler: implemented-entry=LPUART1_LIN_IP_ERR_IRQHandler
        LPUART1_LIN_IP_RxTx_IRQHandler: implemented-entry=LPUART1_LIN_IP_RxTx_IRQHandler
        LPUART2_LIN_IP_ERR_IRQHandler: implemented-entry=LPUART2_LIN_IP_ERR_IRQHandler
        LPUART2_LIN_IP_RxTx_IRQHandler: implemented-entry=LPUART2_LIN_IP_RxTx_IRQHandler
        LPUART3_LIN_IP_ERR_IRQHandler: implemented-entry=LPUART3_LIN_IP_ERR_IRQHandler
        LPUART3_LIN_IP_RxTx_IRQHandler: implemented-entry=LPUART3_LIN_IP_RxTx_IRQHandler
        LPUART4_LIN_IP_ERR_IRQHandler: implemented-entry=LPUART4_LIN_IP_ERR_IRQHandler
        LPUART4_LIN_IP_RxTx_IRQHandler: implemented-entry=LPUART4_LIN_IP_RxTx_IRQHandler
        LPUART5_LIN_IP_ERR_IRQHandler: implemented-entry=LPUART5_LIN_IP_ERR_IRQHandler
        LPUART5_LIN_IP_RxTx_IRQHandler: implemented-entry=LPUART5_LIN_IP_RxTx_IRQHandler
        LPUART6_LIN_IP_ERR_IRQHandler: implemented-entry=LPUART6_LIN_IP_ERR_IRQHandler
        LPUART6_LIN_IP_RxTx_IRQHandler: implemented-entry=LPUART6_LIN_IP_RxTx_IRQHandler
        LPUART7_LIN_IP_ERR_IRQHandler: implemented-entry=LPUART7_LIN_IP_ERR_IRQHandler
        LPUART7_LIN_IP_RxTx_IRQHandler: implemented-entry=LPUART7_LIN_IP_RxTx_IRQHandler
        LPUART8_LIN_IP_ERR_IRQHandler: implemented-entry=LPUART8_LIN_IP_ERR_IRQHandler
        LPUART8_LIN_IP_RxTx_IRQHandler: implemented-entry=LPUART8_LIN_IP_RxTx_IRQHandler
        LPUART9_LIN_IP_ERR_IRQHandler: implemented-entry=LPUART9_LIN_IP_ERR_IRQHandler
        LPUART9_LIN_IP_RxTx_IRQHandler: implemented-entry=LPUART9_LIN_IP_RxTx_IRQHandler
        LPUARTMSC_LIN_IP_ERR_IRQHandler: implemented-entry=LPUARTMSC_LIN_IP_ERR_IRQHandler
        LPUARTMSC_LIN_IP_RxTx_IRQHandler: implemented-entry=LPUARTMSC_LIN_IP_RxTx_IRQHandler
package /AUTOSAR_Lin_43_LPUART_FLEXIO/BswModuleEntrys
  45 x bsw module entry, all with sw-service-impl-policy=STANDARD:
    Flexio_Lin_Ip_Deinit: service-id=0x100, is-reentrant=false, is-synchronous=true, call-type=REGULAR, execution-context=UNSPECIFIED
    Lin_CheckWakeup: service-id=0x0a, is-reentrant=false, is-synchronous=true, call-type=REGULAR, execution-context=UNSPECIFIED
    Lin_GetStatus: service-id=0x08, is-reentrant=false, is-synchronous=true, call-type=REGULAR, execution-context=UNSPECIFIED
    Lin_GetVersionInfo: service-id=0x01, is-reentrant=true, is-synchronous=true, call-type=REGULAR, execution-context=UNSPECIFIED
    Lin_GoToSleep: service-id=0x06, is-reentrant=false, is-synchronous=false, call-type=REGULAR, execution-context=UNSPECIFIED
    Lin_GoToSleepInternal: service-id=0x09, is-reentrant=false, is-synchronous=true, call-type=REGULAR, execution-context=UNSPECIFIED
    Lin_Init: service-id=0x00, is-reentrant=false, is-synchronous=true, call-type=REGULAR, execution-context=UNSPECIFIED
    Lin_SendFrame: service-id=0x04, is-reentrant=false, is-synchronous=false, call-type=REGULAR, execution-context=UNSPECIFIED
    Lin_SetClockMode: service-id=0x0c, is-reentrant=false, is-synchronous=true, call-type=REGULAR, execution-context=UNSPECIFIED
    Lin_Wakeup: service-id=0x07, is-reentrant=false, is-synchronous=false, call-type=REGULAR, execution-context=UNSPECIFIED
    Lin_WakeupInternal: service-id=0x0b, is-reentrant=false, is-synchronous=false, call-type=REGULAR, execution-context=UNSPECIFIED
    LPUART0_LIN_IP_ERR_IRQHandler: service-id=0, is-reentrant=false, is-synchronous=true, call-type=INTERRUPT, execution-context=INTERRUPT-CAT-2
    LPUART0_LIN_IP_RxTx_IRQHandler: service-id=0, is-reentrant=false, is-synchronous=true, call-type=INTERRUPT, execution-context=INTERRUPT-CAT-2
    LPUART10_LIN_IP_ERR_IRQHandler: service-id=0, is-reentrant=false, is-synchronous=true, call-type=INTERRUPT, execution-context=INTERRUPT-CAT-2
    LPUART10_LIN_IP_RxTx_IRQHandler: service-id=0, is-reentrant=false, is-synchronous=true, call-type=INTERRUPT, execution-context=INTERRUPT-CAT-2
    LPUART11_LIN_IP_ERR_IRQHandler: service-id=0, is-reentrant=false, is-synchronous=true, call-type=INTERRUPT, execution-context=INTERRUPT-CAT-2
    LPUART11_LIN_IP_RxTx_IRQHandler: service-id=0, is-reentrant=false, is-synchronous=true, call-type=INTERRUPT, execution-context=INTERRUPT-CAT-2
    LPUART12_LIN_IP_ERR_IRQHandler: service-id=0, is-reentrant=false, is-synchronous=true, call-type=INTERRUPT, execution-context=INTERRUPT-CAT-2
    LPUART12_LIN_IP_RxTx_IRQHandler: service-id=0, is-reentrant=false, is-synchronous=true, call-type=INTERRUPT, execution-context=INTERRUPT-CAT-2
    LPUART13_LIN_IP_ERR_IRQHandler: service-id=0, is-reentrant=false, is-synchronous=true, call-type=INTERRUPT, execution-context=INTERRUPT-CAT-2
    LPUART13_LIN_IP_RxTx_IRQHandler: service-id=0, is-reentrant=false, is-synchronous=true, call-type=INTERRUPT, execution-context=INTERRUPT-CAT-2
    LPUART14_LIN_IP_ERR_IRQHandler: service-id=0, is-reentrant=false, is-synchronous=true, call-type=INTERRUPT, execution-context=INTERRUPT-CAT-2
    LPUART14_LIN_IP_RxTx_IRQHandler: service-id=0, is-reentrant=false, is-synchronous=true, call-type=INTERRUPT, execution-context=INTERRUPT-CAT-2
    LPUART15_LIN_IP_ERR_IRQHandler: service-id=0, is-reentrant=false, is-synchronous=true, call-type=INTERRUPT, execution-context=INTERRUPT-CAT-2
    LPUART15_LIN_IP_RxTx_IRQHandler: service-id=0, is-reentrant=false, is-synchronous=true, call-type=INTERRUPT, execution-context=INTERRUPT-CAT-2
    LPUART1_LIN_IP_ERR_IRQHandler: service-id=0, is-reentrant=false, is-synchronous=true, call-type=INTERRUPT, execution-context=INTERRUPT-CAT-2
    LPUART1_LIN_IP_RxTx_IRQHandler: service-id=0, is-reentrant=false, is-synchronous=true, call-type=INTERRUPT, execution-context=INTERRUPT-CAT-2
    LPUART2_LIN_IP_ERR_IRQHandler: service-id=0, is-reentrant=false, is-synchronous=true, call-type=INTERRUPT, execution-context=INTERRUPT-CAT-2
    LPUART2_LIN_IP_RxTx_IRQHandler: service-id=0, is-reentrant=false, is-synchronous=true, call-type=INTERRUPT, execution-context=INTERRUPT-CAT-2
    LPUART3_LIN_IP_ERR_IRQHandler: service-id=0, is-reentrant=false, is-synchronous=true, call-type=INTERRUPT, execution-context=INTERRUPT-CAT-2
    LPUART3_LIN_IP_RxTx_IRQHandler: service-id=0, is-reentrant=false, is-synchronous=true, call-type=INTERRUPT, execution-context=INTERRUPT-CAT-2
    LPUART4_LIN_IP_ERR_IRQHandler: service-id=0, is-reentrant=false, is-synchronous=true, call-type=INTERRUPT, execution-context=INTERRUPT-CAT-2
    LPUART4_LIN_IP_RxTx_IRQHandler: service-id=0, is-reentrant=false, is-synchronous=true, call-type=INTERRUPT, execution-context=INTERRUPT-CAT-2
    LPUART5_LIN_IP_ERR_IRQHandler: service-id=0, is-reentrant=false, is-synchronous=true, call-type=INTERRUPT, execution-context=INTERRUPT-CAT-2
    LPUART5_LIN_IP_RxTx_IRQHandler: service-id=0, is-reentrant=false, is-synchronous=true, call-type=INTERRUPT, execution-context=INTERRUPT-CAT-2
    LPUART6_LIN_IP_ERR_IRQHandler: service-id=0, is-reentrant=false, is-synchronous=true, call-type=INTERRUPT, execution-context=INTERRUPT-CAT-2
    LPUART6_LIN_IP_RxTx_IRQHandler: service-id=0, is-reentrant=false, is-synchronous=true, call-type=INTERRUPT, execution-context=INTERRUPT-CAT-2
    LPUART7_LIN_IP_ERR_IRQHandler: service-id=0, is-reentrant=false, is-synchronous=true, call-type=INTERRUPT, execution-context=INTERRUPT-CAT-2
    LPUART7_LIN_IP_RxTx_IRQHandler: service-id=0, is-reentrant=false, is-synchronous=true, call-type=INTERRUPT, execution-context=INTERRUPT-CAT-2
    LPUART8_LIN_IP_ERR_IRQHandler: service-id=0, is-reentrant=false, is-synchronous=true, call-type=INTERRUPT, execution-context=INTERRUPT-CAT-2
    LPUART8_LIN_IP_RxTx_IRQHandler: service-id=0, is-reentrant=false, is-synchronous=true, call-type=INTERRUPT, execution-context=INTERRUPT-CAT-2
    LPUART9_LIN_IP_ERR_IRQHandler: service-id=0, is-reentrant=false, is-synchronous=true, call-type=INTERRUPT, execution-context=INTERRUPT-CAT-2
    LPUART9_LIN_IP_RxTx_IRQHandler: service-id=0, is-reentrant=false, is-synchronous=true, call-type=INTERRUPT, execution-context=INTERRUPT-CAT-2
    LPUARTMSC_LIN_IP_ERR_IRQHandler: service-id=0, is-reentrant=false, is-synchronous=true, call-type=INTERRUPT, execution-context=INTERRUPT-CAT-2
    LPUARTMSC_LIN_IP_RxTx_IRQHandler: service-id=0, is-reentrant=false, is-synchronous=true, call-type=INTERRUPT, execution-context=INTERRUPT-CAT-2
package /Lin_43_LPUART_FLEXIO_TS_T40D2M30I0R0/Implementations
  bsw implementation BswImplementation_0: programming-language=C, sw-version=3.0.0_QLP02, vendor-id=43, ar-release-version=4.7.0, behavior=InternalBehavior_0, vendor-api-infix=LPUART_FLEXIO, vendor-specific-module-def=Lin
    code-descriptors:
      code Files
        artifact-descriptors:
          short-label=config::Lin.xdm, category=SWCFG
          short-label=config::Lin_43_LPUART_FLEXIO.xdm, category=SWCFG
          short-label=doc::RTD_LIN_43_LPUART_FLEXIO_IM.pdf, category=SWDOC
          short-label=doc::RTD_LIN_43_LPUART_FLEXIO_UM.pdf, category=SWDOC
          short-label=examples::EBT::S32K1::Lin_Flexio_MasterFrameTransfer_S32K118::generate::epc::BaseNXP.xdm, category=SWCFG
          short-label=examples::EBT::S32K1::Lin_Flexio_MasterFrameTransfer_S32K118::generate::epc::Dem.xdm, category=SWCFG
          short-label=examples::EBT::S32K1::Lin_Flexio_MasterFrameTransfer_S32K118::generate::epc::EcuC.xdm, category=SWCFG
          short-label=examples::EBT::S32K1::Lin_Flexio_MasterFrameTransfer_S32K118::generate::epc::EcuM.xdm, category=SWCFG
          short-label=examples::EBT::S32K1::Lin_Flexio_MasterFrameTransfer_S32K118::generate::epc::Lin_43_LPUART_FLEXIO.xdm, category=SWCFG
          short-label=examples::EBT::S32K1::Lin_Flexio_MasterFrameTransfer_S32K118::generate::epc::Mcl.xdm, category=SWCFG
          short-label=examples::EBT::S32K1::Lin_Flexio_MasterFrameTransfer_S32K118::generate::epc::Mcu.xdm, category=SWCFG
          short-label=examples::EBT::S32K1::Lin_Flexio_MasterFrameTransfer_S32K118::generate::epc::Platform.xdm, category=SWCFG
          short-label=examples::EBT::S32K1::Lin_Flexio_MasterFrameTransfer_S32K118::generate::epc::Port.xdm, category=SWCFG
          short-label=examples::EBT::S32K1::Lin_Flexio_MasterFrameTransfer_S32K118::generate::epc::Resource.xdm, category=SWCFG
          short-label=examples::EBT::S32K1::Lin_Flexio_MasterFrameTransfer_S32K118::include::check_example.h, category=SWHDR
          short-label=examples::EBT::S32K1::Lin_Flexio_MasterFrameTransfer_S32K118::src::main.c, category=SWSRC
          short-label=examples::EBT::S32K1::Lin_Flexio_MasterFrameTransfer_S32K118::TresosProject::Lin_Flexio_MasterFrameTransfer_S32K118::.prefs::preferences.xdm, category=SWCFG
          short-label=examples::EBT::S32K1::Lin_Flexio_MasterFrameTransfer_S32K118::TresosProject::Lin_Flexio_MasterFrameTransfer_S32K118::config::BaseNXP.xdm, category=SWCFG
          short-label=examples::EBT::S32K1::Lin_Flexio_MasterFrameTransfer_S32K118::TresosProject::Lin_Flexio_MasterFrameTransfer_S32K118::config::Dem.xdm, category=SWCFG
          short-label=examples::EBT::S32K1::Lin_Flexio_MasterFrameTransfer_S32K118::TresosProject::Lin_Flexio_MasterFrameTransfer_S32K118::config::EcuC.xdm, category=SWCFG
          short-label=examples::EBT::S32K1::Lin_Flexio_MasterFrameTransfer_S32K118::TresosProject::Lin_Flexio_MasterFrameTransfer_S32K118::config::EcuM.xdm, category=SWCFG
          short-label=examples::EBT::S32K1::Lin_Flexio_MasterFrameTransfer_S32K118::TresosProject::Lin_Flexio_MasterFrameTransfer_S32K118::config::Lin_43_LPUART_FLEXIO.xdm, category=SWCFG
          short-label=examples::EBT::S32K1::Lin_Flexio_MasterFrameTransfer_S32K118::TresosProject::Lin_Flexio_MasterFrameTransfer_S32K118::config::Mcl.xdm, category=SWCFG
          short-label=examples::EBT::S32K1::Lin_Flexio_MasterFrameTransfer_S32K118::TresosProject::Lin_Flexio_MasterFrameTransfer_S32K118::config::Mcu.xdm, category=SWCFG
          short-label=examples::EBT::S32K1::Lin_Flexio_MasterFrameTransfer_S32K118::TresosProject::Lin_Flexio_MasterFrameTransfer_S32K118::config::Platform.xdm, category=SWCFG
          short-label=examples::EBT::S32K1::Lin_Flexio_MasterFrameTransfer_S32K118::TresosProject::Lin_Flexio_MasterFrameTransfer_S32K118::config::Port.xdm, category=SWCFG
          short-label=examples::EBT::S32K1::Lin_Flexio_MasterFrameTransfer_S32K118::TresosProject::Lin_Flexio_MasterFrameTransfer_S32K118::config::Resource.xdm, category=SWCFG
          short-label=examples::EBT::S32K1::Lin_Flexio_MasterFrameTransfer_S32K144::generate::epc::BaseNXP.xdm, category=SWCFG
          short-label=examples::EBT::S32K1::Lin_Flexio_MasterFrameTransfer_S32K144::generate::epc::Dem.xdm, category=SWCFG
          short-label=examples::EBT::S32K1::Lin_Flexio_MasterFrameTransfer_S32K144::generate::epc::EcuC.xdm, category=SWCFG
          short-label=examples::EBT::S32K1::Lin_Flexio_MasterFrameTransfer_S32K144::generate::epc::EcuM.xdm, category=SWCFG
          short-label=examples::EBT::S32K1::Lin_Flexio_MasterFrameTransfer_S32K144::generate::epc::Lin_43_LPUART_FLEXIO.xdm, category=SWCFG
          short-label=examples::EBT::S32K1::Lin_Flexio_MasterFrameTransfer_S32K144::generate::epc::Mcl.xdm, category=SWCFG
          short-label=examples::EBT::S32K1::Lin_Flexio_MasterFrameTransfer_S32K144::generate::epc::Mcu.xdm, category=SWCFG
          short-label=examples::EBT::S32K1::Lin_Flexio_MasterFrameTransfer_S32K144::generate::epc::Platform.xdm, category=SWCFG
          short-label=examples::EBT::S32K1::Lin_Flexio_MasterFrameTransfer_S32K144::generate::epc::Port.xdm, category=SWCFG
          short-label=examples::EBT::S32K1::Lin_Flexio_MasterFrameTransfer_S32K144::generate::epc::Resource.xdm, category=SWCFG
          short-label=examples::EBT::S32K1::Lin_Flexio_MasterFrameTransfer_S32K144::include::check_example.h, category=SWHDR
          short-label=examples::EBT::S32K1::Lin_Flexio_MasterFrameTransfer_S32K144::src::main.c, category=SWSRC
          short-label=examples::EBT::S32K1::Lin_Flexio_MasterFrameTransfer_S32K144::TresosProject::Lin_Flexio_MasterFrameTransfer_S32K144::.prefs::preferences.xdm, category=SWCFG
          short-label=examples::EBT::S32K1::Lin_Flexio_MasterFrameTransfer_S32K144::TresosProject::Lin_Flexio_MasterFrameTransfer_S32K144::config::BaseNXP.xdm, category=SWCFG
          short-label=examples::EBT::S32K1::Lin_Flexio_MasterFrameTransfer_S32K144::TresosProject::Lin_Flexio_MasterFrameTransfer_S32K144::config::Dem.xdm, category=SWCFG
          short-label=examples::EBT::S32K1::Lin_Flexio_MasterFrameTransfer_S32K144::TresosProject::Lin_Flexio_MasterFrameTransfer_S32K144::config::EcuC.xdm, category=SWCFG
          short-label=examples::EBT::S32K1::Lin_Flexio_MasterFrameTransfer_S32K144::TresosProject::Lin_Flexio_MasterFrameTransfer_S32K144::config::EcuM.xdm, category=SWCFG
          short-label=examples::EBT::S32K1::Lin_Flexio_MasterFrameTransfer_S32K144::TresosProject::Lin_Flexio_MasterFrameTransfer_S32K144::config::Lin_43_LPUART_FLEXIO.xdm, category=SWCFG
          short-label=examples::EBT::S32K1::Lin_Flexio_MasterFrameTransfer_S32K144::TresosProject::Lin_Flexio_MasterFrameTransfer_S32K144::config::Mcl.xdm, category=SWCFG
          short-label=examples::EBT::S32K1::Lin_Flexio_MasterFrameTransfer_S32K144::TresosProject::Lin_Flexio_MasterFrameTransfer_S32K144::config::Mcu.xdm, category=SWCFG
          short-label=examples::EBT::S32K1::Lin_Flexio_MasterFrameTransfer_S32K144::TresosProject::Lin_Flexio_MasterFrameTransfer_S32K144::config::Platform.xdm, category=SWCFG
          short-label=examples::EBT::S32K1::Lin_Flexio_MasterFrameTransfer_S32K144::TresosProject::Lin_Flexio_MasterFrameTransfer_S32K144::config::Port.xdm, category=SWCFG
          short-label=examples::EBT::S32K1::Lin_Flexio_MasterFrameTransfer_S32K144::TresosProject::Lin_Flexio_MasterFrameTransfer_S32K144::config::Resource.xdm, category=SWCFG
          short-label=examples::EBT::S32K1::Lin_Flexio_MasterFrameTransfer_S32K144W::generate::epc::BaseNXP.xdm, category=SWCFG
          short-label=examples::EBT::S32K1::Lin_Flexio_MasterFrameTransfer_S32K144W::generate::epc::Dem.xdm, category=SWCFG
          short-label=examples::EBT::S32K1::Lin_Flexio_MasterFrameTransfer_S32K144W::generate::epc::EcuC.xdm, category=SWCFG
          short-label=examples::EBT::S32K1::Lin_Flexio_MasterFrameTransfer_S32K144W::generate::epc::EcuM.xdm, category=SWCFG
          short-label=examples::EBT::S32K1::Lin_Flexio_MasterFrameTransfer_S32K144W::generate::epc::Lin_43_LPUART_FLEXIO.xdm, category=SWCFG
          short-label=examples::EBT::S32K1::Lin_Flexio_MasterFrameTransfer_S32K144W::generate::epc::Mcl.xdm, category=SWCFG
          short-label=examples::EBT::S32K1::Lin_Flexio_MasterFrameTransfer_S32K144W::generate::epc::Mcu.xdm, category=SWCFG
          short-label=examples::EBT::S32K1::Lin_Flexio_MasterFrameTransfer_S32K144W::generate::epc::Platform.xdm, category=SWCFG
          short-label=examples::EBT::S32K1::Lin_Flexio_MasterFrameTransfer_S32K144W::generate::epc::Port.xdm, category=SWCFG
          short-label=examples::EBT::S32K1::Lin_Flexio_MasterFrameTransfer_S32K144W::generate::epc::Resource.xdm, category=SWCFG
          short-label=examples::EBT::S32K1::Lin_Flexio_MasterFrameTransfer_S32K144W::include::check_example.h, category=SWHDR
          short-label=examples::EBT::S32K1::Lin_Flexio_MasterFrameTransfer_S32K144W::src::main.c, category=SWSRC
          short-label=examples::EBT::S32K1::Lin_Flexio_MasterFrameTransfer_S32K144W::TresosProject::Lin_Flexio_MasterFrameTransfer_S32K144W::.prefs::preferences.xdm, category=SWCFG
          short-label=examples::EBT::S32K1::Lin_Flexio_MasterFrameTransfer_S32K144W::TresosProject::Lin_Flexio_MasterFrameTransfer_S32K144W::config::BaseNXP.xdm, category=SWCFG
          short-label=examples::EBT::S32K1::Lin_Flexio_MasterFrameTransfer_S32K144W::TresosProject::Lin_Flexio_MasterFrameTransfer_S32K144W::config::Dem.xdm, category=SWCFG
          short-label=examples::EBT::S32K1::Lin_Flexio_MasterFrameTransfer_S32K144W::TresosProject::Lin_Flexio_MasterFrameTransfer_S32K144W::config::EcuC.xdm, category=SWCFG
          short-label=examples::EBT::S32K1::Lin_Flexio_MasterFrameTransfer_S32K144W::TresosProject::Lin_Flexio_MasterFrameTransfer_S32K144W::config::EcuM.xdm, category=SWCFG
          short-label=examples::EBT::S32K1::Lin_Flexio_MasterFrameTransfer_S32K144W::TresosProject::Lin_Flexio_MasterFrameTransfer_S32K144W::config::Lin_43_LPUART_FLEXIO.xdm, category=SWCFG
          short-label=examples::EBT::S32K1::Lin_Flexio_MasterFrameTransfer_S32K144W::TresosProject::Lin_Flexio_MasterFrameTransfer_S32K144W::config::Mcl.xdm, category=SWCFG
          short-label=examples::EBT::S32K1::Lin_Flexio_MasterFrameTransfer_S32K144W::TresosProject::Lin_Flexio_MasterFrameTransfer_S32K144W::config::Mcu.xdm, category=SWCFG
          short-label=examples::EBT::S32K1::Lin_Flexio_MasterFrameTransfer_S32K144W::TresosProject::Lin_Flexio_MasterFrameTransfer_S32K144W::config::Platform.xdm, category=SWCFG
          short-label=examples::EBT::S32K1::Lin_Flexio_MasterFrameTransfer_S32K144W::TresosProject::Lin_Flexio_MasterFrameTransfer_S32K144W::config::Port.xdm, category=SWCFG
          short-label=examples::EBT::S32K1::Lin_Flexio_MasterFrameTransfer_S32K144W::TresosProject::Lin_Flexio_MasterFrameTransfer_S32K144W::config::Resource.xdm, category=SWCFG
          short-label=examples::EBT::S32K1::Lin_Flexio_MasterFrameTransfer_S32K148::generate::epc::BaseNXP.xdm, category=SWCFG
          short-label=examples::EBT::S32K1::Lin_Flexio_MasterFrameTransfer_S32K148::generate::epc::Dem.xdm, category=SWCFG
          short-label=examples::EBT::S32K1::Lin_Flexio_MasterFrameTransfer_S32K148::generate::epc::EcuC.xdm, category=SWCFG
          short-label=examples::EBT::S32K1::Lin_Flexio_MasterFrameTransfer_S32K148::generate::epc::EcuM.xdm, category=SWCFG
          short-label=examples::EBT::S32K1::Lin_Flexio_MasterFrameTransfer_S32K148::generate::epc::Lin_43_LPUART_FLEXIO.xdm, category=SWCFG
          short-label=examples::EBT::S32K1::Lin_Flexio_MasterFrameTransfer_S32K148::generate::epc::Mcl.xdm, category=SWCFG
          short-label=examples::EBT::S32K1::Lin_Flexio_MasterFrameTransfer_S32K148::generate::epc::Mcu.xdm, category=SWCFG
          short-label=examples::EBT::S32K1::Lin_Flexio_MasterFrameTransfer_S32K148::generate::epc::Platform.xdm, category=SWCFG
          short-label=examples::EBT::S32K1::Lin_Flexio_MasterFrameTransfer_S32K148::generate::epc::Port.xdm, category=SWCFG
          short-label=examples::EBT::S32K1::Lin_Flexio_MasterFrameTransfer_S32K148::generate::epc::Resource.xdm, category=SWCFG
          short-label=examples::EBT::S32K1::Lin_Flexio_MasterFrameTransfer_S32K148::include::check_example.h, category=SWHDR
          short-label=examples::EBT::S32K1::Lin_Flexio_MasterFrameTransfer_S32K148::src::main.c, category=SWSRC
          short-label=examples::EBT::S32K1::Lin_Flexio_MasterFrameTransfer_S32K148::TresosProject::Lin_Flexio_MasterFrameTransfer_S32K148::.prefs::preferences.xdm, category=SWCFG
          short-label=examples::EBT::S32K1::Lin_Flexio_MasterFrameTransfer_S32K148::TresosProject::Lin_Flexio_MasterFrameTransfer_S32K148::config::BaseNXP.xdm, category=SWCFG
          short-label=examples::EBT::S32K1::Lin_Flexio_MasterFrameTransfer_S32K148::TresosProject::Lin_Flexio_MasterFrameTransfer_S32K148::config::Dem.xdm, category=SWCFG
          short-label=examples::EBT::S32K1::Lin_Flexio_MasterFrameTransfer_S32K148::TresosProject::Lin_Flexio_MasterFrameTransfer_S32K148::config::EcuC.xdm, category=SWCFG
          short-label=examples::EBT::S32K1::Lin_Flexio_MasterFrameTransfer_S32K148::TresosProject::Lin_Flexio_MasterFrameTransfer_S32K148::config::EcuM.xdm, category=SWCFG
          short-label=examples::EBT::S32K1::Lin_Flexio_MasterFrameTransfer_S32K148::TresosProject::Lin_Flexio_MasterFrameTransfer_S32K148::config::Lin_43_LPUART_FLEXIO.xdm, category=SWCFG
          short-label=examples::EBT::S32K1::Lin_Flexio_MasterFrameTransfer_S32K148::TresosProject::Lin_Flexio_MasterFrameTransfer_S32K148::config::Mcl.xdm, category=SWCFG
          short-label=examples::EBT::S32K1::Lin_Flexio_MasterFrameTransfer_S32K148::TresosProject::Lin_Flexio_MasterFrameTransfer_S32K148::config::Mcu.xdm, category=SWCFG
          short-label=examples::EBT::S32K1::Lin_Flexio_MasterFrameTransfer_S32K148::TresosProject::Lin_Flexio_MasterFrameTransfer_S32K148::config::Platform.xdm, category=SWCFG
          short-label=examples::EBT::S32K1::Lin_Flexio_MasterFrameTransfer_S32K148::TresosProject::Lin_Flexio_MasterFrameTransfer_S32K148::config::Port.xdm, category=SWCFG
          short-label=examples::EBT::S32K1::Lin_Flexio_MasterFrameTransfer_S32K148::TresosProject::Lin_Flexio_MasterFrameTransfer_S32K148::config::Resource.xdm, category=SWCFG
          short-label=examples::EBT::S32K1::Lin_Lpuart_MasterFrameTransfer_S32K118::generate::epc::BaseNXP.xdm, category=SWCFG
          short-label=examples::EBT::S32K1::Lin_Lpuart_MasterFrameTransfer_S32K118::generate::epc::Dem.xdm, category=SWCFG
          short-label=examples::EBT::S32K1::Lin_Lpuart_MasterFrameTransfer_S32K118::generate::epc::EcuC.xdm, category=SWCFG
          short-label=examples::EBT::S32K1::Lin_Lpuart_MasterFrameTransfer_S32K118::generate::epc::EcuM.xdm, category=SWCFG
          short-label=examples::EBT::S32K1::Lin_Lpuart_MasterFrameTransfer_S32K118::generate::epc::Lin_43_LPUART_FLEXIO.xdm, category=SWCFG
          short-label=examples::EBT::S32K1::Lin_Lpuart_MasterFrameTransfer_S32K118::generate::epc::Mcu.xdm, category=SWCFG
          short-label=examples::EBT::S32K1::Lin_Lpuart_MasterFrameTransfer_S32K118::generate::epc::Platform.xdm, category=SWCFG
          short-label=examples::EBT::S32K1::Lin_Lpuart_MasterFrameTransfer_S32K118::generate::epc::Port.xdm, category=SWCFG
          short-label=examples::EBT::S32K1::Lin_Lpuart_MasterFrameTransfer_S32K118::generate::epc::Resource.xdm, category=SWCFG
          short-label=examples::EBT::S32K1::Lin_Lpuart_MasterFrameTransfer_S32K118::include::check_example.h, category=SWHDR
          short-label=examples::EBT::S32K1::Lin_Lpuart_MasterFrameTransfer_S32K118::src::main.c, category=SWSRC
          short-label=examples::EBT::S32K1::Lin_Lpuart_MasterFrameTransfer_S32K118::TresosProject::Lin_Lpuart_MasterFrameTransfer_S32K118::.prefs::preferences.xdm, category=SWCFG
          short-label=examples::EBT::S32K1::Lin_Lpuart_MasterFrameTransfer_S32K118::TresosProject::Lin_Lpuart_MasterFrameTransfer_S32K118::config::BaseNXP.xdm, category=SWCFG
          short-label=examples::EBT::S32K1::Lin_Lpuart_MasterFrameTransfer_S32K118::TresosProject::Lin_Lpuart_MasterFrameTransfer_S32K118::config::Dem.xdm, category=SWCFG
          short-label=examples::EBT::S32K1::Lin_Lpuart_MasterFrameTransfer_S32K118::TresosProject::Lin_Lpuart_MasterFrameTransfer_S32K118::config::EcuC.xdm, category=SWCFG
          short-label=examples::EBT::S32K1::Lin_Lpuart_MasterFrameTransfer_S32K118::TresosProject::Lin_Lpuart_MasterFrameTransfer_S32K118::config::EcuM.xdm, category=SWCFG
          short-label=examples::EBT::S32K1::Lin_Lpuart_MasterFrameTransfer_S32K118::TresosProject::Lin_Lpuart_MasterFrameTransfer_S32K118::config::Lin_43_LPUART_FLEXIO.xdm, category=SWCFG
          short-label=examples::EBT::S32K1::Lin_Lpuart_MasterFrameTransfer_S32K118::TresosProject::Lin_Lpuart_MasterFrameTransfer_S32K118::config::Mcu.xdm, category=SWCFG
          short-label=examples::EBT::S32K1::Lin_Lpuart_MasterFrameTransfer_S32K118::TresosProject::Lin_Lpuart_MasterFrameTransfer_S32K118::config::Platform.xdm, category=SWCFG
          short-label=examples::EBT::S32K1::Lin_Lpuart_MasterFrameTransfer_S32K118::TresosProject::Lin_Lpuart_MasterFrameTransfer_S32K118::config::Port.xdm, category=SWCFG
          short-label=examples::EBT::S32K1::Lin_Lpuart_MasterFrameTransfer_S32K118::TresosProject::Lin_Lpuart_MasterFrameTransfer_S32K118::config::Resource.xdm, category=SWCFG
          short-label=examples::EBT::S32K1::Lin_Lpuart_MasterFrameTransfer_S32K144::generate::epc::BaseNXP.xdm, category=SWCFG
          short-label=examples::EBT::S32K1::Lin_Lpuart_MasterFrameTransfer_S32K144::generate::epc::Dem.xdm, category=SWCFG
          short-label=examples::EBT::S32K1::Lin_Lpuart_MasterFrameTransfer_S32K144::generate::epc::EcuC.xdm, category=SWCFG
          short-label=examples::EBT::S32K1::Lin_Lpuart_MasterFrameTransfer_S32K144::generate::epc::EcuM.xdm, category=SWCFG
          short-label=examples::EBT::S32K1::Lin_Lpuart_MasterFrameTransfer_S32K144::generate::epc::Lin_43_LPUART_FLEXIO.xdm, category=SWCFG
          short-label=examples::EBT::S32K1::Lin_Lpuart_MasterFrameTransfer_S32K144::generate::epc::Mcu.xdm, category=SWCFG
          short-label=examples::EBT::S32K1::Lin_Lpuart_MasterFrameTransfer_S32K144::generate::epc::Platform.xdm, category=SWCFG
          short-label=examples::EBT::S32K1::Lin_Lpuart_MasterFrameTransfer_S32K144::generate::epc::Port.xdm, category=SWCFG
          short-label=examples::EBT::S32K1::Lin_Lpuart_MasterFrameTransfer_S32K144::generate::epc::Resource.xdm, category=SWCFG
          short-label=examples::EBT::S32K1::Lin_Lpuart_MasterFrameTransfer_S32K144::include::check_example.h, category=SWHDR
          short-label=examples::EBT::S32K1::Lin_Lpuart_MasterFrameTransfer_S32K144::src::main.c, category=SWSRC
          short-label=examples::EBT::S32K1::Lin_Lpuart_MasterFrameTransfer_S32K144::TresosProject::Lin_Lpuart_MasterFrameTransfer_S32K144::.prefs::preferences.xdm, category=SWCFG
          short-label=examples::EBT::S32K1::Lin_Lpuart_MasterFrameTransfer_S32K144::TresosProject::Lin_Lpuart_MasterFrameTransfer_S32K144::config::BaseNXP.xdm, category=SWCFG
          short-label=examples::EBT::S32K1::Lin_Lpuart_MasterFrameTransfer_S32K144::TresosProject::Lin_Lpuart_MasterFrameTransfer_S32K144::config::Dem.xdm, category=SWCFG
          short-label=examples::EBT::S32K1::Lin_Lpuart_MasterFrameTransfer_S32K144::TresosProject::Lin_Lpuart_MasterFrameTransfer_S32K144::config::EcuC.xdm, category=SWCFG
          short-label=examples::EBT::S32K1::Lin_Lpuart_MasterFrameTransfer_S32K144::TresosProject::Lin_Lpuart_MasterFrameTransfer_S32K144::config::EcuM.xdm, category=SWCFG
          short-label=examples::EBT::S32K1::Lin_Lpuart_MasterFrameTransfer_S32K144::TresosProject::Lin_Lpuart_MasterFrameTransfer_S32K144::config::Lin_43_LPUART_FLEXIO.xdm, category=SWCFG
          short-label=examples::EBT::S32K1::Lin_Lpuart_MasterFrameTransfer_S32K144::TresosProject::Lin_Lpuart_MasterFrameTransfer_S32K144::config::Mcu.xdm, category=SWCFG
          short-label=examples::EBT::S32K1::Lin_Lpuart_MasterFrameTransfer_S32K144::TresosProject::Lin_Lpuart_MasterFrameTransfer_S32K144::config::Platform.xdm, category=SWCFG
          short-label=examples::EBT::S32K1::Lin_Lpuart_MasterFrameTransfer_S32K144::TresosProject::Lin_Lpuart_MasterFrameTransfer_S32K144::config::Port.xdm, category=SWCFG
          short-label=examples::EBT::S32K1::Lin_Lpuart_MasterFrameTransfer_S32K144::TresosProject::Lin_Lpuart_MasterFrameTransfer_S32K144::config::Resource.xdm, category=SWCFG
          short-label=examples::EBT::S32K1::Lin_Lpuart_MasterFrameTransfer_S32K144W::generate::epc::BaseNXP.xdm, category=SWCFG
          short-label=examples::EBT::S32K1::Lin_Lpuart_MasterFrameTransfer_S32K144W::generate::epc::Dem.xdm, category=SWCFG
          short-label=examples::EBT::S32K1::Lin_Lpuart_MasterFrameTransfer_S32K144W::generate::epc::EcuC.xdm, category=SWCFG
          short-label=examples::EBT::S32K1::Lin_Lpuart_MasterFrameTransfer_S32K144W::generate::epc::EcuM.xdm, category=SWCFG
          short-label=examples::EBT::S32K1::Lin_Lpuart_MasterFrameTransfer_S32K144W::generate::epc::Lin_43_LPUART_FLEXIO.xdm, category=SWCFG
          short-label=examples::EBT::S32K1::Lin_Lpuart_MasterFrameTransfer_S32K144W::generate::epc::Mcu.xdm, category=SWCFG
          short-label=examples::EBT::S32K1::Lin_Lpuart_MasterFrameTransfer_S32K144W::generate::epc::Platform.xdm, category=SWCFG
          short-label=examples::EBT::S32K1::Lin_Lpuart_MasterFrameTransfer_S32K144W::generate::epc::Port.xdm, category=SWCFG
          short-label=examples::EBT::S32K1::Lin_Lpuart_MasterFrameTransfer_S32K144W::generate::epc::Resource.xdm, category=SWCFG
          short-label=examples::EBT::S32K1::Lin_Lpuart_MasterFrameTransfer_S32K144W::include::check_example.h, category=SWHDR
          short-label=examples::EBT::S32K1::Lin_Lpuart_MasterFrameTransfer_S32K144W::src::main.c, category=SWSRC
          short-label=examples::EBT::S32K1::Lin_Lpuart_MasterFrameTransfer_S32K144W::TresosProject::Lin_Lpuart_MasterFrameTransfer_S32K144W::.prefs::preferences.xdm, category=SWCFG
          short-label=examples::EBT::S32K1::Lin_Lpuart_MasterFrameTransfer_S32K144W::TresosProject::Lin_Lpuart_MasterFrameTransfer_S32K144W::config::BaseNXP.xdm, category=SWCFG
          short-label=examples::EBT::S32K1::Lin_Lpuart_MasterFrameTransfer_S32K144W::TresosProject::Lin_Lpuart_MasterFrameTransfer_S32K144W::config::Dem.xdm, category=SWCFG
          short-label=examples::EBT::S32K1::Lin_Lpuart_MasterFrameTransfer_S32K144W::TresosProject::Lin_Lpuart_MasterFrameTransfer_S32K144W::config::EcuC.xdm, category=SWCFG
          short-label=examples::EBT::S32K1::Lin_Lpuart_MasterFrameTransfer_S32K144W::TresosProject::Lin_Lpuart_MasterFrameTransfer_S32K144W::config::EcuM.xdm, category=SWCFG
          short-label=examples::EBT::S32K1::Lin_Lpuart_MasterFrameTransfer_S32K144W::TresosProject::Lin_Lpuart_MasterFrameTransfer_S32K144W::config::Lin_43_LPUART_FLEXIO.xdm, category=SWCFG
          short-label=examples::EBT::S32K1::Lin_Lpuart_MasterFrameTransfer_S32K144W::TresosProject::Lin_Lpuart_MasterFrameTransfer_S32K144W::config::Mcu.xdm, category=SWCFG
          short-label=examples::EBT::S32K1::Lin_Lpuart_MasterFrameTransfer_S32K144W::TresosProject::Lin_Lpuart_MasterFrameTransfer_S32K144W::config::Platform.xdm, category=SWCFG
          short-label=examples::EBT::S32K1::Lin_Lpuart_MasterFrameTransfer_S32K144W::TresosProject::Lin_Lpuart_MasterFrameTransfer_S32K144W::config::Port.xdm, category=SWCFG
          short-label=examples::EBT::S32K1::Lin_Lpuart_MasterFrameTransfer_S32K144W::TresosProject::Lin_Lpuart_MasterFrameTransfer_S32K144W::config::Resource.xdm, category=SWCFG
          short-label=examples::EBT::S32K1::Lin_Lpuart_MasterFrameTransfer_S32K148::generate::epc::BaseNXP.xdm, category=SWCFG
          short-label=examples::EBT::S32K1::Lin_Lpuart_MasterFrameTransfer_S32K148::generate::epc::Dem.xdm, category=SWCFG
          short-label=examples::EBT::S32K1::Lin_Lpuart_MasterFrameTransfer_S32K148::generate::epc::EcuC.xdm, category=SWCFG
          short-label=examples::EBT::S32K1::Lin_Lpuart_MasterFrameTransfer_S32K148::generate::epc::EcuM.xdm, category=SWCFG
          short-label=examples::EBT::S32K1::Lin_Lpuart_MasterFrameTransfer_S32K148::generate::epc::Lin_43_LPUART_FLEXIO.xdm, category=SWCFG
          short-label=examples::EBT::S32K1::Lin_Lpuart_MasterFrameTransfer_S32K148::generate::epc::Mcu.xdm, category=SWCFG
          short-label=examples::EBT::S32K1::Lin_Lpuart_MasterFrameTransfer_S32K148::generate::epc::Platform.xdm, category=SWCFG
          short-label=examples::EBT::S32K1::Lin_Lpuart_MasterFrameTransfer_S32K148::generate::epc::Port.xdm, category=SWCFG
          short-label=examples::EBT::S32K1::Lin_Lpuart_MasterFrameTransfer_S32K148::generate::epc::Resource.xdm, category=SWCFG
          short-label=examples::EBT::S32K1::Lin_Lpuart_MasterFrameTransfer_S32K148::include::check_example.h, category=SWHDR
          short-label=examples::EBT::S32K1::Lin_Lpuart_MasterFrameTransfer_S32K148::src::main.c, category=SWSRC
          short-label=examples::EBT::S32K1::Lin_Lpuart_MasterFrameTransfer_S32K148::TresosProject::Lin_Lpuart_MasterFrameTransfer_S32K148::.prefs::preferences.xdm, category=SWCFG
          short-label=examples::EBT::S32K1::Lin_Lpuart_MasterFrameTransfer_S32K148::TresosProject::Lin_Lpuart_MasterFrameTransfer_S32K148::config::BaseNXP.xdm, category=SWCFG
          short-label=examples::EBT::S32K1::Lin_Lpuart_MasterFrameTransfer_S32K148::TresosProject::Lin_Lpuart_MasterFrameTransfer_S32K148::config::Dem.xdm, category=SWCFG
          short-label=examples::EBT::S32K1::Lin_Lpuart_MasterFrameTransfer_S32K148::TresosProject::Lin_Lpuart_MasterFrameTransfer_S32K148::config::EcuC.xdm, category=SWCFG
          short-label=examples::EBT::S32K1::Lin_Lpuart_MasterFrameTransfer_S32K148::TresosProject::Lin_Lpuart_MasterFrameTransfer_S32K148::config::EcuM.xdm, category=SWCFG
          short-label=examples::EBT::S32K1::Lin_Lpuart_MasterFrameTransfer_S32K148::TresosProject::Lin_Lpuart_MasterFrameTransfer_S32K148::config::Lin_43_LPUART_FLEXIO.xdm, category=SWCFG
          short-label=examples::EBT::S32K1::Lin_Lpuart_MasterFrameTransfer_S32K148::TresosProject::Lin_Lpuart_MasterFrameTransfer_S32K148::config::Mcu.xdm, category=SWCFG
          short-label=examples::EBT::S32K1::Lin_Lpuart_MasterFrameTransfer_S32K148::TresosProject::Lin_Lpuart_MasterFrameTransfer_S32K148::config::Platform.xdm, category=SWCFG
          short-label=examples::EBT::S32K1::Lin_Lpuart_MasterFrameTransfer_S32K148::TresosProject::Lin_Lpuart_MasterFrameTransfer_S32K148::config::Port.xdm, category=SWCFG
          short-label=examples::EBT::S32K1::Lin_Lpuart_MasterFrameTransfer_S32K148::TresosProject::Lin_Lpuart_MasterFrameTransfer_S32K148::config::Resource.xdm, category=SWCFG
          short-label=examples::EBT::S32M24::Lin_LinTrcv_FrameTransfer_S32M244::generate::epc::Ae.xdm, category=SWCFG
          short-label=examples::EBT::S32M24::Lin_LinTrcv_FrameTransfer_S32M244::generate::epc::BaseNXP.xdm, category=SWCFG
          short-label=examples::EBT::S32M24::Lin_LinTrcv_FrameTransfer_S32M244::generate::epc::Dem.xdm, category=SWCFG
          short-label=examples::EBT::S32M24::Lin_LinTrcv_FrameTransfer_S32M244::generate::epc::EcuC.xdm, category=SWCFG
          short-label=examples::EBT::S32M24::Lin_LinTrcv_FrameTransfer_S32M244::generate::epc::EcuM.xdm, category=SWCFG
          short-label=examples::EBT::S32M24::Lin_LinTrcv_FrameTransfer_S32M244::generate::epc::LinTrcv_43_AE.xdm, category=SWCFG
          short-label=examples::EBT::S32M24::Lin_LinTrcv_FrameTransfer_S32M244::generate::epc::Lin_43_LPUART_FLEXIO.xdm, category=SWCFG
          short-label=examples::EBT::S32M24::Lin_LinTrcv_FrameTransfer_S32M244::generate::epc::Mcu.xdm, category=SWCFG
          short-label=examples::EBT::S32M24::Lin_LinTrcv_FrameTransfer_S32M244::generate::epc::Platform.xdm, category=SWCFG
          short-label=examples::EBT::S32M24::Lin_LinTrcv_FrameTransfer_S32M244::generate::epc::Port.xdm, category=SWCFG
          short-label=examples::EBT::S32M24::Lin_LinTrcv_FrameTransfer_S32M244::generate::epc::Resource.xdm, category=SWCFG
          short-label=examples::EBT::S32M24::Lin_LinTrcv_FrameTransfer_S32M244::generate::epc::Spi.xdm, category=SWCFG
          short-label=examples::EBT::S32M24::Lin_LinTrcv_FrameTransfer_S32M244::include::check_example.h, category=SWHDR
          short-label=examples::EBT::S32M24::Lin_LinTrcv_FrameTransfer_S32M244::src::main.c, category=SWSRC
          short-label=examples::EBT::S32M24::Lin_LinTrcv_FrameTransfer_S32M244::TresosProject::Lin_LinTrcv_FrameTransfer_S32M244::.prefs::preferences.xdm, category=SWCFG
          short-label=examples::EBT::S32M24::Lin_LinTrcv_FrameTransfer_S32M244::TresosProject::Lin_LinTrcv_FrameTransfer_S32M244::config::Ae.xdm, category=SWCFG
          short-label=examples::EBT::S32M24::Lin_LinTrcv_FrameTransfer_S32M244::TresosProject::Lin_LinTrcv_FrameTransfer_S32M244::config::BaseNXP.xdm, category=SWCFG
          short-label=examples::EBT::S32M24::Lin_LinTrcv_FrameTransfer_S32M244::TresosProject::Lin_LinTrcv_FrameTransfer_S32M244::config::Dem.xdm, category=SWCFG
          short-label=examples::EBT::S32M24::Lin_LinTrcv_FrameTransfer_S32M244::TresosProject::Lin_LinTrcv_FrameTransfer_S32M244::config::EcuC.xdm, category=SWCFG
          short-label=examples::EBT::S32M24::Lin_LinTrcv_FrameTransfer_S32M244::TresosProject::Lin_LinTrcv_FrameTransfer_S32M244::config::EcuM.xdm, category=SWCFG
          short-label=examples::EBT::S32M24::Lin_LinTrcv_FrameTransfer_S32M244::TresosProject::Lin_LinTrcv_FrameTransfer_S32M244::config::LinTrcv_43_AE.xdm, category=SWCFG
          short-label=examples::EBT::S32M24::Lin_LinTrcv_FrameTransfer_S32M244::TresosProject::Lin_LinTrcv_FrameTransfer_S32M244::config::Lin_43_LPUART_FLEXIO.xdm, category=SWCFG
          short-label=examples::EBT::S32M24::Lin_LinTrcv_FrameTransfer_S32M244::TresosProject::Lin_LinTrcv_FrameTransfer_S32M244::config::Mcu.xdm, category=SWCFG
          short-label=examples::EBT::S32M24::Lin_LinTrcv_FrameTransfer_S32M244::TresosProject::Lin_LinTrcv_FrameTransfer_S32M244::config::Platform.xdm, category=SWCFG
          short-label=examples::EBT::S32M24::Lin_LinTrcv_FrameTransfer_S32M244::TresosProject::Lin_LinTrcv_FrameTransfer_S32M244::config::Port.xdm, category=SWCFG
          short-label=examples::EBT::S32M24::Lin_LinTrcv_FrameTransfer_S32M244::TresosProject::Lin_LinTrcv_FrameTransfer_S32M244::config::Resource.xdm, category=SWCFG
          short-label=examples::EBT::S32M24::Lin_LinTrcv_FrameTransfer_S32M244::TresosProject::Lin_LinTrcv_FrameTransfer_S32M244::config::Spi.xdm, category=SWCFG
          short-label=examples::S32DS::S32K1::Lin_Flexio_MasterFrameTransfer_S32K118::include::check_example.h, category=SWHDR
          short-label=examples::S32DS::S32K1::Lin_Flexio_MasterFrameTransfer_S32K118::Project_Settings::Startup_Code::exceptions.c, category=SWSRC
          short-label=examples::S32DS::S32K1::Lin_Flexio_MasterFrameTransfer_S32K118::Project_Settings::Startup_Code::nvic.c, category=SWSRC
          short-label=examples::S32DS::S32K1::Lin_Flexio_MasterFrameTransfer_S32K118::Project_Settings::Startup_Code::startup.c, category=SWSRC
          short-label=examples::S32DS::S32K1::Lin_Flexio_MasterFrameTransfer_S32K118::Project_Settings::Startup_Code::system.c, category=SWSRC
          short-label=examples::S32DS::S32K1::Lin_Flexio_MasterFrameTransfer_S32K118::src::main.c, category=SWSRC
          short-label=examples::S32DS::S32K1::Lin_Flexio_MasterFrameTransfer_S32K144::include::check_example.h, category=SWHDR
          short-label=examples::S32DS::S32K1::Lin_Flexio_MasterFrameTransfer_S32K144::Project_Settings::Startup_Code::exceptions.c, category=SWSRC
          short-label=examples::S32DS::S32K1::Lin_Flexio_MasterFrameTransfer_S32K144::Project_Settings::Startup_Code::nvic.c, category=SWSRC
          short-label=examples::S32DS::S32K1::Lin_Flexio_MasterFrameTransfer_S32K144::Project_Settings::Startup_Code::startup.c, category=SWSRC
          short-label=examples::S32DS::S32K1::Lin_Flexio_MasterFrameTransfer_S32K144::Project_Settings::Startup_Code::system.c, category=SWSRC
          short-label=examples::S32DS::S32K1::Lin_Flexio_MasterFrameTransfer_S32K144::src::main.c, category=SWSRC
          short-label=examples::S32DS::S32K1::Lin_Flexio_MasterFrameTransfer_S32K144W::include::check_example.h, category=SWHDR
          short-label=examples::S32DS::S32K1::Lin_Flexio_MasterFrameTransfer_S32K144W::Project_Settings::Startup_Code::exceptions.c, category=SWSRC
          short-label=examples::S32DS::S32K1::Lin_Flexio_MasterFrameTransfer_S32K144W::Project_Settings::Startup_Code::nvic.c, category=SWSRC
          short-label=examples::S32DS::S32K1::Lin_Flexio_MasterFrameTransfer_S32K144W::Project_Settings::Startup_Code::startup.c, category=SWSRC
          short-label=examples::S32DS::S32K1::Lin_Flexio_MasterFrameTransfer_S32K144W::Project_Settings::Startup_Code::system.c, category=SWSRC
          short-label=examples::S32DS::S32K1::Lin_Flexio_MasterFrameTransfer_S32K144W::src::main.c, category=SWSRC
          short-label=examples::S32DS::S32K1::Lin_Flexio_MasterFrameTransfer_S32K148::include::check_example.h, category=SWHDR
          short-label=examples::S32DS::S32K1::Lin_Flexio_MasterFrameTransfer_S32K148::Project_Settings::Startup_Code::exceptions.c, category=SWSRC
          short-label=examples::S32DS::S32K1::Lin_Flexio_MasterFrameTransfer_S32K148::Project_Settings::Startup_Code::nvic.c, category=SWSRC
          short-label=examples::S32DS::S32K1::Lin_Flexio_MasterFrameTransfer_S32K148::Project_Settings::Startup_Code::startup.c, category=SWSRC
          short-label=examples::S32DS::S32K1::Lin_Flexio_MasterFrameTransfer_S32K148::Project_Settings::Startup_Code::system.c, category=SWSRC
          short-label=examples::S32DS::S32K1::Lin_Flexio_MasterFrameTransfer_S32K148::src::main.c, category=SWSRC
          short-label=examples::S32DS::S32K1::Lin_Ip_FrameTransfer_S32K118::include::check_example.h, category=SWHDR
          short-label=examples::S32DS::S32K1::Lin_Ip_FrameTransfer_S32K118::Project_Settings::Startup_Code::exceptions.c, category=SWSRC
          short-label=examples::S32DS::S32K1::Lin_Ip_FrameTransfer_S32K118::Project_Settings::Startup_Code::nvic.c, category=SWSRC
          short-label=examples::S32DS::S32K1::Lin_Ip_FrameTransfer_S32K118::Project_Settings::Startup_Code::startup.c, category=SWSRC
          short-label=examples::S32DS::S32K1::Lin_Ip_FrameTransfer_S32K118::Project_Settings::Startup_Code::system.c, category=SWSRC
          short-label=examples::S32DS::S32K1::Lin_Ip_FrameTransfer_S32K118::src::main.c, category=SWSRC
          short-label=examples::S32DS::S32K1::Lin_Ip_FrameTransfer_S32K144::include::check_example.h, category=SWHDR
          short-label=examples::S32DS::S32K1::Lin_Ip_FrameTransfer_S32K144::Project_Settings::Startup_Code::exceptions.c, category=SWSRC
          short-label=examples::S32DS::S32K1::Lin_Ip_FrameTransfer_S32K144::Project_Settings::Startup_Code::nvic.c, category=SWSRC
          short-label=examples::S32DS::S32K1::Lin_Ip_FrameTransfer_S32K144::Project_Settings::Startup_Code::startup.c, category=SWSRC
          short-label=examples::S32DS::S32K1::Lin_Ip_FrameTransfer_S32K144::Project_Settings::Startup_Code::system.c, category=SWSRC
          short-label=examples::S32DS::S32K1::Lin_Ip_FrameTransfer_S32K144::src::main.c, category=SWSRC
          short-label=examples::S32DS::S32K1::Lin_Ip_FrameTransfer_S32K144W::include::check_example.h, category=SWHDR
          short-label=examples::S32DS::S32K1::Lin_Ip_FrameTransfer_S32K144W::Project_Settings::Startup_Code::exceptions.c, category=SWSRC
          short-label=examples::S32DS::S32K1::Lin_Ip_FrameTransfer_S32K144W::Project_Settings::Startup_Code::nvic.c, category=SWSRC
          short-label=examples::S32DS::S32K1::Lin_Ip_FrameTransfer_S32K144W::Project_Settings::Startup_Code::startup.c, category=SWSRC
          short-label=examples::S32DS::S32K1::Lin_Ip_FrameTransfer_S32K144W::Project_Settings::Startup_Code::system.c, category=SWSRC
          short-label=examples::S32DS::S32K1::Lin_Ip_FrameTransfer_S32K144W::src::main.c, category=SWSRC
          short-label=examples::S32DS::S32K1::Lin_Ip_FrameTransfer_S32K148::include::check_example.h, category=SWHDR
          short-label=examples::S32DS::S32K1::Lin_Ip_FrameTransfer_S32K148::Project_Settings::Startup_Code::exceptions.c, category=SWSRC
          short-label=examples::S32DS::S32K1::Lin_Ip_FrameTransfer_S32K148::Project_Settings::Startup_Code::nvic.c, category=SWSRC
          short-label=examples::S32DS::S32K1::Lin_Ip_FrameTransfer_S32K148::Project_Settings::Startup_Code::startup.c, category=SWSRC
          short-label=examples::S32DS::S32K1::Lin_Ip_FrameTransfer_S32K148::Project_Settings::Startup_Code::system.c, category=SWSRC
          short-label=examples::S32DS::S32K1::Lin_Ip_FrameTransfer_S32K148::src::main.c, category=SWSRC
          short-label=examples::S32DS::S32K1::Lin_Lpuart_MasterFrameTransfer_S32K118::include::check_example.h, category=SWHDR
          short-label=examples::S32DS::S32K1::Lin_Lpuart_MasterFrameTransfer_S32K118::Project_Settings::Startup_Code::exceptions.c, category=SWSRC
          short-label=examples::S32DS::S32K1::Lin_Lpuart_MasterFrameTransfer_S32K118::Project_Settings::Startup_Code::nvic.c, category=SWSRC
          short-label=examples::S32DS::S32K1::Lin_Lpuart_MasterFrameTransfer_S32K118::Project_Settings::Startup_Code::startup.c, category=SWSRC
          short-label=examples::S32DS::S32K1::Lin_Lpuart_MasterFrameTransfer_S32K118::Project_Settings::Startup_Code::system.c, category=SWSRC
          short-label=examples::S32DS::S32K1::Lin_Lpuart_MasterFrameTransfer_S32K118::src::main.c, category=SWSRC
          short-label=examples::S32DS::S32K1::Lin_Lpuart_MasterFrameTransfer_S32K144::include::check_example.h, category=SWHDR
          short-label=examples::S32DS::S32K1::Lin_Lpuart_MasterFrameTransfer_S32K144::Project_Settings::Startup_Code::exceptions.c, category=SWSRC
          short-label=examples::S32DS::S32K1::Lin_Lpuart_MasterFrameTransfer_S32K144::Project_Settings::Startup_Code::nvic.c, category=SWSRC
          short-label=examples::S32DS::S32K1::Lin_Lpuart_MasterFrameTransfer_S32K144::Project_Settings::Startup_Code::startup.c, category=SWSRC
          short-label=examples::S32DS::S32K1::Lin_Lpuart_MasterFrameTransfer_S32K144::Project_Settings::Startup_Code::system.c, category=SWSRC
          short-label=examples::S32DS::S32K1::Lin_Lpuart_MasterFrameTransfer_S32K144::src::main.c, category=SWSRC
          short-label=examples::S32DS::S32K1::Lin_Lpuart_MasterFrameTransfer_S32K144W::include::check_example.h, category=SWHDR
          short-label=examples::S32DS::S32K1::Lin_Lpuart_MasterFrameTransfer_S32K144W::Project_Settings::Startup_Code::exceptions.c, category=SWSRC
          short-label=examples::S32DS::S32K1::Lin_Lpuart_MasterFrameTransfer_S32K144W::Project_Settings::Startup_Code::nvic.c, category=SWSRC
          short-label=examples::S32DS::S32K1::Lin_Lpuart_MasterFrameTransfer_S32K144W::Project_Settings::Startup_Code::startup.c, category=SWSRC
          short-label=examples::S32DS::S32K1::Lin_Lpuart_MasterFrameTransfer_S32K144W::Project_Settings::Startup_Code::system.c, category=SWSRC
          short-label=examples::S32DS::S32K1::Lin_Lpuart_MasterFrameTransfer_S32K144W::src::main.c, category=SWSRC
          short-label=examples::S32DS::S32K1::Lin_Lpuart_MasterFrameTransfer_S32K148::include::check_example.h, category=SWHDR
          short-label=examples::S32DS::S32K1::Lin_Lpuart_MasterFrameTransfer_S32K148::Project_Settings::Startup_Code::exceptions.c, category=SWSRC
          short-label=examples::S32DS::S32K1::Lin_Lpuart_MasterFrameTransfer_S32K148::Project_Settings::Startup_Code::nvic.c, category=SWSRC
          short-label=examples::S32DS::S32K1::Lin_Lpuart_MasterFrameTransfer_S32K148::Project_Settings::Startup_Code::startup.c, category=SWSRC
          short-label=examples::S32DS::S32K1::Lin_Lpuart_MasterFrameTransfer_S32K148::Project_Settings::Startup_Code::system.c, category=SWSRC
          short-label=examples::S32DS::S32K1::Lin_Lpuart_MasterFrameTransfer_S32K148::src::main.c, category=SWSRC
          short-label=examples::S32DS::S32M24::Lin_LinTrcv_FrameTransfer_S32M244::include::check_example.h, category=SWHDR
          short-label=examples::S32DS::S32M24::Lin_LinTrcv_FrameTransfer_S32M244::Project_Settings::Startup_Code::exceptions.c, category=SWSRC
          short-label=examples::S32DS::S32M24::Lin_LinTrcv_FrameTransfer_S32M244::Project_Settings::Startup_Code::nvic.c, category=SWSRC
          short-label=examples::S32DS::S32M24::Lin_LinTrcv_FrameTransfer_S32M244::Project_Settings::Startup_Code::startup.c, category=SWSRC
          short-label=examples::S32DS::S32M24::Lin_LinTrcv_FrameTransfer_S32M244::Project_Settings::Startup_Code::system.c, category=SWSRC
          short-label=examples::S32DS::S32M24::Lin_LinTrcv_FrameTransfer_S32M244::src::main.c, category=SWSRC
          short-label=include::Flexio_Lin_Ip.h, category=SWHDR
          short-label=include::Flexio_Lin_Ip_Irq.h, category=SWHDR
          short-label=include::Flexio_Lin_Ip_Types.h, category=SWHDR
          short-label=include::Lin_43_LPUART_FLEXIO.h, category=SWHDR
          short-label=include::Lin_43_LPUART_FLEXIO_ASRExt.h, category=SWHDR
          short-label=include::Lin_43_LPUART_FLEXIO_Ipw.h, category=SWHDR
          short-label=include::Lin_43_LPUART_FLEXIO_Ipw_Types.h, category=SWHDR
          short-label=include::Lin_43_LPUART_FLEXIO_Types.h, category=SWHDR
          short-label=include::Lin_Ip_Common.h, category=SWHDR
          short-label=include::Lpuart_Lin_Ip.h, category=SWHDR
          short-label=include::Lpuart_Lin_Ip_Hw_Access.h, category=SWHDR
          short-label=include::Lpuart_Lin_Ip_Types.h, category=SWHDR
          short-label=src::Flexio_Lin_Ip.c, category=SWSRC
          short-label=src::Lin_43_LPUART_FLEXIO.c, category=SWSRC
          short-label=src::Lin_43_LPUART_FLEXIO_ASRExt.c, category=SWSRC
          short-label=src::Lin_43_LPUART_FLEXIO_Ipw.c, category=SWSRC
          short-label=src::Lin_Ip_Common.c, category=SWSRC
          short-label=src::Lpuart_Lin_Ip.c, category=SWSRC
          short-label=src::Lpuart_Lin_Ip_Hw_Access.c, category=SWSRC
          short-label=src::Lpuart_Lin_Ip_Irq.c, category=SWSRC
    compiler GCC_Compiler:
      name=GCC Compiler
      options=-mcpu=cortex-m4 -mcpu=cortex-m0plus -mthumb -mlittle-endian -mfpu=fpv4-sp-d16 -mfloat-abi=hard -mfpu=auto -mfloat-abi=soft -std=c99 -Os -ggdb3 -Wall -Wextra -pedantic -Wstrict-prototypes -Wundef -Wunused -Werror=implicit-function-declaration -Wsign-compare -Wdouble-promotion -fno-short-enums -funsigned-char -funsigned-bitfields -fomit-frame-pointer -fno-common -fstack-usage -fdump-ipa-all -c -DUSE_SW_VECTOR_MODE -DI_CACHE_ENABLE -DENABLE_FPU -DMCAL_ENABLE_USER_MODE_SUPPORT --sysroot=$(NEWLIB_DIR) -specs=nano.specs -specs=nosys.specs
      vendor=GCC Systems
      version=NXP GCC 10.2.0 20200723 (Build 1728 Revision g5963bc8)
    compiler GHS_Compiler:
      name=Green Hills
      options=-cpu=cortexm4 -cpu=cortexm0plus -thumb -fpu=vfpv4_d16 -fsingle -fsoft -C99 --ghstd=last -Osize --gnu_asm -dual_debug -G -keeptempfiles -Wimplicit-int -Wshadow -Wtrigraphs -Wundef --unsigned_chars --unsigned_fields --no_commons --no_exceptions --no_slash_comment --prototype_errors --incorrect_pragma_warnings -c -DUSE_SW_VECTOR_MODE -DI_CACHE_ENABLE -DENABLE_FPU -DMCAL_ENABLE_USER_MODE_SUPPORT
      vendor=Green Hills
      version=Green Hills Multi 7.1.6d / Compiler 2020.1.4
    compiler IAR_Compiler:
      name=IAR Compiler
      options=--cpu=Cortex-M4 --cpu=Cortex-M0+ --cpu_mode=thumb --endian=little --fpu=FPv4-SP --fpu=none -e -Ohz --debug --no_clustering --no_mem_idioms --no_explicit_zero_opt --require_prototypes --no_wrap_diagnostics --diag_suppress=Pa050 -DIAR -DUSE_SW_VECTOR_MODE -DI_CACHE_ENABLE -DENABLE_FPU -DMCAL_ENABLE_USER_MODE_SUPPORT
      vendor=IAR Systems
      version=IAR ANSI C/C++ Compiler V8.40.3.228/W32 for ARM Functional Safety
    generated-artifacts:
      17 x dependency on artifact:
        Flexio_Lin_Ip_PBcfg_h: artifact-descriptor={short-label=generate_PB::include::Flexio_Lin_Ip_PBcfg.h, category=SWHDR}, usages=EXECUTE
        Lin_43_LPUART_FLEXIO_Ipw_PBcfg_h: artifact-descriptor={short-label=generate_PB::include::Lin_43_LPUART_FLEXIO_Ipw_PBcfg.h, category=SWHDR}, usages=EXECUTE
        Lin_43_LPUART_FLEXIO_PBcfg_h: artifact-descriptor={short-label=generate_PB::include::Lin_43_LPUART_FLEXIO_PBcfg.h, category=SWHDR}, usages=EXECUTE
        Lpuart_Lin_Ip_PBcfg_h: artifact-descriptor={short-label=generate_PB::include::Lpuart_Lin_Ip_PBcfg.h, category=SWHDR}, usages=EXECUTE
        Flexio_Lin_Ip_PBcfg_c: artifact-descriptor={short-label=generate_PB::src::Flexio_Lin_Ip_PBcfg.c, category=SWSRC}, usages=EXECUTE
        Lin_43_LPUART_FLEXIO_Ipw_PBcfg_c: artifact-descriptor={short-label=generate_PB::src::Lin_43_LPUART_FLEXIO_Ipw_PBcfg.c, category=SWSRC}, usages=EXECUTE
        Lin_43_LPUART_FLEXIO_PBcfg_c: artifact-descriptor={short-label=generate_PB::src::Lin_43_LPUART_FLEXIO_PBcfg.c, category=SWSRC}, usages=EXECUTE
        Lpuart_Lin_Ip_PBcfg_c: artifact-descriptor={short-label=generate_PB::src::Lpuart_Lin_Ip_PBcfg.c, category=SWSRC}, usages=EXECUTE
        Flexio_Lin_Ip_Cfg_h: artifact-descriptor={short-label=generate_PC::include::Flexio_Lin_Ip_Cfg.h, category=SWHDR}, usages=COMPILE
        Flexio_Lin_Ip_CfgDefines_h: artifact-descriptor={short-label=generate_PC::include::Flexio_Lin_Ip_CfgDefines.h, category=SWHDR}, usages=COMPILE
        Flexio_Lin_Ip_Defines_h: artifact-descriptor={short-label=generate_PC::include::Flexio_Lin_Ip_Defines.h, category=SWHDR}, usages=COMPILE
        Lin_43_LPUART_FLEXIO_Cfg_h: artifact-descriptor={short-label=generate_PC::include::Lin_43_LPUART_FLEXIO_Cfg.h, category=SWHDR}, usages=COMPILE
        Lin_43_LPUART_FLEXIO_Defines_h: artifact-descriptor={short-label=generate_PC::include::Lin_43_LPUART_FLEXIO_Defines.h, category=SWHDR}, usages=COMPILE
        Lin_43_LPUART_FLEXIO_Ipw_Cfg_h: artifact-descriptor={short-label=generate_PC::include::Lin_43_LPUART_FLEXIO_Ipw_Cfg.h, category=SWHDR}, usages=COMPILE
        Lpuart_Lin_Ip_Cfg_h: artifact-descriptor={short-label=generate_PC::include::Lpuart_Lin_Ip_Cfg.h, category=SWHDR}, usages=COMPILE
        Lpuart_Lin_Ip_Defines_h: artifact-descriptor={short-label=generate_PC::include::Lpuart_Lin_Ip_Defines.h, category=SWHDR}, usages=COMPILE
        Lin_43_LPUART_FLEXIO_Cfg_c: artifact-descriptor={short-label=generate_PC::src::Lin_43_LPUART_FLEXIO_Cfg.c, category=SWSRC}, usages=COMPILE
    linker GCC_Linker: name=GCC Compiler, options=-Wl,-Map,filename -T linkerfile --entry=Reset_Handler -nostartfiles -mcpu=cortex-m4 -mcpu=cortex-m0plus -mthumb -mfpu=fpv4-sp-d16 -mfloat-abi=hard -mfpu=auto -mfloat-abi=soft -mlittle-endian -ggdb3 -lc -lm -lgcc -n --sysroot=$(NEWLIB_DIR) -specs=nano.specs -specs=nosys.specs, vendor=GCC Systems, version=NXP GCC 10.2.0 20200723 (Build 1728 Revision g5963bc8)
    linker GHS_Linker: name=Green Hills, options=-e Reset_Handler -T linker_script_file.ld -map -keepmap -Mn -delete -ignore_debug_references -Llibrary_path -larch -lstartup -lind_sd -lind_sf -v -keep=C40_Ip_AccessCode -nostartfiles, vendor=Green Hills, version=Green Hills Multi 7.1.6d / Compiler 2020.1.4
    linker IAR_Linker: name=IAR Compiler, options=--map filename --config linkerfile --cpu=Cortex-M4 --cpu=Cortex-M0+ --fpu=FPv4-SP --fpu=none --entry _start --enable_stack_usage --skip_dynamic_initialization --no_wrap_diagnostics, vendor=IAR Systems, version=IAR ANSI C/C++ Compiler V8.40.3.228/W32 for ARM Functional Safety
    resource consumption ResourceConsumption
      9 x memory section:
        LIN_43_LPUART_FLEXIO_CODE: alignment=UNSPECIFIED, sw-addrmethod=CODE, symbol=CODE
        LIN_43_LPUART_FLEXIO_CONFIG_DATA_UNSPECIFIED: alignment=UNSPECIFIED, sw-addrmethod=CONFIG_DATA, symbol=CONFIG_DATA_UNSPECIFIED
        LIN_43_LPUART_FLEXIO_CONST_UNSPECIFIED: alignment=UNSPECIFIED, sw-addrmethod=CONST, symbol=CONST_UNSPECIFIED
        LIN_43_LPUART_FLEXIO_VAR_CLEARED_32_NO_CACHEABLE: alignment=32, sw-addrmethod=VAR_CLEARED_NO_CACHEABLE, symbol=VAR_CLEARED_32_NO_CACHEABLE
        LIN_43_LPUART_FLEXIO_VAR_CLEARED_8_NO_CACHEABLE: alignment=8, sw-addrmethod=VAR_CLEARED_NO_CACHEABLE, symbol=VAR_CLEARED_8_NO_CACHEABLE
        LIN_43_LPUART_FLEXIO_VAR_CLEARED_BOOLEAN_NO_CACHEABLE: alignment=BOOLEAN, sw-addrmethod=VAR_CLEARED_NO_CACHEABLE, symbol=VAR_CLEARED_BOOLEAN_NO_CACHEABLE
        LIN_43_LPUART_FLEXIO_VAR_CLEARED_UNSPECIFIED: alignment=UNSPECIFIED, sw-addrmethod=VAR_CLEARED, symbol=VAR_CLEARED_UNSPECIFIED
        LIN_43_LPUART_FLEXIO_VAR_CLEARED_UNSPECIFIED_NO_CACHEABLE: alignment=UNSPECIFIED, sw-addrmethod=VAR_CLEARED_NO_CACHEABLE, symbol=VAR_CLEARED_UNSPECIFIED_NO_CACHEABLE
        LIN_43_LPUART_FLEXIO_VAR_INIT_8_NO_CACHEABLE: alignment=8, sw-addrmethod=VAR_INIT_NO_CACHEABLE, symbol=VAR_INIT_8_NO_CACHEABLE
