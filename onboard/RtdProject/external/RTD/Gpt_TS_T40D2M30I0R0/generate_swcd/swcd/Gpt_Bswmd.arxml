AUTOSAR XML (schema 00050)
package /AUTOSAR_Gpt/BswModuleDescriptions
  bsw module description Gpt: module-id=100
    provided-entrys:
      Ftm_Gpt_Ip_StartTimer
      Gpt_ChangeNextTimeoutValue
      Gpt_Channel_DisableChainMode
      Gpt_Channel_EnableChainMode
      Gpt_CheckWakeup
      Gpt_DeInit
      Gpt_DisableNotification
      Gpt_DisableWakeup
      Gpt_EnableNotification
      Gpt_EnableWakeup
      Gpt_GetPredefTimerValue
      Gpt_GetTimeElapsed
      Gpt_GetTimeRemaining
      Gpt_GetVersionInfo
      Gpt_Init
      Gpt_SetClockMode
      Gpt_SetMode
      Gpt_StartTimer
      Gpt_StopTimer
      Lptmr_Gpt_Ip_SetCompareValue
      FSS_COSS_FTM_0_CH_{0..5}_ISR
      FSS_COSS_FTM_1_CH_{0..5}_ISR
      FSS_COSS_FTM_2_CH_{0..5}_ISR
      FSS_COSS_FTM_3_CH_{0..5}_ISR
      FSS_HKI_FTM_0_ISR
      FSS_HKI_FTM_1_ISR
      FTM_0_CH_0_CH_1_ISR
      FTM_0_CH_2_CH_3_ISR
      FTM_0_CH_4_CH_5_ISR
      FTM_0_CH_6_CH_7_ISR
      FTM_0_ISR
      FTM_1_CH_0_CH_1_ISR
      FTM_1_CH_2_CH_3_ISR
      FTM_1_CH_4_CH_5_ISR
      FTM_1_CH_6_CH_7_ISR
      FTM_1_ISR
      FTM_2_CH_0_CH_1_ISR
      FTM_2_CH_2_CH_3_ISR
      FTM_2_CH_4_CH_5_ISR
      FTM_2_CH_6_CH_7_ISR
      FTM_3_CH_0_CH_1_ISR
      FTM_3_CH_2_CH_3_ISR
      FTM_3_CH_4_CH_5_ISR
      FTM_3_CH_6_CH_7_ISR
      FTM_4_CH_0_CH_1_ISR
      FTM_4_CH_2_CH_3_ISR
      FTM_4_CH_4_CH_5_ISR
      FTM_4_CH_6_CH_7_ISR
      FTM_5_CH_0_CH_1_ISR
      FTM_5_CH_2_CH_3_ISR
      FTM_5_CH_4_CH_5_ISR
      FTM_5_CH_6_CH_7_ISR
      FTM_6_CH_0_CH_1_ISR
      FTM_6_CH_2_CH_3_ISR
      FTM_6_CH_4_CH_5_ISR
      FTM_6_CH_6_CH_7_ISR
      FTM_7_CH_0_CH_1_ISR
      FTM_7_CH_2_CH_3_ISR
      FTM_7_CH_4_CH_5_ISR
      FTM_7_CH_6_CH_7_ISR
      LPIT_0_CH_{0..3}_ISR
      LPIT_0_ISR
      LPTMR_0_CH_0_ISR
      SRTC_0_Ch_0_ISR
    bsw internal behavior InternalBehavior_0
      23 x exclusive area:
        GPT_EXCLUSIVE_AREA_19
        GPT_EXCLUSIVE_AREA_25
        GPT_EXCLUSIVE_AREA_26
        GPT_EXCLUSIVE_AREA_{40..46}
        GPT_EXCLUSIVE_AREA_{50..56}
        GPT_EXCLUSIVE_AREA_60
        GPT_EXCLUSIVE_AREA_61
        GPT_EXCLUSIVE_AREA_{64..67}
      20 x bsw called entity:
        Ftm_Gpt_Ip_StartTimer: implemented-entry=Ftm_Gpt_Ip_StartTimer
        Gpt_ChangeNextTimeoutValue: implemented-entry=Gpt_ChangeNextTimeoutValue
        Gpt_Channel_DisableChainMode: can-enter-exclusive-area=GPT_EXCLUSIVE_AREA_56, implemented-entry=Gpt_Channel_DisableChainMode
        Gpt_Channel_EnableChainMode: can-enter-exclusive-area=GPT_EXCLUSIVE_AREA_56, implemented-entry=Gpt_Channel_EnableChainMode
        Gpt_CheckWakeup: implemented-entry=Gpt_CheckWakeup
        Gpt_DeInit: can-enter-exclusive-area=[GPT_EXCLUSIVE_AREA_40, GPT_EXCLUSIVE_AREA_41, GPT_EXCLUSIVE_AREA_42, GPT_EXCLUSIVE_AREA_44, GPT_EXCLUSIVE_AREA_52, GPT_EXCLUSIVE_AREA_53, GPT_EXCLUSIVE_AREA_54, GPT_EXCLUSIVE_AREA_55, GPT_EXCLUSIVE_AREA_64], implemented-entry=Gpt_DeInit
        Gpt_DisableNotification: can-enter-exclusive-area=[GPT_EXCLUSIVE_AREA_41, GPT_EXCLUSIVE_AREA_42, GPT_EXCLUSIVE_AREA_55, GPT_EXCLUSIVE_AREA_60, GPT_EXCLUSIVE_AREA_61], implemented-entry=Gpt_DisableNotification
        Gpt_DisableWakeup: implemented-entry=Gpt_DisableWakeup
        Gpt_EnableNotification: can-enter-exclusive-area=[GPT_EXCLUSIVE_AREA_41, GPT_EXCLUSIVE_AREA_55, GPT_EXCLUSIVE_AREA_60, GPT_EXCLUSIVE_AREA_61], implemented-entry=Gpt_EnableNotification
        Gpt_EnableWakeup: implemented-entry=Gpt_EnableWakeup
        Gpt_GetPredefTimerValue: implemented-entry=Gpt_GetPredefTimerValue
        Gpt_GetTimeElapsed: can-enter-exclusive-area=GPT_EXCLUSIVE_AREA_19, implemented-entry=Gpt_GetTimeElapsed
        Gpt_GetTimeRemaining: can-enter-exclusive-area=GPT_EXCLUSIVE_AREA_19, implemented-entry=Gpt_GetTimeRemaining
        Gpt_GetVersionInfo: implemented-entry=Gpt_GetVersionInfo
        Gpt_Init: can-enter-exclusive-area=[GPT_EXCLUSIVE_AREA_26, GPT_EXCLUSIVE_AREA_40, GPT_EXCLUSIVE_AREA_41, GPT_EXCLUSIVE_AREA_42, GPT_EXCLUSIVE_AREA_43, GPT_EXCLUSIVE_AREA_44, GPT_EXCLUSIVE_AREA_45, GPT_EXCLUSIVE_AREA_50, GPT_EXCLUSIVE_AREA_51, GPT_EXCLUSIVE_AREA_52, GPT_EXCLUSIVE_AREA_53, GPT_EXCLUSIVE_AREA_54, GPT_EXCLUSIVE_AREA_55, GPT_EXCLUSIVE_AREA_60, GPT_EXCLUSIVE_AREA_61, GPT_EXCLUSIVE_AREA_65, GPT_EXCLUSIVE_AREA_66, GPT_EXCLUSIVE_AREA_67], implemented-entry=Gpt_Init
        Gpt_SetClockMode: implemented-entry=Gpt_SetClockMode
        Gpt_SetMode: implemented-entry=Gpt_SetMode
        Gpt_StartTimer: can-enter-exclusive-area=[GPT_EXCLUSIVE_AREA_40, GPT_EXCLUSIVE_AREA_65], implemented-entry=Gpt_StartTimer
        Gpt_StopTimer: can-enter-exclusive-area=[GPT_EXCLUSIVE_AREA_19, GPT_EXCLUSIVE_AREA_40, GPT_EXCLUSIVE_AREA_42], implemented-entry=Gpt_StopTimer
        Lptmr_Gpt_Ip_SetCompareValue: can-enter-exclusive-area=GPT_EXCLUSIVE_AREA_46, implemented-entry=Lptmr_Gpt_Ip_SetCompareValue
      67 x bsw interrupt entity, all with interrupt-category=CAT-2, interrupt-source=Hardware:
        FSS_COSS_FTM_0_CH_{0..5}_ISR: implemented-entry=FSS_COSS_FTM_0_CH_{0..5}_ISR
        FSS_COSS_FTM_1_CH_{0..5}_ISR: implemented-entry=FSS_COSS_FTM_1_CH_{0..5}_ISR
        FSS_COSS_FTM_2_CH_{0..5}_ISR: implemented-entry=FSS_COSS_FTM_2_CH_{0..5}_ISR
        FSS_COSS_FTM_3_CH_{0..5}_ISR: implemented-entry=FSS_COSS_FTM_3_CH_{0..5}_ISR
        FSS_HKI_FTM_0_ISR: implemented-entry=FSS_HKI_FTM_0_ISR
        FSS_HKI_FTM_1_ISR: implemented-entry=FSS_HKI_FTM_1_ISR
        FTM_0_CH_0_CH_1_ISR: implemented-entry=FTM_0_CH_0_CH_1_ISR
        FTM_0_CH_2_CH_3_ISR: implemented-entry=FTM_0_CH_2_CH_3_ISR
        FTM_0_CH_4_CH_5_ISR: implemented-entry=FTM_0_CH_4_CH_5_ISR
        FTM_0_CH_6_CH_7_ISR: implemented-entry=FTM_0_CH_6_CH_7_ISR
        FTM_0_ISR: can-enter-exclusive-area=GPT_EXCLUSIVE_AREA_25, implemented-entry=FTM_0_ISR
        FTM_1_CH_0_CH_1_ISR: implemented-entry=FTM_1_CH_0_CH_1_ISR
        FTM_1_CH_2_CH_3_ISR: implemented-entry=FTM_1_CH_2_CH_3_ISR
        FTM_1_CH_4_CH_5_ISR: implemented-entry=FTM_1_CH_4_CH_5_ISR
        FTM_1_CH_6_CH_7_ISR: implemented-entry=FTM_1_CH_6_CH_7_ISR
        FTM_1_ISR: implemented-entry=FTM_1_ISR
        FTM_2_CH_0_CH_1_ISR: implemented-entry=FTM_2_CH_0_CH_1_ISR
        FTM_2_CH_2_CH_3_ISR: implemented-entry=FTM_2_CH_2_CH_3_ISR
        FTM_2_CH_4_CH_5_ISR: implemented-entry=FTM_2_CH_4_CH_5_ISR
        FTM_2_CH_6_CH_7_ISR: implemented-entry=FTM_2_CH_6_CH_7_ISR
        FTM_3_CH_0_CH_1_ISR: implemented-entry=FTM_3_CH_0_CH_1_ISR
        FTM_3_CH_2_CH_3_ISR: implemented-entry=FTM_3_CH_2_CH_3_ISR
        FTM_3_CH_4_CH_5_ISR: implemented-entry=FTM_3_CH_4_CH_5_ISR
        FTM_3_CH_6_CH_7_ISR: implemented-entry=FTM_3_CH_6_CH_7_ISR
        FTM_4_CH_0_CH_1_ISR: implemented-entry=FTM_4_CH_0_CH_1_ISR
        FTM_4_CH_2_CH_3_ISR: implemented-entry=FTM_4_CH_2_CH_3_ISR
        FTM_4_CH_4_CH_5_ISR: implemented-entry=FTM_4_CH_4_CH_5_ISR
        FTM_4_CH_6_CH_7_ISR: implemented-entry=FTM_4_CH_6_CH_7_ISR
        FTM_5_CH_0_CH_1_ISR: implemented-entry=FTM_5_CH_0_CH_1_ISR
        FTM_5_CH_2_CH_3_ISR: implemented-entry=FTM_5_CH_2_CH_3_ISR
        FTM_5_CH_4_CH_5_ISR: implemented-entry=FTM_5_CH_4_CH_5_ISR
        FTM_5_CH_6_CH_7_ISR: implemented-entry=FTM_5_CH_6_CH_7_ISR
        FTM_6_CH_0_CH_1_ISR: implemented-entry=FTM_6_CH_0_CH_1_ISR
        FTM_6_CH_2_CH_3_ISR: implemented-entry=FTM_6_CH_2_CH_3_ISR
        FTM_6_CH_4_CH_5_ISR: implemented-entry=FTM_6_CH_4_CH_5_ISR
        FTM_6_CH_6_CH_7_ISR: implemented-entry=FTM_6_CH_6_CH_7_ISR
        FTM_7_CH_0_CH_1_ISR: implemented-entry=FTM_7_CH_0_CH_1_ISR
        FTM_7_CH_2_CH_3_ISR: implemented-entry=FTM_7_CH_2_CH_3_ISR
        FTM_7_CH_4_CH_5_ISR: implemented-entry=FTM_7_CH_4_CH_5_ISR
        FTM_7_CH_6_CH_7_ISR: implemented-entry=FTM_7_CH_6_CH_7_ISR
        LPIT_0_CH_{0..3}_ISR: implemented-entry=LPIT_0_CH_{0..3}_ISR
        LPIT_0_ISR: implemented-entry=LPIT_0_ISR
        LPTMR_0_CH_0_ISR: implemented-entry=LPTMR_0_CH_0_ISR
        SRTC_0_Ch_0_ISR: implemented-entry=SRTC_0_Ch_0_ISR
package /AUTOSAR_Gpt/BswModuleEntrys
  87 x bsw module entry, all with is-synchronous=true, sw-service-impl-policy=STANDARD:
    Ftm_Gpt_Ip_StartTimer: service-id=0x29, is-reentrant=true, call-type=REGULAR, execution-context=UNSPECIFIED
    Gpt_ChangeNextTimeoutValue: service-id=0x0f, is-reentrant=true, call-type=REGULAR, execution-context=UNSPECIFIED
    Gpt_Channel_DisableChainMode: service-id=0x22, is-reentrant=true, call-type=REGULAR, execution-context=UNSPECIFIED
    Gpt_Channel_EnableChainMode: service-id=0x21, is-reentrant=true, call-type=REGULAR, execution-context=UNSPECIFIED
    Gpt_CheckWakeup: service-id=0x0c, is-reentrant=true, call-type=REGULAR, execution-context=UNSPECIFIED
    Gpt_DeInit: service-id=0x02, is-reentrant=false, call-type=REGULAR, execution-context=UNSPECIFIED
    Gpt_DisableNotification: service-id=0x08, is-reentrant=false, call-type=REGULAR, execution-context=UNSPECIFIED
    Gpt_DisableWakeup: service-id=0x0a, is-reentrant=false, call-type=REGULAR, execution-context=UNSPECIFIED
    Gpt_EnableNotification: service-id=0x07, is-reentrant=false, call-type=REGULAR, execution-context=UNSPECIFIED
    Gpt_EnableWakeup: service-id=0x0b, is-reentrant=false, call-type=REGULAR, execution-context=UNSPECIFIED
    Gpt_GetPredefTimerValue: service-id=0x0d, is-reentrant=true, call-type=REGULAR, execution-context=UNSPECIFIED
    Gpt_GetTimeElapsed: service-id=0x03, is-reentrant=true, call-type=REGULAR, execution-context=UNSPECIFIED
    Gpt_GetTimeRemaining: service-id=0x04, is-reentrant=true, call-type=REGULAR, execution-context=UNSPECIFIED
    Gpt_GetVersionInfo: service-id=0x00, is-reentrant=true, call-type=REGULAR, execution-context=UNSPECIFIED
    Gpt_Init: service-id=0x01, is-reentrant=false, call-type=REGULAR, execution-context=UNSPECIFIED
    Gpt_SetClockMode: service-id=0x10, is-reentrant=false, call-type=REGULAR, execution-context=UNSPECIFIED
    Gpt_SetMode: service-id=0x09, is-reentrant=false, call-type=REGULAR, execution-context=UNSPECIFIED
    Gpt_StartTimer: service-id=0x05, is-reentrant=false, call-type=REGULAR, execution-context=UNSPECIFIED
    Gpt_StopTimer: service-id=0x06, is-reentrant=false, call-type=REGULAR, execution-context=UNSPECIFIED
    Lptmr_Gpt_Ip_SetCompareValue: service-id=0x23, is-reentrant=true, call-type=REGULAR, execution-context=UNSPECIFIED
    FSS_COSS_FTM_0_CH_{0..5}_ISR: service-id=0, is-reentrant=false, call-type=INTERRUPT, execution-context=INTERRUPT-CAT-2
    FSS_COSS_FTM_1_CH_{0..5}_ISR: service-id=0, is-reentrant=false, call-type=INTERRUPT, execution-context=INTERRUPT-CAT-2
    FSS_COSS_FTM_2_CH_{0..5}_ISR: service-id=0, is-reentrant=false, call-type=INTERRUPT, execution-context=INTERRUPT-CAT-2
    FSS_COSS_FTM_3_CH_{0..5}_ISR: service-id=0, is-reentrant=false, call-type=INTERRUPT, execution-context=INTERRUPT-CAT-2
    FSS_HKI_FTM_0_ISR: service-id=0, is-reentrant=false, call-type=INTERRUPT, execution-context=INTERRUPT-CAT-2
    FSS_HKI_FTM_1_ISR: service-id=0, is-reentrant=false, call-type=INTERRUPT, execution-context=INTERRUPT-CAT-2
    FTM_0_CH_0_CH_1_ISR: service-id=0, is-reentrant=false, call-type=INTERRUPT, execution-context=INTERRUPT-CAT-2
    FTM_0_CH_2_CH_3_ISR: service-id=0, is-reentrant=false, call-type=INTERRUPT, execution-context=INTERRUPT-CAT-2
    FTM_0_CH_4_CH_5_ISR: service-id=0, is-reentrant=false, call-type=INTERRUPT, execution-context=INTERRUPT-CAT-2
    FTM_0_CH_6_CH_7_ISR: service-id=0, is-reentrant=false, call-type=INTERRUPT, execution-context=INTERRUPT-CAT-2
    FTM_0_ISR: service-id=0, is-reentrant=false, call-type=INTERRUPT, execution-context=INTERRUPT-CAT-2
    FTM_1_CH_0_CH_1_ISR: service-id=0, is-reentrant=false, call-type=INTERRUPT, execution-context=INTERRUPT-CAT-2
    FTM_1_CH_2_CH_3_ISR: service-id=0, is-reentrant=false, call-type=INTERRUPT, execution-context=INTERRUPT-CAT-2
    FTM_1_CH_4_CH_5_ISR: service-id=0, is-reentrant=false, call-type=INTERRUPT, execution-context=INTERRUPT-CAT-2
    FTM_1_CH_6_CH_7_ISR: service-id=0, is-reentrant=false, call-type=INTERRUPT, execution-context=INTERRUPT-CAT-2
    FTM_1_ISR: service-id=0, is-reentrant=false, call-type=INTERRUPT, execution-context=INTERRUPT-CAT-2
    FTM_2_CH_0_CH_1_ISR: service-id=0, is-reentrant=false, call-type=INTERRUPT, execution-context=INTERRUPT-CAT-2
    FTM_2_CH_2_CH_3_ISR: service-id=0, is-reentrant=false, call-type=INTERRUPT, execution-context=INTERRUPT-CAT-2
    FTM_2_CH_4_CH_5_ISR: service-id=0, is-reentrant=false, call-type=INTERRUPT, execution-context=INTERRUPT-CAT-2
    FTM_2_CH_6_CH_7_ISR: service-id=0, is-reentrant=false, call-type=INTERRUPT, execution-context=INTERRUPT-CAT-2
    FTM_3_CH_0_CH_1_ISR: service-id=0, is-reentrant=false, call-type=INTERRUPT, execution-context=INTERRUPT-CAT-2
    FTM_3_CH_2_CH_3_ISR: service-id=0, is-reentrant=false, call-type=INTERRUPT, execution-context=INTERRUPT-CAT-2
    FTM_3_CH_4_CH_5_ISR: service-id=0, is-reentrant=false, call-type=INTERRUPT, execution-context=INTERRUPT-CAT-2
    FTM_3_CH_6_CH_7_ISR: service-id=0, is-reentrant=false, call-type=INTERRUPT, execution-context=INTERRUPT-CAT-2
    FTM_4_CH_0_CH_1_ISR: service-id=0, is-reentrant=false, call-type=INTERRUPT, execution-context=INTERRUPT-CAT-2
    FTM_4_CH_2_CH_3_ISR: service-id=0, is-reentrant=false, call-type=INTERRUPT, execution-context=INTERRUPT-CAT-2
    FTM_4_CH_4_CH_5_ISR: service-id=0, is-reentrant=false, call-type=INTERRUPT, execution-context=INTERRUPT-CAT-2
    FTM_4_CH_6_CH_7_ISR: service-id=0, is-reentrant=false, call-type=INTERRUPT, execution-context=INTERRUPT-CAT-2
    FTM_5_CH_0_CH_1_ISR: service-id=0, is-reentrant=false, call-type=INTERRUPT, execution-context=INTERRUPT-CAT-2
    FTM_5_CH_2_CH_3_ISR: service-id=0, is-reentrant=false, call-type=INTERRUPT, execution-context=INTERRUPT-CAT-2
    FTM_5_CH_4_CH_5_ISR: service-id=0, is-reentrant=false, call-type=INTERRUPT, execution-context=INTERRUPT-CAT-2
    FTM_5_CH_6_CH_7_ISR: service-id=0, is-reentrant=false, call-type=INTERRUPT, execution-context=INTERRUPT-CAT-2
    FTM_6_CH_0_CH_1_ISR: service-id=0, is-reentrant=false, call-type=INTERRUPT, execution-context=INTERRUPT-CAT-2
    FTM_6_CH_2_CH_3_ISR: service-id=0, is-reentrant=false, call-type=INTERRUPT, execution-context=INTERRUPT-CAT-2
    FTM_6_CH_4_CH_5_ISR: service-id=0, is-reentrant=false, call-type=INTERRUPT, execution-context=INTERRUPT-CAT-2
    FTM_6_CH_6_CH_7_ISR: service-id=0, is-reentrant=false, call-type=INTERRUPT, execution-context=INTERRUPT-CAT-2
    FTM_7_CH_0_CH_1_ISR: service-id=0, is-reentrant=false, call-type=INTERRUPT, execution-context=INTERRUPT-CAT-2
    FTM_7_CH_2_CH_3_ISR: service-id=0, is-reentrant=false, call-type=INTERRUPT, execution-context=INTERRUPT-CAT-2
    FTM_7_CH_4_CH_5_ISR: service-id=0, is-reentrant=false, call-type=INTERRUPT, execution-context=INTERRUPT-CAT-2
    FTM_7_CH_6_CH_7_ISR: service-id=0, is-reentrant=false, call-type=INTERRUPT, execution-context=INTERRUPT-CAT-2
    LPIT_0_CH_{0..3}_ISR: service-id=0, is-reentrant=false, call-type=INTERRUPT, execution-context=INTERRUPT-CAT-2
    LPIT_0_ISR: service-id=0, is-reentrant=false, call-type=INTERRUPT, execution-context=INTERRUPT-CAT-2
    LPTMR_0_CH_0_ISR: service-id=0, is-reentrant=false, call-type=INTERRUPT, execution-context=INTERRUPT-CAT-2
    SRTC_0_Ch_0_ISR: service-id=0, is-reentrant=false, call-type=INTERRUPT, execution-context=INTERRUPT-CAT-2
package /Gpt_TS_T40D2M30I0R0/Implementations
  bsw implementation BswImplementation_0: programming-language=C, sw-version=3.0.0_QLP02, vendor-id=43, ar-release-version=4.7.0, behavior=InternalBehavior_0, vendor-specific-module-def=Gpt
    code-descriptors:
      code Files
        artifact-descriptors:
          short-label=config::Gpt.xdm, category=SWCFG
          short-label=doc::RTD_GPT_IM.pdf, category=SWDOC
          short-label=doc::RTD_GPT_UM.pdf, category=SWDOC
          short-label=examples::EBT::S32K1::Gpt_example_S32K118::generate::epc::BaseNXP.xdm, category=SWCFG
          short-label=examples::EBT::S32K1::Gpt_example_S32K118::generate::epc::Dem.xdm, category=SWCFG
          short-label=examples::EBT::S32K1::Gpt_example_S32K118::generate::epc::Dio.xdm, category=SWCFG
          short-label=examples::EBT::S32K1::Gpt_example_S32K118::generate::epc::Gpt.xdm, category=SWCFG
          short-label=examples::EBT::S32K1::Gpt_example_S32K118::generate::epc::Mcu.xdm, category=SWCFG
          short-label=examples::EBT::S32K1::Gpt_example_S32K118::generate::epc::Platform.xdm, category=SWCFG
          short-label=examples::EBT::S32K1::Gpt_example_S32K118::generate::epc::Port.xdm, category=SWCFG
          short-label=examples::EBT::S32K1::Gpt_example_S32K118::generate::epc::Resource.xdm, category=SWCFG
          short-label=examples::EBT::S32K1::Gpt_example_S32K118::include::check_example.h, category=SWHDR
          short-label=examples::EBT::S32K1::Gpt_example_S32K118::src::main.c, category=SWSRC
          short-label=examples::EBT::S32K1::Gpt_example_S32K118::TresosProject::Gpt_example_S32K118::.prefs::preferences.xdm, category=SWCFG
          short-label=examples::EBT::S32K1::Gpt_example_S32K118::TresosProject::Gpt_example_S32K118::config::BaseNXP.xdm, category=SWCFG
          short-label=examples::EBT::S32K1::Gpt_example_S32K118::TresosProject::Gpt_example_S32K118::config::Dem.xdm, category=SWCFG
          short-label=examples::EBT::S32K1::Gpt_example_S32K118::TresosProject::Gpt_example_S32K118::config::Dio.xdm, category=SWCFG
          short-label=examples::EBT::S32K1::Gpt_example_S32K118::TresosProject::Gpt_example_S32K118::config::EcuC.xdm, category=SWCFG
          short-label=examples::EBT::S32K1::Gpt_example_S32K118::TresosProject::Gpt_example_S32K118::config::Gpt.xdm, category=SWCFG
          short-label=examples::EBT::S32K1::Gpt_example_S32K118::TresosProject::Gpt_example_S32K118::config::Mcu.xdm, category=SWCFG
          short-label=examples::EBT::S32K1::Gpt_example_S32K118::TresosProject::Gpt_example_S32K118::config::Platform.xdm, category=SWCFG
          short-label=examples::EBT::S32K1::Gpt_example_S32K118::TresosProject::Gpt_example_S32K118::config::Port.xdm, category=SWCFG
          short-label=examples::EBT::S32K1::Gpt_example_S32K118::TresosProject::Gpt_example_S32K118::config::Resource.xdm, category=SWCFG
          short-label=examples::EBT::S32K1::Gpt_example_S32K144::generate::epc::BaseNXP.xdm, category=SWCFG
          short-label=examples::EBT::S32K1::Gpt_example_S32K144::generate::epc::Dem.xdm, category=SWCFG
          short-label=examples::EBT::S32K1::Gpt_example_S32K144::generate::epc::Dio.xdm, category=SWCFG
          short-label=examples::EBT::S32K1::Gpt_example_S32K144::generate::epc::Gpt.xdm, category=SWCFG
          short-label=examples::EBT::S32K1::Gpt_example_S32K144::generate::epc::Mcu.xdm, category=SWCFG
          short-label=examples::EBT::S32K1::Gpt_example_S32K144::generate::epc::Platform.xdm, category=SWCFG
          short-label=examples::EBT::S32K1::Gpt_example_S32K144::generate::epc::Port.xdm, category=SWCFG
          short-label=examples::EBT::S32K1::Gpt_example_S32K144::generate::epc::Resource.xdm, category=SWCFG
          short-label=examples::EBT::S32K1::Gpt_example_S32K144::include::check_example.h, category=SWHDR
          short-label=examples::EBT::S32K1::Gpt_example_S32K144::src::main.c, category=SWSRC
          short-label=examples::EBT::S32K1::Gpt_example_S32K144::TresosProject::Gpt_example_S32K144::.prefs::preferences.xdm, category=SWCFG
          short-label=examples::EBT::S32K1::Gpt_example_S32K144::TresosProject::Gpt_example_S32K144::config::BaseNXP.xdm, category=SWCFG
          short-label=examples::EBT::S32K1::Gpt_example_S32K144::TresosProject::Gpt_example_S32K144::config::Dem.xdm, category=SWCFG
          short-label=examples::EBT::S32K1::Gpt_example_S32K144::TresosProject::Gpt_example_S32K144::config::Dio.xdm, category=SWCFG
          short-label=examples::EBT::S32K1::Gpt_example_S32K144::TresosProject::Gpt_example_S32K144::config::EcuC.xdm, category=SWCFG
          short-label=examples::EBT::S32K1::Gpt_example_S32K144::TresosProject::Gpt_example_S32K144::config::Gpt.xdm, category=SWCFG
          short-label=examples::EBT::S32K1::Gpt_example_S32K144::TresosProject::Gpt_example_S32K144::config::Mcu.xdm, category=SWCFG
          short-label=examples::EBT::S32K1::Gpt_example_S32K144::TresosProject::Gpt_example_S32K144::config::Platform.xdm, category=SWCFG
          short-label=examples::EBT::S32K1::Gpt_example_S32K144::TresosProject::Gpt_example_S32K144::config::Port.xdm, category=SWCFG
          short-label=examples::EBT::S32K1::Gpt_example_S32K144::TresosProject::Gpt_example_S32K144::config::Resource.xdm, category=SWCFG
          short-label=examples::EBT::S32K1::Gpt_example_S32K144W::generate::epc::BaseNXP.xdm, category=SWCFG
          short-label=examples::EBT::S32K1::Gpt_example_S32K144W::generate::epc::Dem.xdm, category=SWCFG
          short-label=examples::EBT::S32K1::Gpt_example_S32K144W::generate::epc::Dio.xdm, category=SWCFG
          short-label=examples::EBT::S32K1::Gpt_example_S32K144W::generate::epc::Gpt.xdm, category=SWCFG
          short-label=examples::EBT::S32K1::Gpt_example_S32K144W::generate::epc::Mcu.xdm, category=SWCFG
          short-label=examples::EBT::S32K1::Gpt_example_S32K144W::generate::epc::Platform.xdm, category=SWCFG
          short-label=examples::EBT::S32K1::Gpt_example_S32K144W::generate::epc::Port.xdm, category=SWCFG
          short-label=examples::EBT::S32K1::Gpt_example_S32K144W::generate::epc::Resource.xdm, category=SWCFG
          short-label=examples::EBT::S32K1::Gpt_example_S32K144W::include::check_example.h, category=SWHDR
          short-label=examples::EBT::S32K1::Gpt_example_S32K144W::src::main.c, category=SWSRC
          short-label=examples::EBT::S32K1::Gpt_example_S32K144W::TresosProject::Gpt_example_S32K144W::.prefs::preferences.xdm, category=SWCFG
          short-label=examples::EBT::S32K1::Gpt_example_S32K144W::TresosProject::Gpt_example_S32K144W::config::BaseNXP.xdm, category=SWCFG
          short-label=examples::EBT::S32K1::Gpt_example_S32K144W::TresosProject::Gpt_example_S32K144W::config::Dem.xdm, category=SWCFG
          short-label=examples::EBT::S32K1::Gpt_example_S32K144W::TresosProject::Gpt_example_S32K144W::config::Dio.xdm, category=SWCFG
          short-label=examples::EBT::S32K1::Gpt_example_S32K144W::TresosProject::Gpt_example_S32K144W::config::EcuC.xdm, category=SWCFG
          short-label=examples::EBT::S32K1::Gpt_example_S32K144W::TresosProject::Gpt_example_S32K144W::config::Gpt.xdm, category=SWCFG
          short-label=examples::EBT::S32K1::Gpt_example_S32K144W::TresosProject::Gpt_example_S32K144W::config::Mcu.xdm, category=SWCFG
          short-label=examples::EBT::S32K1::Gpt_example_S32K144W::TresosProject::Gpt_example_S32K144W::config::Platform.xdm, category=SWCFG
          short-label=examples::EBT::S32K1::Gpt_example_S32K144W::TresosProject::Gpt_example_S32K144W::config::Port.xdm, category=SWCFG
          short-label=examples::EBT::S32K1::Gpt_example_S32K144W::TresosProject::Gpt_example_S32K144W::config::Resource.xdm, category=SWCFG
          short-label=examples::EBT::S32K1::Gpt_example_S32K148::generate::epc::BaseNXP.xdm, category=SWCFG
          short-label=examples::EBT::S32K1::Gpt_example_S32K148::generate::epc::Dem.xdm, category=SWCFG
          short-label=examples::EBT::S32K1::Gpt_example_S32K148::generate::epc::Dio.xdm, category=SWCFG
          short-label=examples::EBT::S32K1::Gpt_example_S32K148::generate::epc::Gpt.xdm, category=SWCFG
          short-label=examples::EBT::S32K1::Gpt_example_S32K148::generate::epc::Mcu.xdm, category=SWCFG
          short-label=examples::EBT::S32K1::Gpt_example_S32K148::generate::epc::Platform.xdm, category=SWCFG
          short-label=examples::EBT::S32K1::Gpt_example_S32K148::generate::epc::Port.xdm, category=SWCFG
          short-label=examples::EBT::S32K1::Gpt_example_S32K148::generate::epc::Resource.xdm, category=SWCFG
          short-label=examples::EBT::S32K1::Gpt_example_S32K148::include::check_example.h, category=SWHDR
          short-label=examples::EBT::S32K1::Gpt_example_S32K148::src::main.c, category=SWSRC
          short-label=examples::EBT::S32K1::Gpt_example_S32K148::TresosProject::Gpt_example_S32K148::.prefs::preferences.xdm, category=SWCFG
          short-label=examples::EBT::S32K1::Gpt_example_S32K148::TresosProject::Gpt_example_S32K148::config::BaseNXP.xdm, category=SWCFG
          short-label=examples::EBT::S32K1::Gpt_example_S32K148::TresosProject::Gpt_example_S32K148::config::Dem.xdm, category=SWCFG
          short-label=examples::EBT::S32K1::Gpt_example_S32K148::TresosProject::Gpt_example_S32K148::config::Dio.xdm, category=SWCFG
          short-label=examples::EBT::S32K1::Gpt_example_S32K148::TresosProject::Gpt_example_S32K148::config::EcuC.xdm, category=SWCFG
          short-label=examples::EBT::S32K1::Gpt_example_S32K148::TresosProject::Gpt_example_S32K148::config::Gpt.xdm, category=SWCFG
          short-label=examples::EBT::S32K1::Gpt_example_S32K148::TresosProject::Gpt_example_S32K148::config::Mcu.xdm, category=SWCFG
          short-label=examples::EBT::S32K1::Gpt_example_S32K148::TresosProject::Gpt_example_S32K148::config::Platform.xdm, category=SWCFG
          short-label=examples::EBT::S32K1::Gpt_example_S32K148::TresosProject::Gpt_example_S32K148::config::Port.xdm, category=SWCFG
          short-label=examples::EBT::S32K1::Gpt_example_S32K148::TresosProject::Gpt_example_S32K148::config::Resource.xdm, category=SWCFG
          short-label=examples::S32DS::S32K1::Ftm_Gpt_Example_S32K118::include::check_example.h, category=SWHDR
          short-label=examples::S32DS::S32K1::Ftm_Gpt_Example_S32K118::Project_Settings::Startup_Code::exceptions.c, category=SWSRC
          short-label=examples::S32DS::S32K1::Ftm_Gpt_Example_S32K118::Project_Settings::Startup_Code::nvic.c, category=SWSRC
          short-label=examples::S32DS::S32K1::Ftm_Gpt_Example_S32K118::Project_Settings::Startup_Code::startup.c, category=SWSRC
          short-label=examples::S32DS::S32K1::Ftm_Gpt_Example_S32K118::Project_Settings::Startup_Code::system.c, category=SWSRC
          short-label=examples::S32DS::S32K1::Ftm_Gpt_Example_S32K118::src::main.c, category=SWSRC
          short-label=examples::S32DS::S32K1::Ftm_Gpt_Example_S32K144::include::check_example.h, category=SWHDR
          short-label=examples::S32DS::S32K1::Ftm_Gpt_Example_S32K144::Project_Settings::Startup_Code::exceptions.c, category=SWSRC
          short-label=examples::S32DS::S32K1::Ftm_Gpt_Example_S32K144::Project_Settings::Startup_Code::nvic.c, category=SWSRC
          short-label=examples::S32DS::S32K1::Ftm_Gpt_Example_S32K144::Project_Settings::Startup_Code::startup.c, category=SWSRC
          short-label=examples::S32DS::S32K1::Ftm_Gpt_Example_S32K144::Project_Settings::Startup_Code::system.c, category=SWSRC
          short-label=examples::S32DS::S32K1::Ftm_Gpt_Example_S32K144::src::main.c, category=SWSRC
          short-label=examples::S32DS::S32K1::Ftm_Gpt_Example_S32K144W::include::check_example.h, category=SWHDR
          short-label=examples::S32DS::S32K1::Ftm_Gpt_Example_S32K144W::Project_Settings::Startup_Code::exceptions.c, category=SWSRC
          short-label=examples::S32DS::S32K1::Ftm_Gpt_Example_S32K144W::Project_Settings::Startup_Code::nvic.c, category=SWSRC
          short-label=examples::S32DS::S32K1::Ftm_Gpt_Example_S32K144W::Project_Settings::Startup_Code::startup.c, category=SWSRC
          short-label=examples::S32DS::S32K1::Ftm_Gpt_Example_S32K144W::Project_Settings::Startup_Code::system.c, category=SWSRC
          short-label=examples::S32DS::S32K1::Ftm_Gpt_Example_S32K144W::src::main.c, category=SWSRC
          short-label=examples::S32DS::S32K1::Ftm_Gpt_Example_S32K148::include::check_example.h, category=SWHDR
          short-label=examples::S32DS::S32K1::Ftm_Gpt_Example_S32K148::Project_Settings::Startup_Code::exceptions.c, category=SWSRC
          short-label=examples::S32DS::S32K1::Ftm_Gpt_Example_S32K148::Project_Settings::Startup_Code::nvic.c, category=SWSRC
          short-label=examples::S32DS::S32K1::Ftm_Gpt_Example_S32K148::Project_Settings::Startup_Code::startup.c, category=SWSRC
          short-label=examples::S32DS::S32K1::Ftm_Gpt_Example_S32K148::Project_Settings::Startup_Code::system.c, category=SWSRC
          short-label=examples::S32DS::S32K1::Ftm_Gpt_Example_S32K148::src::main.c, category=SWSRC
          short-label=examples::S32DS::S32K1::Gpt_example_S32K118::include::check_example.h, category=SWHDR
          short-label=examples::S32DS::S32K1::Gpt_example_S32K118::Project_Settings::Startup_Code::exceptions.c, category=SWSRC
          short-label=examples::S32DS::S32K1::Gpt_example_S32K118::Project_Settings::Startup_Code::nvic.c, category=SWSRC
          short-label=examples::S32DS::S32K1::Gpt_example_S32K118::Project_Settings::Startup_Code::startup.c, category=SWSRC
          short-label=examples::S32DS::S32K1::Gpt_example_S32K118::Project_Settings::Startup_Code::system.c, category=SWSRC
          short-label=examples::S32DS::S32K1::Gpt_example_S32K118::src::main.c, category=SWSRC
          short-label=examples::S32DS::S32K1::Gpt_example_S32K144::include::check_example.h, category=SWHDR
          short-label=examples::S32DS::S32K1::Gpt_example_S32K144::Project_Settings::Startup_Code::exceptions.c, category=SWSRC
          short-label=examples::S32DS::S32K1::Gpt_example_S32K144::Project_Settings::Startup_Code::nvic.c, category=SWSRC
          short-label=examples::S32DS::S32K1::Gpt_example_S32K144::Project_Settings::Startup_Code::startup.c, category=SWSRC
          short-label=examples::S32DS::S32K1::Gpt_example_S32K144::Project_Settings::Startup_Code::system.c, category=SWSRC
          short-label=examples::S32DS::S32K1::Gpt_example_S32K144::src::main.c, category=SWSRC
          short-label=examples::S32DS::S32K1::Gpt_example_S32K144W::include::check_example.h, category=SWHDR
          short-label=examples::S32DS::S32K1::Gpt_example_S32K144W::Project_Settings::Startup_Code::exceptions.c, category=SWSRC
          short-label=examples::S32DS::S32K1::Gpt_example_S32K144W::Project_Settings::Startup_Code::nvic.c, category=SWSRC
          short-label=examples::S32DS::S32K1::Gpt_example_S32K144W::Project_Settings::Startup_Code::startup.c, category=SWSRC
          short-label=examples::S32DS::S32K1::Gpt_example_S32K144W::Project_Settings::Startup_Code::system.c, category=SWSRC
          short-label=examples::S32DS::S32K1::Gpt_example_S32K144W::src::main.c, category=SWSRC
          short-label=examples::S32DS::S32K1::Gpt_example_S32K148::include::check_example.h, category=SWHDR
          short-label=examples::S32DS::S32K1::Gpt_example_S32K148::Project_Settings::Startup_Code::exceptions.c, category=SWSRC
          short-label=examples::S32DS::S32K1::Gpt_example_S32K148::Project_Settings::Startup_Code::nvic.c, category=SWSRC
          short-label=examples::S32DS::S32K1::Gpt_example_S32K148::Project_Settings::Startup_Code::startup.c, category=SWSRC
          short-label=examples::S32DS::S32K1::Gpt_example_S32K148::Project_Settings::Startup_Code::system.c, category=SWSRC
          short-label=examples::S32DS::S32K1::Gpt_example_S32K148::src::main.c, category=SWSRC
          short-label=examples::S32DS::S32K1::Lpit_Gpt_Example_S32K118::include::check_example.h, category=SWHDR
          short-label=examples::S32DS::S32K1::Lpit_Gpt_Example_S32K118::Project_Settings::Startup_Code::exceptions.c, category=SWSRC
          short-label=examples::S32DS::S32K1::Lpit_Gpt_Example_S32K118::Project_Settings::Startup_Code::nvic.c, category=SWSRC
          short-label=examples::S32DS::S32K1::Lpit_Gpt_Example_S32K118::Project_Settings::Startup_Code::startup.c, category=SWSRC
          short-label=examples::S32DS::S32K1::Lpit_Gpt_Example_S32K118::Project_Settings::Startup_Code::system.c, category=SWSRC
          short-label=examples::S32DS::S32K1::Lpit_Gpt_Example_S32K118::src::main.c, category=SWSRC
          short-label=examples::S32DS::S32K1::Lpit_Gpt_Example_S32K144::include::check_example.h, category=SWHDR
          short-label=examples::S32DS::S32K1::Lpit_Gpt_Example_S32K144::Project_Settings::Startup_Code::exceptions.c, category=SWSRC
          short-label=examples::S32DS::S32K1::Lpit_Gpt_Example_S32K144::Project_Settings::Startup_Code::nvic.c, category=SWSRC
          short-label=examples::S32DS::S32K1::Lpit_Gpt_Example_S32K144::Project_Settings::Startup_Code::startup.c, category=SWSRC
          short-label=examples::S32DS::S32K1::Lpit_Gpt_Example_S32K144::Project_Settings::Startup_Code::system.c, category=SWSRC
          short-label=examples::S32DS::S32K1::Lpit_Gpt_Example_S32K144::src::main.c, category=SWSRC
          short-label=examples::S32DS::S32K1::Lpit_Gpt_Example_S32K144W::include::check_example.h, category=SWHDR
          short-label=examples::S32DS::S32K1::Lpit_Gpt_Example_S32K144W::Project_Settings::Startup_Code::exceptions.c, category=SWSRC
          short-label=examples::S32DS::S32K1::Lpit_Gpt_Example_S32K144W::Project_Settings::Startup_Code::nvic.c, category=SWSRC
          short-label=examples::S32DS::S32K1::Lpit_Gpt_Example_S32K144W::Project_Settings::Startup_Code::startup.c, category=SWSRC
          short-label=examples::S32DS::S32K1::Lpit_Gpt_Example_S32K144W::Project_Settings::Startup_Code::system.c, category=SWSRC
          short-label=examples::S32DS::S32K1::Lpit_Gpt_Example_S32K144W::src::main.c, category=SWSRC
          short-label=examples::S32DS::S32K1::Lpit_Gpt_Example_S32K148::include::check_example.h, category=SWHDR
          short-label=examples::S32DS::S32K1::Lpit_Gpt_Example_S32K148::Project_Settings::Startup_Code::exceptions.c, category=SWSRC
          short-label=examples::S32DS::S32K1::Lpit_Gpt_Example_S32K148::Project_Settings::Startup_Code::nvic.c, category=SWSRC
          short-label=examples::S32DS::S32K1::Lpit_Gpt_Example_S32K148::Project_Settings::Startup_Code::startup.c, category=SWSRC
          short-label=examples::S32DS::S32K1::Lpit_Gpt_Example_S32K148::Project_Settings::Startup_Code::system.c, category=SWSRC
          short-label=examples::S32DS::S32K1::Lpit_Gpt_Example_S32K148::src::main.c, category=SWSRC
          short-label=include::Ftm_Gpt_Ip.h, category=SWHDR
          short-label=include::Ftm_Gpt_Ip_HwAccess.h, category=SWHDR
          short-label=include::Ftm_Gpt_Ip_Irq.h, category=SWHDR
          short-label=include::Ftm_Gpt_Ip_Types.h, category=SWHDR
          short-label=include::Gpt.h, category=SWHDR
          short-label=include::Gpt_EnvCfg.h, category=SWHDR
          short-label=include::Gpt_Ipw.h, category=SWHDR
          short-label=include::Gpt_Ipw_Irq.h, category=SWHDR
          short-label=include::Gpt_Ipw_Types.h, category=SWHDR
          short-label=include::Gpt_Irq.h, category=SWHDR
          short-label=include::LPit_Gpt_Ip.h, category=SWHDR
          short-label=include::LPit_Gpt_Ip_Types.h, category=SWHDR
          short-label=include::Lptmr_Gpt_Ip.h, category=SWHDR
          short-label=include::Lptmr_Gpt_Ip_Types.h, category=SWHDR
          short-label=include::SRtc_Ip.h, category=SWHDR
          short-label=include::SRtc_Ip_TrustedFunctions.h, category=SWHDR
          short-label=include::SRtc_Ip_Types.h, category=SWHDR
          short-label=src::Ftm_Gpt_Ip.c, category=SWSRC
          short-label=src::Ftm_Gpt_Ip_Irq.c, category=SWSRC
          short-label=src::Gpt.c, category=SWSRC
          short-label=src::Gpt_Ipw.c, category=SWSRC
          short-label=src::LPit_Gpt_Ip.c, category=SWSRC
          short-label=src::Lptmr_Gpt_Ip.c, category=SWSRC
          short-label=src::SRtc_Ip.c, category=SWSRC
    compiler GCC_Compiler:
      name=GCC Compiler
      options=-mcpu=cortex-m4 -mcpu=cortex-m0plus -mthumb -mlittle-endian -mfpu=fpv4-sp-d16 -mfloat-abi=hard -mfpu=auto -mfloat-abi=soft -std=c99 -Os -ggdb3 -Wall -Wextra -pedantic -Wstrict-prototypes -Wundef -Wunused -Werror=implicit-function-declaration -Wsign-compare -Wdouble-promotion -fno-short-enums -funsigned-char -funsigned-bitfields -fomit-frame-pointer -fno-common -fstack-usage -fdump-ipa-all -c -DUSE_SW_VECTOR_MODE -DI_CACHE_ENABLE -DENABLE_FPU -DMCAL_ENABLE_USER_MODE_SUPPORT --sysroot=$(NEWLIB_DIR) -specs=nano.specs -specs=nosys.specs
      vendor=GCC Systems
      version=NXP GCC 10.2.0 20200723 (Build 1728 Revision g5963bc8)
    compiler GHS_Compiler:
      name=Green Hills
      options=-cpu=cortexm4 -cpu=cortexm0plus -thumb -fpu=vfpv4_d16 -fsingle -fsoft -C99 --ghstd=last -Osize --gnu_asm -dual_debug -G -keeptempfiles -Wimplicit-int -Wshadow -Wtrigraphs -Wundef --unsigned_chars --unsigned_fields --no_commons --no_exceptions --no_slash_comment --prototype_errors --incorrect_pragma_warnings -c -DUSE_SW_VECTOR_MODE -DI_CACHE_ENABLE -DENABLE_FPU -DMCAL_ENABLE_USER_MODE_SUPPORT
      vendor=Green Hills
      version=Green Hills Multi 7.1.6d / Compiler 2020.1.4
    compiler IAR_Compiler:
      name=IAR Compiler
      options=--cpu=Cortex-M4 --cpu=Cortex-M0+ --cpu_mode=thumb --endian=little --fpu=FPv4-SP --fpu=none -e -Ohz --debug --no_clustering --no_mem_idioms --no_explicit_zero_opt --require_prototypes --no_wrap_diagnostics --diag_suppress=Pa050 -DIAR -DUSE_SW_VECTOR_MODE -DI_CACHE_ENABLE -DENABLE_FPU -DMCAL_ENABLE_USER_MODE_SUPPORT
      vendor=IAR Systems
      version=IAR ANSI C/C++ Compiler V8.40.3.228/W32 for ARM Functional Safety
    generated-artifacts:
      22 x dependency on artifact:
        Ftm_Gpt_Ip_PBcfg_h: artifact-descriptor={short-label=generate_PB::include::Ftm_Gpt_Ip_PBcfg.h, category=SWHDR}, usages=EXECUTE
        Gpt_Ipw_PBcfg_h: artifact-descriptor={short-label=generate_PB::include::Gpt_Ipw_PBcfg.h, category=SWHDR}, usages=EXECUTE
        Gpt_PBcfg_h: artifact-descriptor={short-label=generate_PB::include::Gpt_PBcfg.h, category=SWHDR}, usages=EXECUTE
        LPit_Gpt_Ip_PBcfg_h: artifact-descriptor={short-label=generate_PB::include::LPit_Gpt_Ip_PBcfg.h, category=SWHDR}, usages=EXECUTE
        Lptmr_Gpt_Ip_PBcfg_h: artifact-descriptor={short-label=generate_PB::include::Lptmr_Gpt_Ip_PBcfg.h, category=SWHDR}, usages=EXECUTE
        SRtc_Ip_PBcfg_h: artifact-descriptor={short-label=generate_PB::include::SRtc_Ip_PBcfg.h, category=SWHDR}, usages=EXECUTE
        Ftm_Gpt_Ip_PBcfg_c: artifact-descriptor={short-label=generate_PB::src::Ftm_Gpt_Ip_PBcfg.c, category=SWSRC}, usages=EXECUTE
        Gpt_Ipw_PBcfg_c: artifact-descriptor={short-label=generate_PB::src::Gpt_Ipw_PBcfg.c, category=SWSRC}, usages=EXECUTE
        Gpt_PBcfg_c: artifact-descriptor={short-label=generate_PB::src::Gpt_PBcfg.c, category=SWSRC}, usages=EXECUTE
        LPit_Gpt_Ip_PBcfg_c: artifact-descriptor={short-label=generate_PB::src::LPit_Gpt_Ip_PBcfg.c, category=SWSRC}, usages=EXECUTE
        Lptmr_Gpt_Ip_PBcfg_c: artifact-descriptor={short-label=generate_PB::src::Lptmr_Gpt_Ip_PBcfg.c, category=SWSRC}, usages=EXECUTE
        SRtc_Ip_PBcfg_c: artifact-descriptor={short-label=generate_PB::src::SRtc_Ip_PBcfg.c, category=SWSRC}, usages=EXECUTE
        Ftm_Gpt_Ip_Cfg_h: artifact-descriptor={short-label=generate_PC::include::Ftm_Gpt_Ip_Cfg.h, category=SWHDR}, usages=COMPILE
        Ftm_Gpt_Ip_Cfg_Defines_h: artifact-descriptor={short-label=generate_PC::include::Ftm_Gpt_Ip_Cfg_Defines.h, category=SWHDR}, usages=COMPILE
        Gpt_Cfg_h: artifact-descriptor={short-label=generate_PC::include::Gpt_Cfg.h, category=SWHDR}, usages=COMPILE
        LPit_Gpt_Ip_Cfg_h: artifact-descriptor={short-label=generate_PC::include::LPit_Gpt_Ip_Cfg.h, category=SWHDR}, usages=COMPILE
        LPit_Gpt_Ip_Cfg_Defines_h: artifact-descriptor={short-label=generate_PC::include::LPit_Gpt_Ip_Cfg_Defines.h, category=SWHDR}, usages=COMPILE
        Lptmr_Gpt_Ip_Cfg_h: artifact-descriptor={short-label=generate_PC::include::Lptmr_Gpt_Ip_Cfg.h, category=SWHDR}, usages=COMPILE
        Lptmr_Gpt_Ip_Cfg_Defines_h: artifact-descriptor={short-label=generate_PC::include::Lptmr_Gpt_Ip_Cfg_Defines.h, category=SWHDR}, usages=COMPILE
        SRtc_Ip_Cfg_h: artifact-descriptor={short-label=generate_PC::include::SRtc_Ip_Cfg.h, category=SWHDR}, usages=COMPILE
        SRtc_Ip_Cfg_Defines_h: artifact-descriptor={short-label=generate_PC::include::SRtc_Ip_Cfg_Defines.h, category=SWHDR}, usages=COMPILE
        Gpt_Cfg_c: artifact-descriptor={short-label=generate_PC::src::Gpt_Cfg.c, category=SWSRC}, usages=COMPILE
    linker GCC_Linker: name=GCC Compiler, options=-Wl,-Map,filename -T linkerfile --entry=Reset_Handler -nostartfiles -mcpu=cortex-m4 -mcpu=cortex-m0plus -mthumb -mfpu=fpv4-sp-d16 -mfloat-abi=hard -mfpu=auto -mfloat-abi=soft -mlittle-endian -ggdb3 -lc -lm -lgcc -n --sysroot=$(NEWLIB_DIR) -specs=nano.specs -specs=nosys.specs, vendor=GCC Systems, version=NXP GCC 10.2.0 20200723 (Build 1728 Revision g5963bc8)
    linker GHS_Linker: name=Green Hills, options=-e Reset_Handler -T linker_script_file.ld -map -keepmap -Mn -delete -ignore_debug_references -Llibrary_path -larch -lstartup -lind_sd -lind_sf -v -keep=C40_Ip_AccessCode -nostartfiles, vendor=Green Hills, version=Green Hills Multi 7.1.6d / Compiler 2020.1.4
    linker IAR_Linker: name=IAR Compiler, options=--map filename --config linkerfile --cpu=Cortex-M4 --cpu=Cortex-M0+ --fpu=FPv4-SP --fpu=none --entry _start --enable_stack_usage --skip_dynamic_initialization --no_wrap_diagnostics, vendor=IAR Systems, version=IAR ANSI C/C++ Compiler V8.40.3.228/W32 for ARM Functional Safety
    resource consumption ResourceConsumption
      9 x memory section:
        GPT_CODE: alignment=UNSPECIFIED, sw-addrmethod=CODE, symbol=CODE
        GPT_CONFIG_DATA_UNSPECIFIED: alignment=UNSPECIFIED, sw-addrmethod=CONFIG_DATA, symbol=CONFIG_DATA_UNSPECIFIED
        GPT_CONST_8: alignment=8, sw-addrmethod=CONST, symbol=CONST_8
        GPT_CONST_UNSPECIFIED: alignment=UNSPECIFIED, sw-addrmethod=CONST, symbol=CONST_UNSPECIFIED
        GPT_VAR_CLEARED_32_NO_CACHEABLE: alignment=32, sw-addrmethod=VAR_CLEARED_NO_CACHEABLE, symbol=VAR_CLEARED_32_NO_CACHEABLE
        GPT_VAR_CLEARED_BOOLEAN: alignment=BOOLEAN, sw-addrmethod=VAR_CLEARED, symbol=VAR_CLEARED_BOOLEAN
        GPT_VAR_CLEARED_UNSPECIFIED_NO_CACHEABLE: alignment=UNSPECIFIED, sw-addrmethod=VAR_CLEARED_NO_CACHEABLE, symbol=VAR_CLEARED_UNSPECIFIED_NO_CACHEABLE
        GPT_VAR_INIT_32_NO_CACHEABLE: alignment=32, sw-addrmethod=VAR_INIT_NO_CACHEABLE, symbol=VAR_INIT_32_NO_CACHEABLE
        GPT_VAR_INIT_UNSPECIFIED_NO_CACHEABLE: alignment=UNSPECIFIED, sw-addrmethod=VAR_INIT_NO_CACHEABLE, symbol=VAR_INIT_UNSPECIFIED_NO_CACHEABLE
