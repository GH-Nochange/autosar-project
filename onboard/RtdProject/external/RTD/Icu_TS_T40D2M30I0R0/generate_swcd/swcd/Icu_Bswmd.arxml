AUTOSAR XML (schema 00050)
package /AUTOSAR_Icu/BswModuleDescriptions
  bsw module description Icu: module-id=122
    provided-entrys:
      Icu_CheckWakeup
      Icu_DeInit
      Icu_DisableEdgeCount
      Icu_DisableEdgeDetection
      Icu_DisableNotification
      Icu_DisableWakeup
      Icu_EnableEdgeCount
      Icu_EnableEdgeDetection
      Icu_EnableNotification
      Icu_EnableWakeup
      Icu_GetCaptureRegisterValue
      Icu_GetDutyCycleValues
      Icu_GetEdgeNumbers
      Icu_GetInputLevel
      Icu_GetInputState
      Icu_GetTimeElapsed
      Icu_GetTimestampIndex
      Icu_GetVersionInfo
      Icu_Init
      Icu_ResetEdgeCount
      Icu_SetActivationCondition
      Icu_SetClockMode
      Icu_SetMode
      Icu_StartSignalMeasurement
      Icu_StartTimestamp
      Icu_StopSignalMeasurement
      Icu_StopTimestamp
      Icu_TimestampDmaProcessing
      CMP_{0..2}_ISR
      FTM_0_CH_0_CH_1_ISR
      FTM_0_CH_2_CH_3_ISR
      FTM_0_CH_4_CH_5_ISR
      FTM_0_CH_6_CH_7_ISR
      FTM_0_ISR
      FTM_0_OVF_ISR
      FTM_1_CH_0_CH_1_ISR
      FTM_1_CH_2_CH_3_ISR
      FTM_1_CH_4_CH_5_ISR
      FTM_1_CH_6_CH_7_ISR
      FTM_1_ISR
      FTM_1_OVF_ISR
      FTM_2_CH_0_CH_1_ISR
      FTM_2_CH_2_CH_3_ISR
      FTM_2_CH_4_CH_5_ISR
      FTM_2_CH_6_CH_7_ISR
      FTM_2_OVF_ISR
      FTM_3_CH_0_CH_1_ISR
      FTM_3_CH_2_CH_3_ISR
      FTM_3_CH_4_CH_5_ISR
      FTM_3_CH_6_CH_7_ISR
      FTM_3_OVF_ISR
      FTM_4_CH_0_CH_1_ISR
      FTM_4_CH_2_CH_3_ISR
      FTM_4_CH_4_CH_5_ISR
      FTM_4_CH_6_CH_7_ISR
      FTM_4_OVF_ISR
      FTM_5_CH_0_CH_1_ISR
      FTM_5_CH_2_CH_3_ISR
      FTM_5_CH_4_CH_5_ISR
      FTM_5_CH_6_CH_7_ISR
      FTM_5_OVF_ISR
      FTM_6_CH_0_CH_1_ISR
      FTM_6_CH_2_CH_3_ISR
      FTM_6_CH_4_CH_5_ISR
      FTM_6_CH_6_CH_7_ISR
      FTM_6_OVF_ISR
      FTM_7_CH_0_CH_1_ISR
      FTM_7_CH_2_CH_3_ISR
      FTM_7_CH_4_CH_5_ISR
      FTM_7_CH_6_CH_7_ISR
      FTM_7_OVF_ISR
      ICU_PORT_CI_G_EXT_IRQ_ISR
      ICU_PORT_CI_H_EXT_IRQ_ISR
      ICU_PORT_CI_J_EXT_IRQ_ISR
      ICU_PORT_CI_L_EXT_IRQ_ISR
      LPIT_0_CH_{0..3}_ISR
      LPIT_0_ISR
      LPTMR_0_CH_0_ISR
      PORT_CI_ICU_IP_A_EXT_IRQ_ISR
      PORT_CI_ICU_IP_B_EXT_IRQ_ISR
      PORT_CI_ICU_IP_C_EXT_IRQ_ISR
      PORT_CI_ICU_IP_D_EXT_IRQ_ISR
      PORT_CI_ICU_IP_E_EXT_IRQ_ISR
      PORT_CI_ICU_IP_EXT_IRQ_SINGLE_INTERRUPT
      PORT_CI_ICU_IP_F_EXT_IRQ_ISR
      PORT_CI_ICU_IP_K_EXT_IRQ_ISR
    bsw internal behavior InternalBehavior_0
      22 x exclusive area:
        ICU_EXCLUSIVE_AREA_{00..03}
        ICU_EXCLUSIVE_AREA_08
        ICU_EXCLUSIVE_AREA_{15..30}
        ICU_EXCLUSIVE_AREA_33
      28 x bsw called entity:
        Icu_CheckWakeup: can-enter-exclusive-area=ICU_EXCLUSIVE_AREA_01, implemented-entry=Icu_CheckWakeup
        Icu_DeInit: can-enter-exclusive-area=[ICU_EXCLUSIVE_AREA_17, ICU_EXCLUSIVE_AREA_18], implemented-entry=Icu_DeInit
        Icu_DisableEdgeCount: can-enter-exclusive-area=[ICU_EXCLUSIVE_AREA_01, ICU_EXCLUSIVE_AREA_16, ICU_EXCLUSIVE_AREA_27], implemented-entry=Icu_DisableEdgeCount
        Icu_DisableEdgeDetection: can-enter-exclusive-area=[ICU_EXCLUSIVE_AREA_01, ICU_EXCLUSIVE_AREA_24], implemented-entry=Icu_DisableEdgeDetection
        Icu_DisableNotification: can-enter-exclusive-area=ICU_EXCLUSIVE_AREA_01, implemented-entry=Icu_DisableNotification
        Icu_DisableWakeup: can-enter-exclusive-area=ICU_EXCLUSIVE_AREA_01, implemented-entry=Icu_DisableWakeup
        Icu_EnableEdgeCount: can-enter-exclusive-area=[ICU_EXCLUSIVE_AREA_00, ICU_EXCLUSIVE_AREA_01, ICU_EXCLUSIVE_AREA_15, ICU_EXCLUSIVE_AREA_26], implemented-entry=Icu_EnableEdgeCount
        Icu_EnableEdgeDetection: can-enter-exclusive-area=[ICU_EXCLUSIVE_AREA_00, ICU_EXCLUSIVE_AREA_15, ICU_EXCLUSIVE_AREA_23], implemented-entry=Icu_EnableEdgeDetection
        Icu_EnableNotification: can-enter-exclusive-area=ICU_EXCLUSIVE_AREA_00, implemented-entry=Icu_EnableNotification
        Icu_EnableWakeup: can-enter-exclusive-area=ICU_EXCLUSIVE_AREA_00, implemented-entry=Icu_EnableWakeup
        Icu_GetCaptureRegisterValue: implemented-entry=Icu_GetCaptureRegisterValue
        Icu_GetDutyCycleValues: can-enter-exclusive-area=ICU_EXCLUSIVE_AREA_20, implemented-entry=Icu_GetDutyCycleValues
        Icu_GetEdgeNumbers: can-enter-exclusive-area=ICU_EXCLUSIVE_AREA_20, implemented-entry=Icu_GetEdgeNumbers
        Icu_GetInputLevel: implemented-entry=Icu_GetInputLevel
        Icu_GetInputState: can-enter-exclusive-area=[ICU_EXCLUSIVE_AREA_01, ICU_EXCLUSIVE_AREA_29], implemented-entry=Icu_GetInputState
        Icu_GetTimeElapsed: can-enter-exclusive-area=[ICU_EXCLUSIVE_AREA_01, ICU_EXCLUSIVE_AREA_20], implemented-entry=Icu_GetTimeElapsed
        Icu_GetTimestampIndex: can-enter-exclusive-area=ICU_EXCLUSIVE_AREA_20, implemented-entry=Icu_GetTimestampIndex
        Icu_GetVersionInfo: implemented-entry=Icu_GetVersionInfo
        Icu_Init: can-enter-exclusive-area=ICU_EXCLUSIVE_AREA_17, implemented-entry=Icu_Init
        Icu_ResetEdgeCount: can-enter-exclusive-area=ICU_EXCLUSIVE_AREA_01, implemented-entry=Icu_ResetEdgeCount
        Icu_SetActivationCondition: can-enter-exclusive-area=[ICU_EXCLUSIVE_AREA_01, ICU_EXCLUSIVE_AREA_19], implemented-entry=Icu_SetActivationCondition
        Icu_SetClockMode: implemented-entry=Icu_SetClockMode
        Icu_SetMode: can-enter-exclusive-area=[ICU_EXCLUSIVE_AREA_21, ICU_EXCLUSIVE_AREA_22], implemented-entry=Icu_SetMode
        Icu_StartSignalMeasurement: can-enter-exclusive-area=[ICU_EXCLUSIVE_AREA_00, ICU_EXCLUSIVE_AREA_01, ICU_EXCLUSIVE_AREA_08, ICU_EXCLUSIVE_AREA_15, ICU_EXCLUSIVE_AREA_28], implemented-entry=Icu_StartSignalMeasurement
        Icu_StartTimestamp: can-enter-exclusive-area=[ICU_EXCLUSIVE_AREA_00, ICU_EXCLUSIVE_AREA_01, ICU_EXCLUSIVE_AREA_02, ICU_EXCLUSIVE_AREA_15, ICU_EXCLUSIVE_AREA_25], implemented-entry=Icu_StartTimestamp
        Icu_StopSignalMeasurement: can-enter-exclusive-area=[ICU_EXCLUSIVE_AREA_01, ICU_EXCLUSIVE_AREA_16, ICU_EXCLUSIVE_AREA_30], implemented-entry=Icu_StopSignalMeasurement
        Icu_StopTimestamp: can-enter-exclusive-area=[ICU_EXCLUSIVE_AREA_01, ICU_EXCLUSIVE_AREA_16], implemented-entry=Icu_StopTimestamp
        Icu_TimestampDmaProcessing: implemented-entry=Icu_TimestampDmaProcessing
      63 x bsw interrupt entity, all with interrupt-category=CAT-2, interrupt-source=Hardware:
        CMP_{0..2}_ISR: implemented-entry=CMP_{0..2}_ISR
        FTM_0_CH_0_CH_1_ISR: implemented-entry=FTM_0_CH_0_CH_1_ISR
        FTM_0_CH_2_CH_3_ISR: implemented-entry=FTM_0_CH_2_CH_3_ISR
        FTM_0_CH_4_CH_5_ISR: implemented-entry=FTM_0_CH_4_CH_5_ISR
        FTM_0_CH_6_CH_7_ISR: implemented-entry=FTM_0_CH_6_CH_7_ISR
        FTM_0_ISR: can-enter-exclusive-area=[ICU_EXCLUSIVE_AREA_03, ICU_EXCLUSIVE_AREA_20, ICU_EXCLUSIVE_AREA_33], implemented-entry=FTM_0_ISR
        FTM_0_OVF_ISR: implemented-entry=FTM_0_OVF_ISR
        FTM_1_CH_0_CH_1_ISR: implemented-entry=FTM_1_CH_0_CH_1_ISR
        FTM_1_CH_2_CH_3_ISR: implemented-entry=FTM_1_CH_2_CH_3_ISR
        FTM_1_CH_4_CH_5_ISR: implemented-entry=FTM_1_CH_4_CH_5_ISR
        FTM_1_CH_6_CH_7_ISR: implemented-entry=FTM_1_CH_6_CH_7_ISR
        FTM_1_ISR: can-enter-exclusive-area=[ICU_EXCLUSIVE_AREA_03, ICU_EXCLUSIVE_AREA_20, ICU_EXCLUSIVE_AREA_33], implemented-entry=FTM_1_ISR
        FTM_1_OVF_ISR: implemented-entry=FTM_1_OVF_ISR
        FTM_2_CH_0_CH_1_ISR: implemented-entry=FTM_2_CH_0_CH_1_ISR
        FTM_2_CH_2_CH_3_ISR: implemented-entry=FTM_2_CH_2_CH_3_ISR
        FTM_2_CH_4_CH_5_ISR: implemented-entry=FTM_2_CH_4_CH_5_ISR
        FTM_2_CH_6_CH_7_ISR: implemented-entry=FTM_2_CH_6_CH_7_ISR
        FTM_2_OVF_ISR: implemented-entry=FTM_2_OVF_ISR
        FTM_3_CH_0_CH_1_ISR: implemented-entry=FTM_3_CH_0_CH_1_ISR
        FTM_3_CH_2_CH_3_ISR: implemented-entry=FTM_3_CH_2_CH_3_ISR
        FTM_3_CH_4_CH_5_ISR: implemented-entry=FTM_3_CH_4_CH_5_ISR
        FTM_3_CH_6_CH_7_ISR: implemented-entry=FTM_3_CH_6_CH_7_ISR
        FTM_3_OVF_ISR: implemented-entry=FTM_3_OVF_ISR
        FTM_4_CH_0_CH_1_ISR: implemented-entry=FTM_4_CH_0_CH_1_ISR
        FTM_4_CH_2_CH_3_ISR: implemented-entry=FTM_4_CH_2_CH_3_ISR
        FTM_4_CH_4_CH_5_ISR: implemented-entry=FTM_4_CH_4_CH_5_ISR
        FTM_4_CH_6_CH_7_ISR: implemented-entry=FTM_4_CH_6_CH_7_ISR
        FTM_4_OVF_ISR: implemented-entry=FTM_4_OVF_ISR
        FTM_5_CH_0_CH_1_ISR: implemented-entry=FTM_5_CH_0_CH_1_ISR
        FTM_5_CH_2_CH_3_ISR: implemented-entry=FTM_5_CH_2_CH_3_ISR
        FTM_5_CH_4_CH_5_ISR: implemented-entry=FTM_5_CH_4_CH_5_ISR
        FTM_5_CH_6_CH_7_ISR: implemented-entry=FTM_5_CH_6_CH_7_ISR
        FTM_5_OVF_ISR: implemented-entry=FTM_5_OVF_ISR
        FTM_6_CH_0_CH_1_ISR: implemented-entry=FTM_6_CH_0_CH_1_ISR
        FTM_6_CH_2_CH_3_ISR: implemented-entry=FTM_6_CH_2_CH_3_ISR
        FTM_6_CH_4_CH_5_ISR: implemented-entry=FTM_6_CH_4_CH_5_ISR
        FTM_6_CH_6_CH_7_ISR: implemented-entry=FTM_6_CH_6_CH_7_ISR
        FTM_6_OVF_ISR: implemented-entry=FTM_6_OVF_ISR
        FTM_7_CH_0_CH_1_ISR: implemented-entry=FTM_7_CH_0_CH_1_ISR
        FTM_7_CH_2_CH_3_ISR: implemented-entry=FTM_7_CH_2_CH_3_ISR
        FTM_7_CH_4_CH_5_ISR: implemented-entry=FTM_7_CH_4_CH_5_ISR
        FTM_7_CH_6_CH_7_ISR: implemented-entry=FTM_7_CH_6_CH_7_ISR
        FTM_7_OVF_ISR: implemented-entry=FTM_7_OVF_ISR
        ICU_PORT_CI_G_EXT_IRQ_ISR: implemented-entry=ICU_PORT_CI_G_EXT_IRQ_ISR
        ICU_PORT_CI_H_EXT_IRQ_ISR: implemented-entry=ICU_PORT_CI_H_EXT_IRQ_ISR
        ICU_PORT_CI_J_EXT_IRQ_ISR: implemented-entry=ICU_PORT_CI_J_EXT_IRQ_ISR
        ICU_PORT_CI_L_EXT_IRQ_ISR: implemented-entry=ICU_PORT_CI_L_EXT_IRQ_ISR
        LPIT_0_CH_{0..3}_ISR: implemented-entry=LPIT_0_CH_{0..3}_ISR
        LPIT_0_ISR: implemented-entry=LPIT_0_ISR
        LPTMR_0_CH_0_ISR: implemented-entry=LPTMR_0_CH_0_ISR
        PORT_CI_ICU_IP_A_EXT_IRQ_ISR: implemented-entry=PORT_CI_ICU_IP_A_EXT_IRQ_ISR
        PORT_CI_ICU_IP_B_EXT_IRQ_ISR: implemented-entry=PORT_CI_ICU_IP_B_EXT_IRQ_ISR
        PORT_CI_ICU_IP_C_EXT_IRQ_ISR: implemented-entry=PORT_CI_ICU_IP_C_EXT_IRQ_ISR
        PORT_CI_ICU_IP_D_EXT_IRQ_ISR: implemented-entry=PORT_CI_ICU_IP_D_EXT_IRQ_ISR
        PORT_CI_ICU_IP_E_EXT_IRQ_ISR: implemented-entry=PORT_CI_ICU_IP_E_EXT_IRQ_ISR
        PORT_CI_ICU_IP_EXT_IRQ_SINGLE_INTERRUPT: implemented-entry=PORT_CI_ICU_IP_EXT_IRQ_SINGLE_INTERRUPT
        PORT_CI_ICU_IP_F_EXT_IRQ_ISR: implemented-entry=PORT_CI_ICU_IP_F_EXT_IRQ_ISR
        PORT_CI_ICU_IP_K_EXT_IRQ_ISR: implemented-entry=PORT_CI_ICU_IP_K_EXT_IRQ_ISR
package /AUTOSAR_Icu/BswModuleEntrys
  91 x bsw module entry, all with sw-service-impl-policy=STANDARD:
    Icu_CheckWakeup: service-id=0x15, is-reentrant=false, is-synchronous=true, call-type=REGULAR, execution-context=UNSPECIFIED
    Icu_DeInit: service-id=0x01, is-reentrant=false, is-synchronous=true, call-type=REGULAR, execution-context=UNSPECIFIED
    Icu_DisableEdgeCount: service-id=0x0e, is-reentrant=false, is-synchronous=true, call-type=REGULAR, execution-context=UNSPECIFIED
    Icu_DisableEdgeDetection: service-id=0x17, is-reentrant=false, is-synchronous=true, call-type=REGULAR, execution-context=UNSPECIFIED
    Icu_DisableNotification: service-id=0x06, is-reentrant=false, is-synchronous=true, call-type=REGULAR, execution-context=UNSPECIFIED
    Icu_DisableWakeup: service-id=0x03, is-reentrant=false, is-synchronous=true, call-type=REGULAR, execution-context=UNSPECIFIED
    Icu_EnableEdgeCount: service-id=0x0d, is-reentrant=false, is-synchronous=true, call-type=REGULAR, execution-context=UNSPECIFIED
    Icu_EnableEdgeDetection: service-id=0x16, is-reentrant=false, is-synchronous=true, call-type=REGULAR, execution-context=UNSPECIFIED
    Icu_EnableNotification: service-id=0x07, is-reentrant=false, is-synchronous=true, call-type=REGULAR, execution-context=UNSPECIFIED
    Icu_EnableWakeup: service-id=0x04, is-reentrant=false, is-synchronous=true, call-type=REGULAR, execution-context=UNSPECIFIED
    Icu_GetCaptureRegisterValue: service-id=0x19, is-reentrant=true, is-synchronous=true, call-type=REGULAR, execution-context=UNSPECIFIED
    Icu_GetDutyCycleValues: service-id=0x11, is-reentrant=false, is-synchronous=true, call-type=REGULAR, execution-context=UNSPECIFIED
    Icu_GetEdgeNumbers: service-id=0x0f, is-reentrant=false, is-synchronous=true, call-type=REGULAR, execution-context=UNSPECIFIED
    Icu_GetInputLevel: service-id=0x7c, is-reentrant=true, is-synchronous=true, call-type=REGULAR, execution-context=UNSPECIFIED
    Icu_GetInputState: service-id=0x08, is-reentrant=false, is-synchronous=true, call-type=REGULAR, execution-context=UNSPECIFIED
    Icu_GetTimeElapsed: service-id=0x10, is-reentrant=false, is-synchronous=true, call-type=REGULAR, execution-context=UNSPECIFIED
    Icu_GetTimestampIndex: service-id=0x0b, is-reentrant=false, is-synchronous=true, call-type=REGULAR, execution-context=UNSPECIFIED
    Icu_GetVersionInfo: service-id=0x12, is-reentrant=true, is-synchronous=true, call-type=REGULAR, execution-context=UNSPECIFIED
    Icu_Init: service-id=0x00, is-reentrant=false, is-synchronous=true, call-type=REGULAR, execution-context=UNSPECIFIED
    Icu_ResetEdgeCount: service-id=0x0c, is-reentrant=false, is-synchronous=true, call-type=REGULAR, execution-context=UNSPECIFIED
    Icu_SetActivationCondition: service-id=0x05, is-reentrant=false, is-synchronous=true, call-type=REGULAR, execution-context=UNSPECIFIED
    Icu_SetClockMode: service-id=0x7b, is-reentrant=false, is-synchronous=true, call-type=REGULAR, execution-context=UNSPECIFIED
    Icu_SetMode: service-id=0x02, is-reentrant=false, is-synchronous=true, call-type=REGULAR, execution-context=UNSPECIFIED
    Icu_StartSignalMeasurement: service-id=0x13, is-reentrant=false, is-synchronous=false, call-type=REGULAR, execution-context=UNSPECIFIED
    Icu_StartTimestamp: service-id=0x09, is-reentrant=false, is-synchronous=false, call-type=REGULAR, execution-context=UNSPECIFIED
    Icu_StopSignalMeasurement: service-id=0x14, is-reentrant=false, is-synchronous=true, call-type=REGULAR, execution-context=UNSPECIFIED
    Icu_StopTimestamp: service-id=0x0a, is-reentrant=false, is-synchronous=true, call-type=REGULAR, execution-context=UNSPECIFIED
    Icu_TimestampDmaProcessing: service-id=0x20, is-reentrant=true, is-synchronous=true, call-type=REGULAR, execution-context=UNSPECIFIED
    CMP_{0..2}_ISR: service-id=0, is-reentrant=false, is-synchronous=true, call-type=INTERRUPT, execution-context=INTERRUPT-CAT-2
    FTM_0_CH_0_CH_1_ISR: service-id=0, is-reentrant=false, is-synchronous=true, call-type=INTERRUPT, execution-context=INTERRUPT-CAT-2
    FTM_0_CH_2_CH_3_ISR: service-id=0, is-reentrant=false, is-synchronous=true, call-type=INTERRUPT, execution-context=INTERRUPT-CAT-2
    FTM_0_CH_4_CH_5_ISR: service-id=0, is-reentrant=false, is-synchronous=true, call-type=INTERRUPT, execution-context=INTERRUPT-CAT-2
    FTM_0_CH_6_CH_7_ISR: service-id=0, is-reentrant=false, is-synchronous=true, call-type=INTERRUPT, execution-context=INTERRUPT-CAT-2
    FTM_0_ISR: service-id=0, is-reentrant=false, is-synchronous=true, call-type=INTERRUPT, execution-context=INTERRUPT-CAT-2
    FTM_0_OVF_ISR: service-id=0, is-reentrant=false, is-synchronous=true, call-type=INTERRUPT, execution-context=INTERRUPT-CAT-2
    FTM_1_CH_0_CH_1_ISR: service-id=0, is-reentrant=false, is-synchronous=true, call-type=INTERRUPT, execution-context=INTERRUPT-CAT-2
    FTM_1_CH_2_CH_3_ISR: service-id=0, is-reentrant=false, is-synchronous=true, call-type=INTERRUPT, execution-context=INTERRUPT-CAT-2
    FTM_1_CH_4_CH_5_ISR: service-id=0, is-reentrant=false, is-synchronous=true, call-type=INTERRUPT, execution-context=INTERRUPT-CAT-2
    FTM_1_CH_6_CH_7_ISR: service-id=0, is-reentrant=false, is-synchronous=true, call-type=INTERRUPT, execution-context=INTERRUPT-CAT-2
    FTM_1_ISR: service-id=0, is-reentrant=false, is-synchronous=true, call-type=INTERRUPT, execution-context=INTERRUPT-CAT-2
    FTM_1_OVF_ISR: service-id=0, is-reentrant=false, is-synchronous=true, call-type=INTERRUPT, execution-context=INTERRUPT-CAT-2
    FTM_2_CH_0_CH_1_ISR: service-id=0, is-reentrant=false, is-synchronous=true, call-type=INTERRUPT, execution-context=INTERRUPT-CAT-2
    FTM_2_CH_2_CH_3_ISR: service-id=0, is-reentrant=false, is-synchronous=true, call-type=INTERRUPT, execution-context=INTERRUPT-CAT-2
    FTM_2_CH_4_CH_5_ISR: service-id=0, is-reentrant=false, is-synchronous=true, call-type=INTERRUPT, execution-context=INTERRUPT-CAT-2
    FTM_2_CH_6_CH_7_ISR: service-id=0, is-reentrant=false, is-synchronous=true, call-type=INTERRUPT, execution-context=INTERRUPT-CAT-2
    FTM_2_OVF_ISR: service-id=0, is-reentrant=false, is-synchronous=true, call-type=INTERRUPT, execution-context=INTERRUPT-CAT-2
    FTM_3_CH_0_CH_1_ISR: service-id=0, is-reentrant=false, is-synchronous=true, call-type=INTERRUPT, execution-context=INTERRUPT-CAT-2
    FTM_3_CH_2_CH_3_ISR: service-id=0, is-reentrant=false, is-synchronous=true, call-type=INTERRUPT, execution-context=INTERRUPT-CAT-2
    FTM_3_CH_4_CH_5_ISR: service-id=0, is-reentrant=false, is-synchronous=true, call-type=INTERRUPT, execution-context=INTERRUPT-CAT-2
    FTM_3_CH_6_CH_7_ISR: service-id=0, is-reentrant=false, is-synchronous=true, call-type=INTERRUPT, execution-context=INTERRUPT-CAT-2
    FTM_3_OVF_ISR: service-id=0, is-reentrant=false, is-synchronous=true, call-type=INTERRUPT, execution-context=INTERRUPT-CAT-2
    FTM_4_CH_0_CH_1_ISR: service-id=0, is-reentrant=false, is-synchronous=true, call-type=INTERRUPT, execution-context=INTERRUPT-CAT-2
    FTM_4_CH_2_CH_3_ISR: service-id=0, is-reentrant=false, is-synchronous=true, call-type=INTERRUPT, execution-context=INTERRUPT-CAT-2
    FTM_4_CH_4_CH_5_ISR: service-id=0, is-reentrant=false, is-synchronous=true, call-type=INTERRUPT, execution-context=INTERRUPT-CAT-2
    FTM_4_CH_6_CH_7_ISR: service-id=0, is-reentrant=false, is-synchronous=true, call-type=INTERRUPT, execution-context=INTERRUPT-CAT-2
    FTM_4_OVF_ISR: service-id=0, is-reentrant=false, is-synchronous=true, call-type=INTERRUPT, execution-context=INTERRUPT-CAT-2
    FTM_5_CH_0_CH_1_ISR: service-id=0, is-reentrant=false, is-synchronous=true, call-type=INTERRUPT, execution-context=INTERRUPT-CAT-2
    FTM_5_CH_2_CH_3_ISR: service-id=0, is-reentrant=false, is-synchronous=true, call-type=INTERRUPT, execution-context=INTERRUPT-CAT-2
    FTM_5_CH_4_CH_5_ISR: service-id=0, is-reentrant=false, is-synchronous=true, call-type=INTERRUPT, execution-context=INTERRUPT-CAT-2
    FTM_5_CH_6_CH_7_ISR: service-id=0, is-reentrant=false, is-synchronous=true, call-type=INTERRUPT, execution-context=INTERRUPT-CAT-2
    FTM_5_OVF_ISR: service-id=0, is-reentrant=false, is-synchronous=true, call-type=INTERRUPT, execution-context=INTERRUPT-CAT-2
    FTM_6_CH_0_CH_1_ISR: service-id=0, is-reentrant=false, is-synchronous=true, call-type=INTERRUPT, execution-context=INTERRUPT-CAT-2
    FTM_6_CH_2_CH_3_ISR: service-id=0, is-reentrant=false, is-synchronous=true, call-type=INTERRUPT, execution-context=INTERRUPT-CAT-2
    FTM_6_CH_4_CH_5_ISR: service-id=0, is-reentrant=false, is-synchronous=true, call-type=INTERRUPT, execution-context=INTERRUPT-CAT-2
    FTM_6_CH_6_CH_7_ISR: service-id=0, is-reentrant=false, is-synchronous=true, call-type=INTERRUPT, execution-context=INTERRUPT-CAT-2
    FTM_6_OVF_ISR: service-id=0, is-reentrant=false, is-synchronous=true, call-type=INTERRUPT, execution-context=INTERRUPT-CAT-2
    FTM_7_CH_0_CH_1_ISR: service-id=0, is-reentrant=false, is-synchronous=true, call-type=INTERRUPT, execution-context=INTERRUPT-CAT-2
    FTM_7_CH_2_CH_3_ISR: service-id=0, is-reentrant=false, is-synchronous=true, call-type=INTERRUPT, execution-context=INTERRUPT-CAT-2
    FTM_7_CH_4_CH_5_ISR: service-id=0, is-reentrant=false, is-synchronous=true, call-type=INTERRUPT, execution-context=INTERRUPT-CAT-2
    FTM_7_CH_6_CH_7_ISR: service-id=0, is-reentrant=false, is-synchronous=true, call-type=INTERRUPT, execution-context=INTERRUPT-CAT-2
    FTM_7_OVF_ISR: service-id=0, is-reentrant=false, is-synchronous=true, call-type=INTERRUPT, execution-context=INTERRUPT-CAT-2
    ICU_PORT_CI_G_EXT_IRQ_ISR: service-id=0, is-reentrant=false, is-synchronous=true, call-type=INTERRUPT, execution-context=INTERRUPT-CAT-2
    ICU_PORT_CI_H_EXT_IRQ_ISR: service-id=0, is-reentrant=false, is-synchronous=true, call-type=INTERRUPT, execution-context=INTERRUPT-CAT-2
    ICU_PORT_CI_J_EXT_IRQ_ISR: service-id=0, is-reentrant=false, is-synchronous=true, call-type=INTERRUPT, execution-context=INTERRUPT-CAT-2
    ICU_PORT_CI_L_EXT_IRQ_ISR: service-id=0, is-reentrant=false, is-synchronous=true, call-type=INTERRUPT, execution-context=INTERRUPT-CAT-2
    LPIT_0_CH_{0..3}_ISR: service-id=0, is-reentrant=false, is-synchronous=true, call-type=INTERRUPT, execution-context=INTERRUPT-CAT-2
    LPIT_0_ISR: service-id=0, is-reentrant=false, is-synchronous=true, call-type=INTERRUPT, execution-context=INTERRUPT-CAT-2
    LPTMR_0_CH_0_ISR: service-id=0, is-reentrant=false, is-synchronous=true, call-type=INTERRUPT, execution-context=INTERRUPT-CAT-2
    PORT_CI_ICU_IP_A_EXT_IRQ_ISR: service-id=0, is-reentrant=false, is-synchronous=true, call-type=INTERRUPT, execution-context=INTERRUPT-CAT-2
    PORT_CI_ICU_IP_B_EXT_IRQ_ISR: service-id=0, is-reentrant=false, is-synchronous=true, call-type=INTERRUPT, execution-context=INTERRUPT-CAT-2
    PORT_CI_ICU_IP_C_EXT_IRQ_ISR: service-id=0, is-reentrant=false, is-synchronous=true, call-type=INTERRUPT, execution-context=INTERRUPT-CAT-2
    PORT_CI_ICU_IP_D_EXT_IRQ_ISR: service-id=0, is-reentrant=false, is-synchronous=true, call-type=INTERRUPT, execution-context=INTERRUPT-CAT-2
    PORT_CI_ICU_IP_E_EXT_IRQ_ISR: service-id=0, is-reentrant=false, is-synchronous=true, call-type=INTERRUPT, execution-context=INTERRUPT-CAT-2
    PORT_CI_ICU_IP_EXT_IRQ_SINGLE_INTERRUPT: service-id=0, is-reentrant=false, is-synchronous=true, call-type=INTERRUPT, execution-context=INTERRUPT-CAT-2
    PORT_CI_ICU_IP_F_EXT_IRQ_ISR: service-id=0, is-reentrant=false, is-synchronous=true, call-type=INTERRUPT, execution-context=INTERRUPT-CAT-2
    PORT_CI_ICU_IP_K_EXT_IRQ_ISR: service-id=0, is-reentrant=false, is-synchronous=true, call-type=INTERRUPT, execution-context=INTERRUPT-CAT-2
package /Icu_TS_T40D2M30I0R0/Implementations
  bsw implementation BswImplementation_0: programming-language=C, sw-version=3.0.0_QLP02, vendor-id=43, ar-release-version=4.7.0, behavior=InternalBehavior_0, vendor-specific-module-def=Icu
    code-descriptors:
      code Files
        artifact-descriptors:
          short-label=config::Icu.xdm, category=SWCFG
          short-label=doc::RTD_ICU_IM.pdf, category=SWDOC
          short-label=doc::RTD_ICU_UM.pdf, category=SWDOC
          short-label=examples::EBT::S32K1::Icu_BlinkLed_S32K118::generate::epc::BaseNXP.xdm, category=SWCFG
          short-label=examples::EBT::S32K1::Icu_BlinkLed_S32K118::generate::epc::Dio.xdm, category=SWCFG
          short-label=examples::EBT::S32K1::Icu_BlinkLed_S32K118::generate::epc::Icu.xdm, category=SWCFG
          short-label=examples::EBT::S32K1::Icu_BlinkLed_S32K118::generate::epc::Mcu.xdm, category=SWCFG
          short-label=examples::EBT::S32K1::Icu_BlinkLed_S32K118::generate::epc::Platform.xdm, category=SWCFG
          short-label=examples::EBT::S32K1::Icu_BlinkLed_S32K118::generate::epc::Port.xdm, category=SWCFG
          short-label=examples::EBT::S32K1::Icu_BlinkLed_S32K118::generate::epc::Resource.xdm, category=SWCFG
          short-label=examples::EBT::S32K1::Icu_BlinkLed_S32K118::include::check_example.h, category=SWHDR
          short-label=examples::EBT::S32K1::Icu_BlinkLed_S32K118::src::main.c, category=SWSRC
          short-label=examples::EBT::S32K1::Icu_BlinkLed_S32K118::TresosProject::Icu_BlinkLed_S32K118::.prefs::preferences.xdm, category=SWCFG
          short-label=examples::EBT::S32K1::Icu_BlinkLed_S32K118::TresosProject::Icu_BlinkLed_S32K118::config::BaseNXP.xdm, category=SWCFG
          short-label=examples::EBT::S32K1::Icu_BlinkLed_S32K118::TresosProject::Icu_BlinkLed_S32K118::config::Dio.xdm, category=SWCFG
          short-label=examples::EBT::S32K1::Icu_BlinkLed_S32K118::TresosProject::Icu_BlinkLed_S32K118::config::EcuC.xdm, category=SWCFG
          short-label=examples::EBT::S32K1::Icu_BlinkLed_S32K118::TresosProject::Icu_BlinkLed_S32K118::config::Icu.xdm, category=SWCFG
          short-label=examples::EBT::S32K1::Icu_BlinkLed_S32K118::TresosProject::Icu_BlinkLed_S32K118::config::Mcu.xdm, category=SWCFG
          short-label=examples::EBT::S32K1::Icu_BlinkLed_S32K118::TresosProject::Icu_BlinkLed_S32K118::config::Platform.xdm, category=SWCFG
          short-label=examples::EBT::S32K1::Icu_BlinkLed_S32K118::TresosProject::Icu_BlinkLed_S32K118::config::Port.xdm, category=SWCFG
          short-label=examples::EBT::S32K1::Icu_BlinkLed_S32K118::TresosProject::Icu_BlinkLed_S32K118::config::Resource.xdm, category=SWCFG
          short-label=examples::EBT::S32K1::Icu_BlinkLed_S32K144::generate::epc::BaseNXP.xdm, category=SWCFG
          short-label=examples::EBT::S32K1::Icu_BlinkLed_S32K144::generate::epc::Dio.xdm, category=SWCFG
          short-label=examples::EBT::S32K1::Icu_BlinkLed_S32K144::generate::epc::Icu.xdm, category=SWCFG
          short-label=examples::EBT::S32K1::Icu_BlinkLed_S32K144::generate::epc::Mcu.xdm, category=SWCFG
          short-label=examples::EBT::S32K1::Icu_BlinkLed_S32K144::generate::epc::Platform.xdm, category=SWCFG
          short-label=examples::EBT::S32K1::Icu_BlinkLed_S32K144::generate::epc::Port.xdm, category=SWCFG
          short-label=examples::EBT::S32K1::Icu_BlinkLed_S32K144::generate::epc::Resource.xdm, category=SWCFG
          short-label=examples::EBT::S32K1::Icu_BlinkLed_S32K144::include::check_example.h, category=SWHDR
          short-label=examples::EBT::S32K1::Icu_BlinkLed_S32K144::src::main.c, category=SWSRC
          short-label=examples::EBT::S32K1::Icu_BlinkLed_S32K144::TresosProject::Icu_BlinkLed_S32K144::.prefs::preferences.xdm, category=SWCFG
          short-label=examples::EBT::S32K1::Icu_BlinkLed_S32K144::TresosProject::Icu_BlinkLed_S32K144::config::BaseNXP.xdm, category=SWCFG
          short-label=examples::EBT::S32K1::Icu_BlinkLed_S32K144::TresosProject::Icu_BlinkLed_S32K144::config::Dio.xdm, category=SWCFG
          short-label=examples::EBT::S32K1::Icu_BlinkLed_S32K144::TresosProject::Icu_BlinkLed_S32K144::config::EcuC.xdm, category=SWCFG
          short-label=examples::EBT::S32K1::Icu_BlinkLed_S32K144::TresosProject::Icu_BlinkLed_S32K144::config::Icu.xdm, category=SWCFG
          short-label=examples::EBT::S32K1::Icu_BlinkLed_S32K144::TresosProject::Icu_BlinkLed_S32K144::config::Mcu.xdm, category=SWCFG
          short-label=examples::EBT::S32K1::Icu_BlinkLed_S32K144::TresosProject::Icu_BlinkLed_S32K144::config::Platform.xdm, category=SWCFG
          short-label=examples::EBT::S32K1::Icu_BlinkLed_S32K144::TresosProject::Icu_BlinkLed_S32K144::config::Port.xdm, category=SWCFG
          short-label=examples::EBT::S32K1::Icu_BlinkLed_S32K144::TresosProject::Icu_BlinkLed_S32K144::config::Resource.xdm, category=SWCFG
          short-label=examples::EBT::S32K1::Icu_BlinkLed_S32K144W::generate::epc::BaseNXP.xdm, category=SWCFG
          short-label=examples::EBT::S32K1::Icu_BlinkLed_S32K144W::generate::epc::Dio.xdm, category=SWCFG
          short-label=examples::EBT::S32K1::Icu_BlinkLed_S32K144W::generate::epc::Icu.xdm, category=SWCFG
          short-label=examples::EBT::S32K1::Icu_BlinkLed_S32K144W::generate::epc::Mcu.xdm, category=SWCFG
          short-label=examples::EBT::S32K1::Icu_BlinkLed_S32K144W::generate::epc::Platform.xdm, category=SWCFG
          short-label=examples::EBT::S32K1::Icu_BlinkLed_S32K144W::generate::epc::Port.xdm, category=SWCFG
          short-label=examples::EBT::S32K1::Icu_BlinkLed_S32K144W::generate::epc::Resource.xdm, category=SWCFG
          short-label=examples::EBT::S32K1::Icu_BlinkLed_S32K144W::include::check_example.h, category=SWHDR
          short-label=examples::EBT::S32K1::Icu_BlinkLed_S32K144W::src::main.c, category=SWSRC
          short-label=examples::EBT::S32K1::Icu_BlinkLed_S32K144W::TresosProject::Icu_BlinkLed_S32K144W::.prefs::preferences.xdm, category=SWCFG
          short-label=examples::EBT::S32K1::Icu_BlinkLed_S32K144W::TresosProject::Icu_BlinkLed_S32K144W::config::BaseNXP.xdm, category=SWCFG
          short-label=examples::EBT::S32K1::Icu_BlinkLed_S32K144W::TresosProject::Icu_BlinkLed_S32K144W::config::Dio.xdm, category=SWCFG
          short-label=examples::EBT::S32K1::Icu_BlinkLed_S32K144W::TresosProject::Icu_BlinkLed_S32K144W::config::EcuC.xdm, category=SWCFG
          short-label=examples::EBT::S32K1::Icu_BlinkLed_S32K144W::TresosProject::Icu_BlinkLed_S32K144W::config::Icu.xdm, category=SWCFG
          short-label=examples::EBT::S32K1::Icu_BlinkLed_S32K144W::TresosProject::Icu_BlinkLed_S32K144W::config::Mcu.xdm, category=SWCFG
          short-label=examples::EBT::S32K1::Icu_BlinkLed_S32K144W::TresosProject::Icu_BlinkLed_S32K144W::config::Platform.xdm, category=SWCFG
          short-label=examples::EBT::S32K1::Icu_BlinkLed_S32K144W::TresosProject::Icu_BlinkLed_S32K144W::config::Port.xdm, category=SWCFG
          short-label=examples::EBT::S32K1::Icu_BlinkLed_S32K144W::TresosProject::Icu_BlinkLed_S32K144W::config::Resource.xdm, category=SWCFG
          short-label=examples::EBT::S32K1::Icu_BlinkLed_S32K148::generate::epc::BaseNXP.xdm, category=SWCFG
          short-label=examples::EBT::S32K1::Icu_BlinkLed_S32K148::generate::epc::Dio.xdm, category=SWCFG
          short-label=examples::EBT::S32K1::Icu_BlinkLed_S32K148::generate::epc::Icu.xdm, category=SWCFG
          short-label=examples::EBT::S32K1::Icu_BlinkLed_S32K148::generate::epc::Mcu.xdm, category=SWCFG
          short-label=examples::EBT::S32K1::Icu_BlinkLed_S32K148::generate::epc::Platform.xdm, category=SWCFG
          short-label=examples::EBT::S32K1::Icu_BlinkLed_S32K148::generate::epc::Port.xdm, category=SWCFG
          short-label=examples::EBT::S32K1::Icu_BlinkLed_S32K148::generate::epc::Resource.xdm, category=SWCFG
          short-label=examples::EBT::S32K1::Icu_BlinkLed_S32K148::include::check_example.h, category=SWHDR
          short-label=examples::EBT::S32K1::Icu_BlinkLed_S32K148::src::main.c, category=SWSRC
          short-label=examples::EBT::S32K1::Icu_BlinkLed_S32K148::TresosProject::Icu_BlinkLed_S32K148::.prefs::preferences.xdm, category=SWCFG
          short-label=examples::EBT::S32K1::Icu_BlinkLed_S32K148::TresosProject::Icu_BlinkLed_S32K148::config::BaseNXP.xdm, category=SWCFG
          short-label=examples::EBT::S32K1::Icu_BlinkLed_S32K148::TresosProject::Icu_BlinkLed_S32K148::config::Dio.xdm, category=SWCFG
          short-label=examples::EBT::S32K1::Icu_BlinkLed_S32K148::TresosProject::Icu_BlinkLed_S32K148::config::EcuC.xdm, category=SWCFG
          short-label=examples::EBT::S32K1::Icu_BlinkLed_S32K148::TresosProject::Icu_BlinkLed_S32K148::config::Icu.xdm, category=SWCFG
          short-label=examples::EBT::S32K1::Icu_BlinkLed_S32K148::TresosProject::Icu_BlinkLed_S32K148::config::Mcu.xdm, category=SWCFG
          short-label=examples::EBT::S32K1::Icu_BlinkLed_S32K148::TresosProject::Icu_BlinkLed_S32K148::config::Platform.xdm, category=SWCFG
          short-label=examples::EBT::S32K1::Icu_BlinkLed_S32K148::TresosProject::Icu_BlinkLed_S32K148::config::Port.xdm, category=SWCFG
          short-label=examples::EBT::S32K1::Icu_BlinkLed_S32K148::TresosProject::Icu_BlinkLed_S32K148::config::Resource.xdm, category=SWCFG
          short-label=examples::S32DS::S32K1::Ftm_Icu_Ip_BlinkLed_S32K118::include::check_example.h, category=SWHDR
          short-label=examples::S32DS::S32K1::Ftm_Icu_Ip_BlinkLed_S32K118::Project_Settings::Startup_Code::exceptions.c, category=SWSRC
          short-label=examples::S32DS::S32K1::Ftm_Icu_Ip_BlinkLed_S32K118::Project_Settings::Startup_Code::nvic.c, category=SWSRC
          short-label=examples::S32DS::S32K1::Ftm_Icu_Ip_BlinkLed_S32K118::Project_Settings::Startup_Code::startup.c, category=SWSRC
          short-label=examples::S32DS::S32K1::Ftm_Icu_Ip_BlinkLed_S32K118::Project_Settings::Startup_Code::system.c, category=SWSRC
          short-label=examples::S32DS::S32K1::Ftm_Icu_Ip_BlinkLed_S32K118::src::main.c, category=SWSRC
          short-label=examples::S32DS::S32K1::Ftm_Icu_Ip_BlinkLed_S32K144::include::check_example.h, category=SWHDR
          short-label=examples::S32DS::S32K1::Ftm_Icu_Ip_BlinkLed_S32K144::Project_Settings::Startup_Code::exceptions.c, category=SWSRC
          short-label=examples::S32DS::S32K1::Ftm_Icu_Ip_BlinkLed_S32K144::Project_Settings::Startup_Code::nvic.c, category=SWSRC
          short-label=examples::S32DS::S32K1::Ftm_Icu_Ip_BlinkLed_S32K144::Project_Settings::Startup_Code::startup.c, category=SWSRC
          short-label=examples::S32DS::S32K1::Ftm_Icu_Ip_BlinkLed_S32K144::Project_Settings::Startup_Code::system.c, category=SWSRC
          short-label=examples::S32DS::S32K1::Ftm_Icu_Ip_BlinkLed_S32K144::src::main.c, category=SWSRC
          short-label=examples::S32DS::S32K1::Ftm_Icu_Ip_BlinkLed_S32K144W::include::check_example.h, category=SWHDR
          short-label=examples::S32DS::S32K1::Ftm_Icu_Ip_BlinkLed_S32K144W::Project_Settings::Startup_Code::exceptions.c, category=SWSRC
          short-label=examples::S32DS::S32K1::Ftm_Icu_Ip_BlinkLed_S32K144W::Project_Settings::Startup_Code::nvic.c, category=SWSRC
          short-label=examples::S32DS::S32K1::Ftm_Icu_Ip_BlinkLed_S32K144W::Project_Settings::Startup_Code::startup.c, category=SWSRC
          short-label=examples::S32DS::S32K1::Ftm_Icu_Ip_BlinkLed_S32K144W::Project_Settings::Startup_Code::system.c, category=SWSRC
          short-label=examples::S32DS::S32K1::Ftm_Icu_Ip_BlinkLed_S32K144W::src::main.c, category=SWSRC
          short-label=examples::S32DS::S32K1::Ftm_Icu_Ip_BlinkLed_S32K148::include::check_example.h, category=SWHDR
          short-label=examples::S32DS::S32K1::Ftm_Icu_Ip_BlinkLed_S32K148::Project_Settings::Startup_Code::exceptions.c, category=SWSRC
          short-label=examples::S32DS::S32K1::Ftm_Icu_Ip_BlinkLed_S32K148::Project_Settings::Startup_Code::nvic.c, category=SWSRC
          short-label=examples::S32DS::S32K1::Ftm_Icu_Ip_BlinkLed_S32K148::Project_Settings::Startup_Code::startup.c, category=SWSRC
          short-label=examples::S32DS::S32K1::Ftm_Icu_Ip_BlinkLed_S32K148::Project_Settings::Startup_Code::system.c, category=SWSRC
          short-label=examples::S32DS::S32K1::Ftm_Icu_Ip_BlinkLed_S32K148::src::main.c, category=SWSRC
          short-label=examples::S32DS::S32K1::Icu_BlinkLed_S32K118::include::check_example.h, category=SWHDR
          short-label=examples::S32DS::S32K1::Icu_BlinkLed_S32K118::Project_Settings::Startup_Code::exceptions.c, category=SWSRC
          short-label=examples::S32DS::S32K1::Icu_BlinkLed_S32K118::Project_Settings::Startup_Code::nvic.c, category=SWSRC
          short-label=examples::S32DS::S32K1::Icu_BlinkLed_S32K118::Project_Settings::Startup_Code::startup.c, category=SWSRC
          short-label=examples::S32DS::S32K1::Icu_BlinkLed_S32K118::Project_Settings::Startup_Code::system.c, category=SWSRC
          short-label=examples::S32DS::S32K1::Icu_BlinkLed_S32K118::src::main.c, category=SWSRC
          short-label=examples::S32DS::S32K1::Icu_BlinkLed_S32K144::include::check_example.h, category=SWHDR
          short-label=examples::S32DS::S32K1::Icu_BlinkLed_S32K144::Project_Settings::Startup_Code::exceptions.c, category=SWSRC
          short-label=examples::S32DS::S32K1::Icu_BlinkLed_S32K144::Project_Settings::Startup_Code::nvic.c, category=SWSRC
          short-label=examples::S32DS::S32K1::Icu_BlinkLed_S32K144::Project_Settings::Startup_Code::startup.c, category=SWSRC
          short-label=examples::S32DS::S32K1::Icu_BlinkLed_S32K144::Project_Settings::Startup_Code::system.c, category=SWSRC
          short-label=examples::S32DS::S32K1::Icu_BlinkLed_S32K144::src::main.c, category=SWSRC
          short-label=examples::S32DS::S32K1::Icu_BlinkLed_S32K144W::include::check_example.h, category=SWHDR
          short-label=examples::S32DS::S32K1::Icu_BlinkLed_S32K144W::Project_Settings::Startup_Code::exceptions.c, category=SWSRC
          short-label=examples::S32DS::S32K1::Icu_BlinkLed_S32K144W::Project_Settings::Startup_Code::nvic.c, category=SWSRC
          short-label=examples::S32DS::S32K1::Icu_BlinkLed_S32K144W::Project_Settings::Startup_Code::startup.c, category=SWSRC
          short-label=examples::S32DS::S32K1::Icu_BlinkLed_S32K144W::Project_Settings::Startup_Code::system.c, category=SWSRC
          short-label=examples::S32DS::S32K1::Icu_BlinkLed_S32K144W::src::main.c, category=SWSRC
          short-label=examples::S32DS::S32K1::Icu_BlinkLed_S32K148::include::check_example.h, category=SWHDR
          short-label=examples::S32DS::S32K1::Icu_BlinkLed_S32K148::Project_Settings::Startup_Code::exceptions.c, category=SWSRC
          short-label=examples::S32DS::S32K1::Icu_BlinkLed_S32K148::Project_Settings::Startup_Code::nvic.c, category=SWSRC
          short-label=examples::S32DS::S32K1::Icu_BlinkLed_S32K148::Project_Settings::Startup_Code::startup.c, category=SWSRC
          short-label=examples::S32DS::S32K1::Icu_BlinkLed_S32K148::Project_Settings::Startup_Code::system.c, category=SWSRC
          short-label=examples::S32DS::S32K1::Icu_BlinkLed_S32K148::src::main.c, category=SWSRC
          short-label=examples::S32DS::S32K1::Port_Ci_Icu_Ip_BlinkLed_S32K118::include::check_example.h, category=SWHDR
          short-label=examples::S32DS::S32K1::Port_Ci_Icu_Ip_BlinkLed_S32K118::Project_Settings::Startup_Code::exceptions.c, category=SWSRC
          short-label=examples::S32DS::S32K1::Port_Ci_Icu_Ip_BlinkLed_S32K118::Project_Settings::Startup_Code::nvic.c, category=SWSRC
          short-label=examples::S32DS::S32K1::Port_Ci_Icu_Ip_BlinkLed_S32K118::Project_Settings::Startup_Code::startup.c, category=SWSRC
          short-label=examples::S32DS::S32K1::Port_Ci_Icu_Ip_BlinkLed_S32K118::Project_Settings::Startup_Code::system.c, category=SWSRC
          short-label=examples::S32DS::S32K1::Port_Ci_Icu_Ip_BlinkLed_S32K118::src::main.c, category=SWSRC
          short-label=examples::S32DS::S32K1::Port_Ci_Icu_Ip_BlinkLed_S32K144::include::check_example.h, category=SWHDR
          short-label=examples::S32DS::S32K1::Port_Ci_Icu_Ip_BlinkLed_S32K144::Project_Settings::Startup_Code::exceptions.c, category=SWSRC
          short-label=examples::S32DS::S32K1::Port_Ci_Icu_Ip_BlinkLed_S32K144::Project_Settings::Startup_Code::nvic.c, category=SWSRC
          short-label=examples::S32DS::S32K1::Port_Ci_Icu_Ip_BlinkLed_S32K144::Project_Settings::Startup_Code::startup.c, category=SWSRC
          short-label=examples::S32DS::S32K1::Port_Ci_Icu_Ip_BlinkLed_S32K144::Project_Settings::Startup_Code::system.c, category=SWSRC
          short-label=examples::S32DS::S32K1::Port_Ci_Icu_Ip_BlinkLed_S32K144::src::main.c, category=SWSRC
          short-label=examples::S32DS::S32K1::Port_Ci_Icu_Ip_BlinkLed_S32K144W::include::check_example.h, category=SWHDR
          short-label=examples::S32DS::S32K1::Port_Ci_Icu_Ip_BlinkLed_S32K144W::Project_Settings::Startup_Code::exceptions.c, category=SWSRC
          short-label=examples::S32DS::S32K1::Port_Ci_Icu_Ip_BlinkLed_S32K144W::Project_Settings::Startup_Code::nvic.c, category=SWSRC
          short-label=examples::S32DS::S32K1::Port_Ci_Icu_Ip_BlinkLed_S32K144W::Project_Settings::Startup_Code::startup.c, category=SWSRC
          short-label=examples::S32DS::S32K1::Port_Ci_Icu_Ip_BlinkLed_S32K144W::Project_Settings::Startup_Code::system.c, category=SWSRC
          short-label=examples::S32DS::S32K1::Port_Ci_Icu_Ip_BlinkLed_S32K144W::src::main.c, category=SWSRC
          short-label=examples::S32DS::S32K1::Port_Ci_Icu_Ip_BlinkLed_S32K148::include::check_example.h, category=SWHDR
          short-label=examples::S32DS::S32K1::Port_Ci_Icu_Ip_BlinkLed_S32K148::Project_Settings::Startup_Code::exceptions.c, category=SWSRC
          short-label=examples::S32DS::S32K1::Port_Ci_Icu_Ip_BlinkLed_S32K148::Project_Settings::Startup_Code::nvic.c, category=SWSRC
          short-label=examples::S32DS::S32K1::Port_Ci_Icu_Ip_BlinkLed_S32K148::Project_Settings::Startup_Code::startup.c, category=SWSRC
          short-label=examples::S32DS::S32K1::Port_Ci_Icu_Ip_BlinkLed_S32K148::Project_Settings::Startup_Code::system.c, category=SWSRC
          short-label=examples::S32DS::S32K1::Port_Ci_Icu_Ip_BlinkLed_S32K148::src::main.c, category=SWSRC
          short-label=include::Cmp_Ip.h, category=SWHDR
          short-label=include::Cmp_Ip_Types.h, category=SWHDR
          short-label=include::Ftm_Icu_Ip.h, category=SWHDR
          short-label=include::Ftm_Icu_Ip_Irq.h, category=SWHDR
          short-label=include::Ftm_Icu_Ip_Types.h, category=SWHDR
          short-label=include::Icu.h, category=SWHDR
          short-label=include::Icu_EnvCfg.h, category=SWHDR
          short-label=include::Icu_Ipw.h, category=SWHDR
          short-label=include::Icu_Ipw_Types.h, category=SWHDR
          short-label=include::Icu_Irq.h, category=SWHDR
          short-label=include::Icu_Types.h, category=SWHDR
          short-label=include::Lpit_Icu_Ip.h, category=SWHDR
          short-label=include::Lpit_Icu_Ip_Irq.h, category=SWHDR
          short-label=include::Lpit_Icu_Ip_Types.h, category=SWHDR
          short-label=include::Lptmr_Icu_Ip.h, category=SWHDR
          short-label=include::Lptmr_Icu_Ip_Irq.h, category=SWHDR
          short-label=include::Lptmr_Icu_Ip_Types.h, category=SWHDR
          short-label=include::Port_Ci_Icu_Ip.h, category=SWHDR
          short-label=include::Port_Ci_Icu_Ip_Irq.h, category=SWHDR
          short-label=include::Port_Ci_Icu_Ip_Types.h, category=SWHDR
          short-label=src::Cmp_Ip.c, category=SWSRC
          short-label=src::Ftm_Icu_Ip.c, category=SWSRC
          short-label=src::Ftm_Icu_Ip_Irq.c, category=SWSRC
          short-label=src::Icu.c, category=SWSRC
          short-label=src::Icu_Ipw.c, category=SWSRC
          short-label=src::Lpit_Icu_Ip.c, category=SWSRC
          short-label=src::Lpit_Icu_Ip_Irq.c, category=SWSRC
          short-label=src::Lptmr_Icu_Ip.c, category=SWSRC
          short-label=src::Lptmr_Icu_Ip_Irq.c, category=SWSRC
          short-label=src::Port_Ci_Icu_Ip.c, category=SWSRC
          short-label=src::Port_Ci_Icu_Ip_Irq.c, category=SWSRC
    compiler GCC_Compiler:
      name=GCC Compiler
      options=-mcpu=cortex-m4 -mcpu=cortex-m0plus -mthumb -mlittle-endian -mfpu=fpv4-sp-d16 -mfloat-abi=hard -mfpu=auto -mfloat-abi=soft -std=c99 -Os -ggdb3 -Wall -Wextra -pedantic -Wstrict-prototypes -Wundef -Wunused -Werror=implicit-function-declaration -Wsign-compare -Wdouble-promotion -fno-short-enums -funsigned-char -funsigned-bitfields -fomit-frame-pointer -fno-common -fstack-usage -fdump-ipa-all -c -DUSE_SW_VECTOR_MODE -DI_CACHE_ENABLE -DENABLE_FPU -DMCAL_ENABLE_USER_MODE_SUPPORT --sysroot=$(NEWLIB_DIR) -specs=nano.specs -specs=nosys.specs
      vendor=GCC Systems
      version=NXP GCC 10.2.0 20200723 (Build 1728 Revision g5963bc8)
    compiler GHS_Compiler:
      name=Green Hills
      options=-cpu=cortexm4 -cpu=cortexm0plus -thumb -fpu=vfpv4_d16 -fsingle -fsoft -C99 --ghstd=last -Osize --gnu_asm -dual_debug -G -keeptempfiles -Wimplicit-int -Wshadow -Wtrigraphs -Wundef --unsigned_chars --unsigned_fields --no_commons --no_exceptions --no_slash_comment --prototype_errors --incorrect_pragma_warnings -c -DUSE_SW_VECTOR_MODE -DI_CACHE_ENABLE -DENABLE_FPU -DMCAL_ENABLE_USER_MODE_SUPPORT
      vendor=Green Hills
      version=Green Hills Multi 7.1.6d / Compiler 2020.1.4
    compiler IAR_Compiler:
      name=IAR Compiler
      options=--cpu=Cortex-M4 --cpu=Cortex-M0+ --cpu_mode=thumb --endian=little --fpu=FPv4-SP --fpu=none -e -Ohz --debug --no_clustering --no_mem_idioms --no_explicit_zero_opt --require_prototypes --no_wrap_diagnostics --diag_suppress=Pa050 -DIAR -DUSE_SW_VECTOR_MODE -DI_CACHE_ENABLE -DENABLE_FPU -DMCAL_ENABLE_USER_MODE_SUPPORT
      vendor=IAR Systems
      version=IAR ANSI C/C++ Compiler V8.40.3.228/W32 for ARM Functional Safety
    generated-artifacts:
      28 x dependency on artifact:
        Cmp_Ip_PBcfg_h: artifact-descriptor={short-label=generate_PB::include::Cmp_Ip_PBcfg.h, category=SWHDR}, usages=EXECUTE
        Ftm_Icu_Ip_PBcfg_h: artifact-descriptor={short-label=generate_PB::include::Ftm_Icu_Ip_PBcfg.h, category=SWHDR}, usages=EXECUTE
        Icu_Ipw_PBcfg_h: artifact-descriptor={short-label=generate_PB::include::Icu_Ipw_PBcfg.h, category=SWHDR}, usages=EXECUTE
        Icu_PBcfg_h: artifact-descriptor={short-label=generate_PB::include::Icu_PBcfg.h, category=SWHDR}, usages=EXECUTE
        Lpit_Icu_Ip_PBcfg_h: artifact-descriptor={short-label=generate_PB::include::Lpit_Icu_Ip_PBcfg.h, category=SWHDR}, usages=EXECUTE
        Lptmr_Icu_Ip_PBcfg_h: artifact-descriptor={short-label=generate_PB::include::Lptmr_Icu_Ip_PBcfg.h, category=SWHDR}, usages=EXECUTE
        Port_Ci_Icu_Ip_PBcfg_h: artifact-descriptor={short-label=generate_PB::include::Port_Ci_Icu_Ip_PBcfg.h, category=SWHDR}, usages=EXECUTE
        Cmp_Ip_PBcfg_c: artifact-descriptor={short-label=generate_PB::src::Cmp_Ip_PBcfg.c, category=SWSRC}, usages=EXECUTE
        Ftm_Icu_Ip_PBcfg_c: artifact-descriptor={short-label=generate_PB::src::Ftm_Icu_Ip_PBcfg.c, category=SWSRC}, usages=EXECUTE
        Icu_DmaNotification_c: artifact-descriptor={short-label=generate_PB::src::Icu_DmaNotification.c, category=SWSRC}, usages=EXECUTE
        Icu_Ipw_PBcfg_c: artifact-descriptor={short-label=generate_PB::src::Icu_Ipw_PBcfg.c, category=SWSRC}, usages=EXECUTE
        Icu_PBcfg_c: artifact-descriptor={short-label=generate_PB::src::Icu_PBcfg.c, category=SWSRC}, usages=EXECUTE
        Lpit_Icu_Ip_PBcfg_c: artifact-descriptor={short-label=generate_PB::src::Lpit_Icu_Ip_PBcfg.c, category=SWSRC}, usages=EXECUTE
        Lptmr_Icu_Ip_PBcfg_c: artifact-descriptor={short-label=generate_PB::src::Lptmr_Icu_Ip_PBcfg.c, category=SWSRC}, usages=EXECUTE
        Port_Ci_Icu_Ip_PBcfg_c: artifact-descriptor={short-label=generate_PB::src::Port_Ci_Icu_Ip_PBcfg.c, category=SWSRC}, usages=EXECUTE
        Cmp_Ip_Cfg_h: artifact-descriptor={short-label=generate_PC::include::Cmp_Ip_Cfg.h, category=SWHDR}, usages=COMPILE
        Cmp_Ip_Defines_h: artifact-descriptor={short-label=generate_PC::include::Cmp_Ip_Defines.h, category=SWHDR}, usages=COMPILE
        Ftm_Icu_Ip_Cfg_h: artifact-descriptor={short-label=generate_PC::include::Ftm_Icu_Ip_Cfg.h, category=SWHDR}, usages=COMPILE
        Ftm_Icu_Ip_Defines_h: artifact-descriptor={short-label=generate_PC::include::Ftm_Icu_Ip_Defines.h, category=SWHDR}, usages=COMPILE
        Icu_Cfg_h: artifact-descriptor={short-label=generate_PC::include::Icu_Cfg.h, category=SWHDR}, usages=COMPILE
        Icu_Ipw_Cfg_h: artifact-descriptor={short-label=generate_PC::include::Icu_Ipw_Cfg.h, category=SWHDR}, usages=COMPILE
        Lpit_Icu_Ip_Cfg_h: artifact-descriptor={short-label=generate_PC::include::Lpit_Icu_Ip_Cfg.h, category=SWHDR}, usages=COMPILE
        Lpit_Icu_Ip_Defines_h: artifact-descriptor={short-label=generate_PC::include::Lpit_Icu_Ip_Defines.h, category=SWHDR}, usages=COMPILE
        Lptmr_Icu_Ip_Cfg_h: artifact-descriptor={short-label=generate_PC::include::Lptmr_Icu_Ip_Cfg.h, category=SWHDR}, usages=COMPILE
        Lptmr_Icu_Ip_Defines_h: artifact-descriptor={short-label=generate_PC::include::Lptmr_Icu_Ip_Defines.h, category=SWHDR}, usages=COMPILE
        Port_Ci_Icu_Ip_Cfg_h: artifact-descriptor={short-label=generate_PC::include::Port_Ci_Icu_Ip_Cfg.h, category=SWHDR}, usages=COMPILE
        Port_Ci_Icu_Ip_Defines_h: artifact-descriptor={short-label=generate_PC::include::Port_Ci_Icu_Ip_Defines.h, category=SWHDR}, usages=COMPILE
        Icu_Cfg_c: artifact-descriptor={short-label=generate_PC::src::Icu_Cfg.c, category=SWSRC}, usages=COMPILE
    linker GCC_Linker: name=GCC Compiler, options=-Wl,-Map,filename -T linkerfile --entry=Reset_Handler -nostartfiles -mcpu=cortex-m4 -mcpu=cortex-m0plus -mthumb -mfpu=fpv4-sp-d16 -mfloat-abi=hard -mfpu=auto -mfloat-abi=soft -mlittle-endian -ggdb3 -lc -lm -lgcc -n --sysroot=$(NEWLIB_DIR) -specs=nano.specs -specs=nosys.specs, vendor=GCC Systems, version=NXP GCC 10.2.0 20200723 (Build 1728 Revision g5963bc8)
    linker GHS_Linker: name=Green Hills, options=-e Reset_Handler -T linker_script_file.ld -map -keepmap -Mn -delete -ignore_debug_references -Llibrary_path -larch -lstartup -lind_sd -lind_sf -v -keep=C40_Ip_AccessCode -nostartfiles, vendor=Green Hills, version=Green Hills Multi 7.1.6d / Compiler 2020.1.4
    linker IAR_Linker: name=IAR Compiler, options=--map filename --config linkerfile --cpu=Cortex-M4 --cpu=Cortex-M0+ --fpu=FPv4-SP --fpu=none --entry _start --enable_stack_usage --skip_dynamic_initialization --no_wrap_diagnostics, vendor=IAR Systems, version=IAR ANSI C/C++ Compiler V8.40.3.228/W32 for ARM Functional Safety
    resource consumption ResourceConsumption
      9 x memory section:
        ICU_CODE: alignment=UNSPECIFIED, sw-addrmethod=CODE, symbol=CODE
        ICU_CONFIG_DATA_UNSPECIFIED: alignment=UNSPECIFIED, sw-addrmethod=CONFIG_DATA, symbol=CONFIG_DATA_UNSPECIFIED
        ICU_CONST_UNSPECIFIED: alignment=UNSPECIFIED, sw-addrmethod=CONST, symbol=CONST_UNSPECIFIED
        ICU_VAR_CLEARED_16: alignment=16, sw-addrmethod=VAR_CLEARED, symbol=VAR_CLEARED_16
        ICU_VAR_CLEARED_16_NO_CACHEABLE: alignment=16, sw-addrmethod=VAR_CLEARED_NO_CACHEABLE, symbol=VAR_CLEARED_16_NO_CACHEABLE
        ICU_VAR_CLEARED_8: alignment=8, sw-addrmethod=VAR_CLEARED, symbol=VAR_CLEARED_8
        ICU_VAR_CLEARED_8_NO_CACHEABLE: alignment=8, sw-addrmethod=VAR_CLEARED_NO_CACHEABLE, symbol=VAR_CLEARED_8_NO_CACHEABLE
        ICU_VAR_CLEARED_UNSPECIFIED: alignment=UNSPECIFIED, sw-addrmethod=VAR_CLEARED, symbol=VAR_CLEARED_UNSPECIFIED
        ICU_VAR_CLEARED_UNSPECIFIED_NO_CACHEABLE: alignment=UNSPECIFIED, sw-addrmethod=VAR_CLEARED_NO_CACHEABLE, symbol=VAR_CLEARED_UNSPECIFIED_NO_CACHEABLE
