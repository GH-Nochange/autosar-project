AUTOSAR XML (schema 00050)
package /AUTOSAR_Crc/BswModuleDescriptions
  bsw module description Crc: module-id=201
    provided-entrys:
      Crc_CalculateCRC16
      Crc_CalculateCRC16ARC
      Crc_CalculateCRC32
      Crc_CalculateCRC32C
      Crc_CalculateCRC32P4
      Crc_CalculateCRC64
      Crc_CalculateCRC8
      Crc_CalculateCRC8H2F
      Crc_GetChannelResult
      Crc_GetVersionInfo
      Crc_Init
      Crc_SetChannelCalculate
      Crc_SetChannelConfig
    bsw internal behavior InternalBehavior_0
      13 x bsw called entity:
        Crc_CalculateCRC16: implemented-entry=Crc_CalculateCRC16
        Crc_CalculateCRC16ARC: implemented-entry=Crc_CalculateCRC16ARC
        Crc_CalculateCRC32: implemented-entry=Crc_CalculateCRC32
        Crc_CalculateCRC32C: implemented-entry=Crc_CalculateCRC32C
        Crc_CalculateCRC32P4: implemented-entry=Crc_CalculateCRC32P4
        Crc_CalculateCRC64: implemented-entry=Crc_CalculateCRC64
        Crc_CalculateCRC8: implemented-entry=Crc_CalculateCRC8
        Crc_CalculateCRC8H2F: implemented-entry=Crc_CalculateCRC8H2F
        Crc_GetChannelResult: implemented-entry=Crc_GetChannelResult
        Crc_GetVersionInfo: implemented-entry=Crc_GetVersionInfo
        Crc_Init: implemented-entry=Crc_Init
        Crc_SetChannelCalculate: implemented-entry=Crc_SetChannelCalculate
        Crc_SetChannelConfig: implemented-entry=Crc_SetChannelConfig
package /AUTOSAR_Crc/BswModuleEntrys
  13 x bsw module entry, all with is-synchronous=true, call-type=REGULAR, execution-context=UNSPECIFIED, sw-service-impl-policy=STANDARD:
    Crc_CalculateCRC16: service-id=0x02, is-reentrant=true
    Crc_CalculateCRC16ARC: service-id=0x08, is-reentrant=true
    Crc_CalculateCRC32: service-id=0x03, is-reentrant=true
    Crc_CalculateCRC32C: service-id=0x0d, is-reentrant=true
    Crc_CalculateCRC32P4: service-id=0x06, is-reentrant=true
    Crc_CalculateCRC64: service-id=0x07, is-reentrant=true
    Crc_CalculateCRC8: service-id=0x01, is-reentrant=true
    Crc_CalculateCRC8H2F: service-id=0x05, is-reentrant=true
    Crc_GetChannelResult: service-id=0x0c, is-reentrant=true
    Crc_GetVersionInfo: service-id=0x04, is-reentrant=true
    Crc_Init: service-id=0x09, is-reentrant=false
    Crc_SetChannelCalculate: service-id=0x0b, is-reentrant=true
    Crc_SetChannelConfig: service-id=0x0a, is-reentrant=true
package /Crc_TS_T40D2M30I0R0/Implementations
  bsw implementation BswImplementation_0: programming-language=C, sw-version=3.0.0_QLP02, vendor-id=43, ar-release-version=4.7.0, behavior=InternalBehavior_0, vendor-specific-module-def=Crc
    code-descriptors:
      code Files
        artifact-descriptors:
          short-label=config::Crc.xdm, category=SWCFG
          short-label=doc::RTD_CRC_IM.pdf, category=SWDOC
          short-label=doc::RTD_CRC_UM.pdf, category=SWDOC
          short-label=examples::EBT::S32K1::Crc_Example_S32K118::generate::epc::BaseNXP.xdm, category=SWCFG
          short-label=examples::EBT::S32K1::Crc_Example_S32K118::generate::epc::Crc.xdm, category=SWCFG
          short-label=examples::EBT::S32K1::Crc_Example_S32K118::generate::epc::Mcl.xdm, category=SWCFG
          short-label=examples::EBT::S32K1::Crc_Example_S32K118::generate::epc::Mcu.xdm, category=SWCFG
          short-label=examples::EBT::S32K1::Crc_Example_S32K118::generate::epc::Resource.xdm, category=SWCFG
          short-label=examples::EBT::S32K1::Crc_Example_S32K118::include::check_example.h, category=SWHDR
          short-label=examples::EBT::S32K1::Crc_Example_S32K118::src::main.c, category=SWSRC
          short-label=examples::EBT::S32K1::Crc_Example_S32K118::TresosProject::Crc_Example_S32K118::.prefs::preferences.xdm, category=SWCFG
          short-label=examples::EBT::S32K1::Crc_Example_S32K118::TresosProject::Crc_Example_S32K118::config::BaseNXP.xdm, category=SWCFG
          short-label=examples::EBT::S32K1::Crc_Example_S32K118::TresosProject::Crc_Example_S32K118::config::Crc.xdm, category=SWCFG
          short-label=examples::EBT::S32K1::Crc_Example_S32K118::TresosProject::Crc_Example_S32K118::config::EcuC.xdm, category=SWCFG
          short-label=examples::EBT::S32K1::Crc_Example_S32K118::TresosProject::Crc_Example_S32K118::config::Mcl.xdm, category=SWCFG
          short-label=examples::EBT::S32K1::Crc_Example_S32K118::TresosProject::Crc_Example_S32K118::config::Mcu.xdm, category=SWCFG
          short-label=examples::EBT::S32K1::Crc_Example_S32K118::TresosProject::Crc_Example_S32K118::config::Resource.xdm, category=SWCFG
          short-label=examples::EBT::S32K1::Crc_Example_S32K144::generate::epc::BaseNXP.xdm, category=SWCFG
          short-label=examples::EBT::S32K1::Crc_Example_S32K144::generate::epc::Crc.xdm, category=SWCFG
          short-label=examples::EBT::S32K1::Crc_Example_S32K144::generate::epc::Mcl.xdm, category=SWCFG
          short-label=examples::EBT::S32K1::Crc_Example_S32K144::generate::epc::Mcu.xdm, category=SWCFG
          short-label=examples::EBT::S32K1::Crc_Example_S32K144::generate::epc::Resource.xdm, category=SWCFG
          short-label=examples::EBT::S32K1::Crc_Example_S32K144::include::check_example.h, category=SWHDR
          short-label=examples::EBT::S32K1::Crc_Example_S32K144::src::main.c, category=SWSRC
          short-label=examples::EBT::S32K1::Crc_Example_S32K144::TresosProject::Crc_Example_S32K144::.prefs::preferences.xdm, category=SWCFG
          short-label=examples::EBT::S32K1::Crc_Example_S32K144::TresosProject::Crc_Example_S32K144::config::BaseNXP.xdm, category=SWCFG
          short-label=examples::EBT::S32K1::Crc_Example_S32K144::TresosProject::Crc_Example_S32K144::config::Crc.xdm, category=SWCFG
          short-label=examples::EBT::S32K1::Crc_Example_S32K144::TresosProject::Crc_Example_S32K144::config::EcuC.xdm, category=SWCFG
          short-label=examples::EBT::S32K1::Crc_Example_S32K144::TresosProject::Crc_Example_S32K144::config::Mcl.xdm, category=SWCFG
          short-label=examples::EBT::S32K1::Crc_Example_S32K144::TresosProject::Crc_Example_S32K144::config::Mcu.xdm, category=SWCFG
          short-label=examples::EBT::S32K1::Crc_Example_S32K144::TresosProject::Crc_Example_S32K144::config::Resource.xdm, category=SWCFG
          short-label=examples::EBT::S32K1::Crc_Example_S32K144W::generate::epc::BaseNXP.xdm, category=SWCFG
          short-label=examples::EBT::S32K1::Crc_Example_S32K144W::generate::epc::Crc.xdm, category=SWCFG
          short-label=examples::EBT::S32K1::Crc_Example_S32K144W::generate::epc::Mcl.xdm, category=SWCFG
          short-label=examples::EBT::S32K1::Crc_Example_S32K144W::generate::epc::Mcu.xdm, category=SWCFG
          short-label=examples::EBT::S32K1::Crc_Example_S32K144W::generate::epc::Resource.xdm, category=SWCFG
          short-label=examples::EBT::S32K1::Crc_Example_S32K144W::include::check_example.h, category=SWHDR
          short-label=examples::EBT::S32K1::Crc_Example_S32K144W::src::main.c, category=SWSRC
          short-label=examples::EBT::S32K1::Crc_Example_S32K144W::TresosProject::Crc_Example_S32K144W::.prefs::preferences.xdm, category=SWCFG
          short-label=examples::EBT::S32K1::Crc_Example_S32K144W::TresosProject::Crc_Example_S32K144W::config::BaseNXP.xdm, category=SWCFG
          short-label=examples::EBT::S32K1::Crc_Example_S32K144W::TresosProject::Crc_Example_S32K144W::config::Crc.xdm, category=SWCFG
          short-label=examples::EBT::S32K1::Crc_Example_S32K144W::TresosProject::Crc_Example_S32K144W::config::EcuC.xdm, category=SWCFG
          short-label=examples::EBT::S32K1::Crc_Example_S32K144W::TresosProject::Crc_Example_S32K144W::config::Mcl.xdm, category=SWCFG
          short-label=examples::EBT::S32K1::Crc_Example_S32K144W::TresosProject::Crc_Example_S32K144W::config::Mcu.xdm, category=SWCFG
          short-label=examples::EBT::S32K1::Crc_Example_S32K144W::TresosProject::Crc_Example_S32K144W::config::Resource.xdm, category=SWCFG
          short-label=examples::EBT::S32K1::Crc_Example_S32K148::generate::epc::BaseNXP.xdm, category=SWCFG
          short-label=examples::EBT::S32K1::Crc_Example_S32K148::generate::epc::Crc.xdm, category=SWCFG
          short-label=examples::EBT::S32K1::Crc_Example_S32K148::generate::epc::Mcl.xdm, category=SWCFG
          short-label=examples::EBT::S32K1::Crc_Example_S32K148::generate::epc::Mcu.xdm, category=SWCFG
          short-label=examples::EBT::S32K1::Crc_Example_S32K148::generate::epc::Resource.xdm, category=SWCFG
          short-label=examples::EBT::S32K1::Crc_Example_S32K148::include::check_example.h, category=SWHDR
          short-label=examples::EBT::S32K1::Crc_Example_S32K148::src::main.c, category=SWSRC
          short-label=examples::EBT::S32K1::Crc_Example_S32K148::TresosProject::Crc_Example_S32K148::.prefs::preferences.xdm, category=SWCFG
          short-label=examples::EBT::S32K1::Crc_Example_S32K148::TresosProject::Crc_Example_S32K148::config::BaseNXP.xdm, category=SWCFG
          short-label=examples::EBT::S32K1::Crc_Example_S32K148::TresosProject::Crc_Example_S32K148::config::Crc.xdm, category=SWCFG
          short-label=examples::EBT::S32K1::Crc_Example_S32K148::TresosProject::Crc_Example_S32K148::config::EcuC.xdm, category=SWCFG
          short-label=examples::EBT::S32K1::Crc_Example_S32K148::TresosProject::Crc_Example_S32K148::config::Mcl.xdm, category=SWCFG
          short-label=examples::EBT::S32K1::Crc_Example_S32K148::TresosProject::Crc_Example_S32K148::config::Mcu.xdm, category=SWCFG
          short-label=examples::EBT::S32K1::Crc_Example_S32K148::TresosProject::Crc_Example_S32K148::config::Resource.xdm, category=SWCFG
          short-label=examples::S32DS::S32K1::Crc_Example_S32K118::include::check_example.h, category=SWHDR
          short-label=examples::S32DS::S32K1::Crc_Example_S32K118::Project_Settings::Startup_Code::exceptions.c, category=SWSRC
          short-label=examples::S32DS::S32K1::Crc_Example_S32K118::Project_Settings::Startup_Code::nvic.c, category=SWSRC
          short-label=examples::S32DS::S32K1::Crc_Example_S32K118::Project_Settings::Startup_Code::startup.c, category=SWSRC
          short-label=examples::S32DS::S32K1::Crc_Example_S32K118::Project_Settings::Startup_Code::system.c, category=SWSRC
          short-label=examples::S32DS::S32K1::Crc_Example_S32K118::src::main.c, category=SWSRC
          short-label=examples::S32DS::S32K1::Crc_Example_S32K144::include::check_example.h, category=SWHDR
          short-label=examples::S32DS::S32K1::Crc_Example_S32K144::Project_Settings::Startup_Code::exceptions.c, category=SWSRC
          short-label=examples::S32DS::S32K1::Crc_Example_S32K144::Project_Settings::Startup_Code::nvic.c, category=SWSRC
          short-label=examples::S32DS::S32K1::Crc_Example_S32K144::Project_Settings::Startup_Code::startup.c, category=SWSRC
          short-label=examples::S32DS::S32K1::Crc_Example_S32K144::Project_Settings::Startup_Code::system.c, category=SWSRC
          short-label=examples::S32DS::S32K1::Crc_Example_S32K144::src::main.c, category=SWSRC
          short-label=examples::S32DS::S32K1::Crc_Example_S32K144W::include::check_example.h, category=SWHDR
          short-label=examples::S32DS::S32K1::Crc_Example_S32K144W::Project_Settings::Startup_Code::exceptions.c, category=SWSRC
          short-label=examples::S32DS::S32K1::Crc_Example_S32K144W::Project_Settings::Startup_Code::nvic.c, category=SWSRC
          short-label=examples::S32DS::S32K1::Crc_Example_S32K144W::Project_Settings::Startup_Code::startup.c, category=SWSRC
          short-label=examples::S32DS::S32K1::Crc_Example_S32K144W::Project_Settings::Startup_Code::system.c, category=SWSRC
          short-label=examples::S32DS::S32K1::Crc_Example_S32K144W::src::main.c, category=SWSRC
          short-label=examples::S32DS::S32K1::Crc_Example_S32K148::include::check_example.h, category=SWHDR
          short-label=examples::S32DS::S32K1::Crc_Example_S32K148::Project_Settings::Startup_Code::exceptions.c, category=SWSRC
          short-label=examples::S32DS::S32K1::Crc_Example_S32K148::Project_Settings::Startup_Code::nvic.c, category=SWSRC
          short-label=examples::S32DS::S32K1::Crc_Example_S32K148::Project_Settings::Startup_Code::startup.c, category=SWSRC
          short-label=examples::S32DS::S32K1::Crc_Example_S32K148::Project_Settings::Startup_Code::system.c, category=SWSRC
          short-label=examples::S32DS::S32K1::Crc_Example_S32K148::src::main.c, category=SWSRC
          short-label=examples::S32DS::S32K1::Crc_Ip_Example_S32K118::include::check_example.h, category=SWHDR
          short-label=examples::S32DS::S32K1::Crc_Ip_Example_S32K118::Project_Settings::Startup_Code::exceptions.c, category=SWSRC
          short-label=examples::S32DS::S32K1::Crc_Ip_Example_S32K118::Project_Settings::Startup_Code::nvic.c, category=SWSRC
          short-label=examples::S32DS::S32K1::Crc_Ip_Example_S32K118::Project_Settings::Startup_Code::startup.c, category=SWSRC
          short-label=examples::S32DS::S32K1::Crc_Ip_Example_S32K118::Project_Settings::Startup_Code::system.c, category=SWSRC
          short-label=examples::S32DS::S32K1::Crc_Ip_Example_S32K118::src::main.c, category=SWSRC
          short-label=examples::S32DS::S32K1::Crc_Ip_Example_S32K144::include::check_example.h, category=SWHDR
          short-label=examples::S32DS::S32K1::Crc_Ip_Example_S32K144::Project_Settings::Startup_Code::exceptions.c, category=SWSRC
          short-label=examples::S32DS::S32K1::Crc_Ip_Example_S32K144::Project_Settings::Startup_Code::nvic.c, category=SWSRC
          short-label=examples::S32DS::S32K1::Crc_Ip_Example_S32K144::Project_Settings::Startup_Code::startup.c, category=SWSRC
          short-label=examples::S32DS::S32K1::Crc_Ip_Example_S32K144::Project_Settings::Startup_Code::system.c, category=SWSRC
          short-label=examples::S32DS::S32K1::Crc_Ip_Example_S32K144::src::main.c, category=SWSRC
          short-label=examples::S32DS::S32K1::Crc_Ip_Example_S32K144W::include::check_example.h, category=SWHDR
          short-label=examples::S32DS::S32K1::Crc_Ip_Example_S32K144W::Project_Settings::Startup_Code::exceptions.c, category=SWSRC
          short-label=examples::S32DS::S32K1::Crc_Ip_Example_S32K144W::Project_Settings::Startup_Code::nvic.c, category=SWSRC
          short-label=examples::S32DS::S32K1::Crc_Ip_Example_S32K144W::Project_Settings::Startup_Code::startup.c, category=SWSRC
          short-label=examples::S32DS::S32K1::Crc_Ip_Example_S32K144W::Project_Settings::Startup_Code::system.c, category=SWSRC
          short-label=examples::S32DS::S32K1::Crc_Ip_Example_S32K144W::src::main.c, category=SWSRC
          short-label=examples::S32DS::S32K1::Crc_Ip_Example_S32K148::include::check_example.h, category=SWHDR
          short-label=examples::S32DS::S32K1::Crc_Ip_Example_S32K148::Project_Settings::Startup_Code::exceptions.c, category=SWSRC
          short-label=examples::S32DS::S32K1::Crc_Ip_Example_S32K148::Project_Settings::Startup_Code::nvic.c, category=SWSRC
          short-label=examples::S32DS::S32K1::Crc_Ip_Example_S32K148::Project_Settings::Startup_Code::startup.c, category=SWSRC
          short-label=examples::S32DS::S32K1::Crc_Ip_Example_S32K148::Project_Settings::Startup_Code::system.c, category=SWSRC
          short-label=examples::S32DS::S32K1::Crc_Ip_Example_S32K148::src::main.c, category=SWSRC
          short-label=include::CDD_Crc.h, category=SWHDR
          short-label=include::Crc.h, category=SWHDR
          short-label=include::Crc_Ip.h, category=SWHDR
          short-label=include::Crc_Ipw.h, category=SWHDR
          short-label=include::Crc_Ip_Devassert.h, category=SWHDR
          short-label=include::Crc_Ip_Hardware.h, category=SWHDR
          short-label=include::Crc_Ip_Hw_Access.h, category=SWHDR
          short-label=include::Crc_Ip_Lib.h, category=SWHDR
          short-label=include::Crc_Ip_Lookup_Tables.h, category=SWHDR
          short-label=include::Crc_Ip_Lookup_Tables_Slice_By_N.h, category=SWHDR
          short-label=include::Crc_Ip_Software.h, category=SWHDR
          short-label=include::Crc_Ip_State.h, category=SWHDR
          short-label=include::Crc_Ip_TrustedFunctions.h, category=SWHDR
          short-label=include::Crc_Ip_Types.h, category=SWHDR
          short-label=include::Crc_TrustedFunctions.h, category=SWHDR
          short-label=include::Crc_Types.h, category=SWHDR
          short-label=src::CDD_Crc.c, category=SWSRC
          short-label=src::Crc_Ip.c, category=SWSRC
          short-label=src::Crc_Ip_Hardware.c, category=SWSRC
          short-label=src::Crc_Ip_Lookup_Tables.c, category=SWSRC
          short-label=src::Crc_Ip_Software.c, category=SWSRC
    compiler GCC_Compiler:
      name=GCC Compiler
      options=-mcpu=cortex-m4 -mcpu=cortex-m0plus -mthumb -mlittle-endian -mfpu=fpv4-sp-d16 -mfloat-abi=hard -mfpu=auto -mfloat-abi=soft -std=c99 -Os -ggdb3 -Wall -Wextra -pedantic -Wstrict-prototypes -Wundef -Wunused -Werror=implicit-function-declaration -Wsign-compare -Wdouble-promotion -fno-short-enums -funsigned-char -funsigned-bitfields -fomit-frame-pointer -fno-common -fstack-usage -fdump-ipa-all -c -DUSE_SW_VECTOR_MODE -DI_CACHE_ENABLE -DENABLE_FPU -DMCAL_ENABLE_USER_MODE_SUPPORT --sysroot=$(NEWLIB_DIR) -specs=nano.specs -specs=nosys.specs
      vendor=GCC Systems
      version=NXP GCC 10.2.0 20200723 (Build 1728 Revision g5963bc8)
    compiler GHS_Compiler:
      name=Green Hills
      options=-cpu=cortexm4 -cpu=cortexm0plus -thumb -fpu=vfpv4_d16 -fsingle -fsoft -C99 --ghstd=last -Osize --gnu_asm -dual_debug -G -keeptempfiles -Wimplicit-int -Wshadow -Wtrigraphs -Wundef --unsigned_chars --unsigned_fields --no_commons --no_exceptions --no_slash_comment --prototype_errors --incorrect_pragma_warnings -c -DUSE_SW_VECTOR_MODE -DI_CACHE_ENABLE -DENABLE_FPU -DMCAL_ENABLE_USER_MODE_SUPPORT
      vendor=Green Hills
      version=Green Hills Multi 7.1.6d / Compiler 2020.1.4
    compiler IAR_Compiler:
      name=IAR Compiler
      options=--cpu=Cortex-M4 --cpu=Cortex-M0+ --cpu_mode=thumb --endian=little --fpu=FPv4-SP --fpu=none -e -Ohz --debug --no_clustering --no_mem_idioms --no_explicit_zero_opt --require_prototypes --no_wrap_diagnostics --diag_suppress=Pa050 -DIAR -DUSE_SW_VECTOR_MODE -DI_CACHE_ENABLE -DENABLE_FPU -DMCAL_ENABLE_USER_MODE_SUPPORT
      vendor=IAR Systems
      version=IAR ANSI C/C++ Compiler V8.40.3.228/W32 for ARM Functional Safety
    generated-artifacts:
      5 x dependency on artifact, all with usages=COMPILE:
        Crc_Cfg_h: artifact-descriptor={short-label=generate_PC::include::Crc_Cfg.h, category=SWHDR}
        Crc_Ip_Cfg_h: artifact-descriptor={short-label=generate_PC::include::Crc_Ip_Cfg.h, category=SWHDR}
        Crc_Ip_CfgDefines_h: artifact-descriptor={short-label=generate_PC::include::Crc_Ip_CfgDefines.h, category=SWHDR}
        Crc_Cfg_c: artifact-descriptor={short-label=generate_PC::src::Crc_Cfg.c, category=SWSRC}
        Crc_Ip_Cfg_c: artifact-descriptor={short-label=generate_PC::src::Crc_Ip_Cfg.c, category=SWSRC}
    linker GCC_Linker: name=GCC Compiler, options=-Wl,-Map,filename -T linkerfile --entry=Reset_Handler -nostartfiles -mcpu=cortex-m4 -mcpu=cortex-m0plus -mthumb -mfpu=fpv4-sp-d16 -mfloat-abi=hard -mfpu=auto -mfloat-abi=soft -mlittle-endian -ggdb3 -lc -lm -lgcc -n --sysroot=$(NEWLIB_DIR) -specs=nano.specs -specs=nosys.specs, vendor=GCC Systems, version=NXP GCC 10.2.0 20200723 (Build 1728 Revision g5963bc8)
    linker GHS_Linker: name=Green Hills, options=-e Reset_Handler -T linker_script_file.ld -map -keepmap -Mn -delete -ignore_debug_references -Llibrary_path -larch -lstartup -lind_sd -lind_sf -v -keep=C40_Ip_AccessCode -nostartfiles, vendor=Green Hills, version=Green Hills Multi 7.1.6d / Compiler 2020.1.4
    linker IAR_Linker: name=IAR Compiler, options=--map filename --config linkerfile --cpu=Cortex-M4 --cpu=Cortex-M0+ --fpu=FPv4-SP --fpu=none --entry _start --enable_stack_usage --skip_dynamic_initialization --no_wrap_diagnostics, vendor=IAR Systems, version=IAR ANSI C/C++ Compiler V8.40.3.228/W32 for ARM Functional Safety
    resource consumption ResourceConsumption
      10 x memory section:
        CRC_CODE: alignment=UNSPECIFIED, sw-addrmethod=CODE, symbol=CODE
        CRC_CONFIG_DATA_32: alignment=32, sw-addrmethod=CONFIG_DATA, symbol=CONFIG_DATA_32
        CRC_CONFIG_DATA_UNSPECIFIED: alignment=UNSPECIFIED, sw-addrmethod=CONFIG_DATA, symbol=CONFIG_DATA_UNSPECIFIED
        CRC_CONST_16: alignment=16, sw-addrmethod=CONST, symbol=CONST_16
        CRC_CONST_32: alignment=32, sw-addrmethod=CONST, symbol=CONST_32
        CRC_CONST_8: alignment=8, sw-addrmethod=CONST, symbol=CONST_8
        CRC_CONST_UNSPECIFIED: alignment=UNSPECIFIED, sw-addrmethod=CONST, symbol=CONST_UNSPECIFIED
        CRC_VAR_CLEARED_8: alignment=8, sw-addrmethod=VAR_CLEARED, symbol=VAR_CLEARED_8
        CRC_VAR_CLEARED_UNSPECIFIED_NO_CACHEABLE: alignment=UNSPECIFIED, sw-addrmethod=VAR_CLEARED_NO_CACHEABLE, symbol=VAR_CLEARED_UNSPECIFIED_NO_CACHEABLE
        CRC_VAR_INIT_UNSPECIFIED: alignment=UNSPECIFIED, sw-addrmethod=VAR_INIT, symbol=VAR_INIT_UNSPECIFIED
