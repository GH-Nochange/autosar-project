AUTOSAR XML (schema 00050)
package /AUTOSAR_Ocotp/BswModuleDescriptions
  bsw module description Ocotp: module-id=255, provided-entrys=Ocotp_ReadEFuse
    bsw internal behavior InternalBehavior_0
      bsw called entity Ocotp_ReadEFuse: implemented-entry=Ocotp_ReadEFuse
package /AUTOSAR_Ocotp/BswModuleEntrys
  bsw module entry Ocotp_ReadEFuse: service-id=0x04, is-reentrant=false, is-synchronous=true, call-type=REGULAR, execution-context=UNSPECIFIED, sw-service-impl-policy=STANDARD
package /Ocotp_TS_T40D2M30I0R0/Implementations
  bsw implementation BswImplementation_0: programming-language=C, sw-version=3.0.0_QLP02, vendor-id=43, ar-release-version=4.7.0, behavior=InternalBehavior_0, vendor-specific-module-def=Ocotp
    code-descriptors:
      code Files
        artifact-descriptors:
          short-label=config::Ocotp.xdm, category=SWCFG
          short-label=doc::RTD_OCOTP_IM.pdf, category=SWDOC
          short-label=doc::RTD_OCOTP_UM.pdf, category=SWDOC
          short-label=examples::EBT::S32M24::Ocotp_Example_S32M244::generate::epc::Ae.xdm, category=SWCFG
          short-label=examples::EBT::S32M24::Ocotp_Example_S32M244::generate::epc::BaseNXP.xdm, category=SWCFG
          short-label=examples::EBT::S32M24::Ocotp_Example_S32M244::generate::epc::EcuC.xdm, category=SWCFG
          short-label=examples::EBT::S32M24::Ocotp_Example_S32M244::generate::epc::Mcu.xdm, category=SWCFG
          short-label=examples::EBT::S32M24::Ocotp_Example_S32M244::generate::epc::Ocotp.xdm, category=SWCFG
          short-label=examples::EBT::S32M24::Ocotp_Example_S32M244::generate::epc::Platform.xdm, category=SWCFG
          short-label=examples::EBT::S32M24::Ocotp_Example_S32M244::generate::epc::Port.xdm, category=SWCFG
          short-label=examples::EBT::S32M24::Ocotp_Example_S32M244::generate::epc::Resource.xdm, category=SWCFG
          short-label=examples::EBT::S32M24::Ocotp_Example_S32M244::generate::epc::Spi.xdm, category=SWCFG
          short-label=examples::EBT::S32M24::Ocotp_Example_S32M244::include::check_example.h, category=SWHDR
          short-label=examples::EBT::S32M24::Ocotp_Example_S32M244::src::main.c, category=SWSRC
          short-label=examples::EBT::S32M24::Ocotp_Example_S32M244::TresosProject::Ocotp_Example_S32M244::.prefs::preferences.xdm, category=SWCFG
          short-label=examples::EBT::S32M24::Ocotp_Example_S32M244::TresosProject::Ocotp_Example_S32M244::config::Ae.xdm, category=SWCFG
          short-label=examples::EBT::S32M24::Ocotp_Example_S32M244::TresosProject::Ocotp_Example_S32M244::config::BaseNXP.xdm, category=SWCFG
          short-label=examples::EBT::S32M24::Ocotp_Example_S32M244::TresosProject::Ocotp_Example_S32M244::config::EcuC.xdm, category=SWCFG
          short-label=examples::EBT::S32M24::Ocotp_Example_S32M244::TresosProject::Ocotp_Example_S32M244::config::Mcu.xdm, category=SWCFG
          short-label=examples::EBT::S32M24::Ocotp_Example_S32M244::TresosProject::Ocotp_Example_S32M244::config::Ocotp.xdm, category=SWCFG
          short-label=examples::EBT::S32M24::Ocotp_Example_S32M244::TresosProject::Ocotp_Example_S32M244::config::Platform.xdm, category=SWCFG
          short-label=examples::EBT::S32M24::Ocotp_Example_S32M244::TresosProject::Ocotp_Example_S32M244::config::Port.xdm, category=SWCFG
          short-label=examples::EBT::S32M24::Ocotp_Example_S32M244::TresosProject::Ocotp_Example_S32M244::config::Resource.xdm, category=SWCFG
          short-label=examples::EBT::S32M24::Ocotp_Example_S32M244::TresosProject::Ocotp_Example_S32M244::config::Spi.xdm, category=SWCFG
          short-label=examples::S32DS::S32M24::Mem_Otp_Ip_Example_S32M244::include::check_example.h, category=SWHDR
          short-label=examples::S32DS::S32M24::Mem_Otp_Ip_Example_S32M244::Project_Settings::Startup_Code::exceptions.c, category=SWSRC
          short-label=examples::S32DS::S32M24::Mem_Otp_Ip_Example_S32M244::Project_Settings::Startup_Code::nvic.c, category=SWSRC
          short-label=examples::S32DS::S32M24::Mem_Otp_Ip_Example_S32M244::Project_Settings::Startup_Code::startup.c, category=SWSRC
          short-label=examples::S32DS::S32M24::Mem_Otp_Ip_Example_S32M244::Project_Settings::Startup_Code::system.c, category=SWSRC
          short-label=examples::S32DS::S32M24::Mem_Otp_Ip_Example_S32M244::src::main.c, category=SWSRC
          short-label=examples::S32DS::S32M24::Ocotp_Example_S32M244::include::check_example.h, category=SWHDR
          short-label=examples::S32DS::S32M24::Ocotp_Example_S32M244::Project_Settings::Startup_Code::exceptions.c, category=SWSRC
          short-label=examples::S32DS::S32M24::Ocotp_Example_S32M244::Project_Settings::Startup_Code::nvic.c, category=SWSRC
          short-label=examples::S32DS::S32M24::Ocotp_Example_S32M244::Project_Settings::Startup_Code::startup.c, category=SWSRC
          short-label=examples::S32DS::S32M24::Ocotp_Example_S32M244::Project_Settings::Startup_Code::system.c, category=SWSRC
          short-label=examples::S32DS::S32M24::Ocotp_Example_S32M244::src::main.c, category=SWSRC
          short-label=include::CDD_Ocotp.h, category=SWHDR
          short-label=include::Mem_Otp_Ip.h, category=SWHDR
          short-label=include::Mem_Otp_Ip_Defines.h, category=SWHDR
          short-label=include::Mem_Otp_Ip_Types.h, category=SWHDR
          short-label=include::Ocotp_IPW.h, category=SWHDR
          short-label=include::Ocotp_Types.h, category=SWHDR
          short-label=src::CDD_Ocotp.c, category=SWSRC
          short-label=src::Mem_Otp_Ip.c, category=SWSRC
          short-label=src::Ocotp_IPW.c, category=SWSRC
    compiler GCC_Compiler:
      name=GCC Compiler
      options=-mcpu=cortex-m4 -mcpu=cortex-m0plus -mthumb -mlittle-endian -mfpu=fpv4-sp-d16 -mfloat-abi=hard -mfpu=auto -mfloat-abi=soft -std=c99 -Os -ggdb3 -Wall -Wextra -pedantic -Wstrict-prototypes -Wundef -Wunused -Werror=implicit-function-declaration -Wsign-compare -Wdouble-promotion -fno-short-enums -funsigned-char -funsigned-bitfields -fomit-frame-pointer -fno-common -fstack-usage -fdump-ipa-all -c -DUSE_SW_VECTOR_MODE -DI_CACHE_ENABLE -DENABLE_FPU -DMCAL_ENABLE_USER_MODE_SUPPORT --sysroot=$(NEWLIB_DIR) -specs=nano.specs -specs=nosys.specs
      vendor=GCC Systems
      version=NXP GCC 10.2.0 20200723 (Build 1728 Revision g5963bc8)
    compiler GHS_Compiler:
      name=Green Hills
      options=-cpu=cortexm4 -cpu=cortexm0plus -thumb -fpu=vfpv4_d16 -fsingle -fsoft -C99 --ghstd=last -Osize --gnu_asm -dual_debug -G -keeptempfiles -Wimplicit-int -Wshadow -Wtrigraphs -Wundef --unsigned_chars --unsigned_fields --no_commons --no_exceptions --no_slash_comment --prototype_errors --incorrect_pragma_warnings -c -DUSE_SW_VECTOR_MODE -DI_CACHE_ENABLE -DENABLE_FPU -DMCAL_ENABLE_USER_MODE_SUPPORT
      vendor=Green Hills
      version=Green Hills Multi 7.1.6d / Compiler 2020.1.4
    compiler IAR_Compiler:
      name=IAR Compiler
      options=--cpu=Cortex-M4 --cpu=Cortex-M0+ --cpu_mode=thumb --endian=little --fpu=FPv4-SP --fpu=none -e -Ohz --debug --no_clustering --no_mem_idioms --no_explicit_zero_opt --require_prototypes --no_wrap_diagnostics --diag_suppress=Pa050 -DIAR -DUSE_SW_VECTOR_MODE -DI_CACHE_ENABLE -DENABLE_FPU -DMCAL_ENABLE_USER_MODE_SUPPORT
      vendor=IAR Systems
      version=IAR ANSI C/C++ Compiler V8.40.3.228/W32 for ARM Functional Safety
    generated-artifacts:
      6 x dependency on artifact:
        Ocotp_PBcfg_h: artifact-descriptor={short-label=generate_PB::include::Ocotp_PBcfg.h, category=SWHDR}, usages=EXECUTE
        Mem_Otp_Ip_PBcfg_c: artifact-descriptor={short-label=generate_PB::src::Mem_Otp_Ip_PBcfg.c, category=SWSRC}, usages=EXECUTE
        Ocotp_PBcfg_c: artifact-descriptor={short-label=generate_PB::src::Ocotp_PBcfg.c, category=SWSRC}, usages=EXECUTE
        Mem_Otp_Ip_Cfg_h: artifact-descriptor={short-label=generate_PC::include::Mem_Otp_Ip_Cfg.h, category=SWHDR}, usages=COMPILE
        Ocotp_Cfg_h: artifact-descriptor={short-label=generate_PC::include::Ocotp_Cfg.h, category=SWHDR}, usages=COMPILE
        Ocotp_Cfg_c: artifact-descriptor={short-label=generate_PC::src::Ocotp_Cfg.c, category=SWSRC}, usages=COMPILE
    linker GCC_Linker: name=GCC Compiler, options=-Wl,-Map,filename -T linkerfile --entry=Reset_Handler -nostartfiles -mcpu=cortex-m4 -mcpu=cortex-m0plus -mthumb -mfpu=fpv4-sp-d16 -mfloat-abi=hard -mfpu=auto -mfloat-abi=soft -mlittle-endian -ggdb3 -lc -lm -lgcc -n --sysroot=$(NEWLIB_DIR) -specs=nano.specs -specs=nosys.specs, vendor=GCC Systems, version=NXP GCC 10.2.0 20200723 (Build 1728 Revision g5963bc8)
    linker GHS_Linker: name=Green Hills, options=-e Reset_Handler -T linker_script_file.ld -map -keepmap -Mn -delete -ignore_debug_references -Llibrary_path -larch -lstartup -lind_sd -lind_sf -v -keep=C40_Ip_AccessCode -nostartfiles, vendor=Green Hills, version=Green Hills Multi 7.1.6d / Compiler 2020.1.4
    linker IAR_Linker: name=IAR Compiler, options=--map filename --config linkerfile --cpu=Cortex-M4 --cpu=Cortex-M0+ --fpu=FPv4-SP --fpu=none --entry _start --enable_stack_usage --skip_dynamic_initialization --no_wrap_diagnostics, vendor=IAR Systems, version=IAR ANSI C/C++ Compiler V8.40.3.228/W32 for ARM Functional Safety
    resource consumption ResourceConsumption
      4 x memory section, all with alignment=UNSPECIFIED:
        OCOTP_CODE: sw-addrmethod=CODE, symbol=CODE
        OCOTP_CONFIG_DATA_UNSPECIFIED: sw-addrmethod=CONFIG_DATA, symbol=CONFIG_DATA_UNSPECIFIED
        OCOTP_VAR_CLEARED_UNSPECIFIED_NO_CACHEABLE: sw-addrmethod=VAR_CLEARED_NO_CACHEABLE, symbol=VAR_CLEARED_UNSPECIFIED_NO_CACHEABLE
        OCOTP_VAR_INIT_UNSPECIFIED: sw-addrmethod=VAR_INIT, symbol=VAR_INIT_UNSPECIFIED
