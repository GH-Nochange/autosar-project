AUTOSAR XML (schema 00050)
package /AUTOSAR_Ocu/BswModuleDescriptions
  bsw module description Ocu: module-id=125
    provided-entrys:
      Ftm_Ocu_Ip_SetClockMode
      Ocu_DeInit
      Ocu_DisableNotification
      Ocu_EnableNotification
      Ocu_GetCounter
      Ocu_GetVersionInfo
      Ocu_Init
      Ocu_SetAbsoluteThreshold
      Ocu_SetClockMode
      Ocu_SetPinAction
      Ocu_SetPinState
      Ocu_SetRelativeThreshold
      Ocu_StartChannel
      Ocu_StopChannel
      FTM_0_CH_0_CH_1_ISR
      FTM_0_CH_0_ISR
      FTM_0_CH_1_ISR
      FTM_0_CH_2_CH_3_ISR
      FTM_0_CH_2_ISR
      FTM_0_CH_3_ISR
      FTM_0_CH_4_CH_5_ISR
      FTM_0_CH_4_ISR
      FTM_0_CH_5_ISR
      FTM_0_CH_6_CH_7_ISR
      FTM_0_ISR
      FTM_1_CH_0_CH_1_ISR
      FTM_1_CH_0_ISR
      FTM_1_CH_1_ISR
      FTM_1_CH_2_CH_3_ISR
      FTM_1_CH_2_ISR
      FTM_1_CH_3_ISR
      FTM_1_CH_4_CH_5_ISR
      FTM_1_CH_4_ISR
      FTM_1_CH_5_ISR
      FTM_1_CH_6_CH_7_ISR
      FTM_1_ISR
      FTM_2_CH_0_CH_1_ISR
      FTM_2_CH_0_ISR
      FTM_2_CH_1_ISR
      FTM_2_CH_2_CH_3_ISR
      FTM_2_CH_2_ISR
      FTM_2_CH_3_ISR
      FTM_2_CH_4_CH_5_ISR
      FTM_2_CH_4_ISR
      FTM_2_CH_5_ISR
      FTM_2_CH_6_CH_7_ISR
      FTM_3_CH_0_CH_1_ISR
      FTM_3_CH_0_ISR
      FTM_3_CH_1_ISR
      FTM_3_CH_2_CH_3_ISR
      FTM_3_CH_2_ISR
      FTM_3_CH_3_ISR
      FTM_3_CH_4_CH_5_ISR
      FTM_3_CH_4_ISR
      FTM_3_CH_5_ISR
      FTM_3_CH_6_CH_7_ISR
      FTM_4_CH_0_CH_1_ISR
      FTM_4_CH_0_ISR
      FTM_4_CH_1_ISR
      FTM_4_CH_2_CH_3_ISR
      FTM_4_CH_2_ISR
      FTM_4_CH_3_ISR
      FTM_4_CH_4_CH_5_ISR
      FTM_4_CH_4_ISR
      FTM_4_CH_5_ISR
      FTM_4_CH_6_CH_7_ISR
      FTM_4_ISR
      FTM_5_CH_0_CH_1_ISR
      FTM_5_CH_0_ISR
      FTM_5_CH_1_ISR
      FTM_5_CH_2_CH_3_ISR
      FTM_5_CH_2_ISR
      FTM_5_CH_3_ISR
      FTM_5_CH_4_CH_5_ISR
      FTM_5_CH_4_ISR
      FTM_5_CH_5_ISR
      FTM_5_CH_6_CH_7_ISR
      FTM_5_ISR
      FTM_6_CH_0_CH_1_ISR
      FTM_6_CH_2_CH_3_ISR
      FTM_6_CH_4_CH_5_ISR
      FTM_6_CH_6_CH_7_ISR
      FTM_7_CH_0_CH_1_ISR
      FTM_7_CH_2_CH_3_ISR
      FTM_7_CH_4_CH_5_ISR
      FTM_7_CH_6_CH_7_ISR
    bsw internal behavior InternalBehavior_0
      6 x exclusive area:
        OCU_EXCLUSIVE_AREA_{10..15}
      14 x bsw called entity:
        Ftm_Ocu_Ip_SetClockMode: implemented-entry=Ftm_Ocu_Ip_SetClockMode
        Ocu_DeInit: implemented-entry=Ocu_DeInit
        Ocu_DisableNotification: implemented-entry=Ocu_DisableNotification
        Ocu_EnableNotification: implemented-entry=Ocu_EnableNotification
        Ocu_GetCounter: implemented-entry=Ocu_GetCounter
        Ocu_GetVersionInfo: implemented-entry=Ocu_GetVersionInfo
        Ocu_Init: implemented-entry=Ocu_Init
        Ocu_SetAbsoluteThreshold: implemented-entry=Ocu_SetAbsoluteThreshold
        Ocu_SetClockMode: implemented-entry=Ocu_SetClockMode
        Ocu_SetPinAction: can-enter-exclusive-area=OCU_EXCLUSIVE_AREA_13, implemented-entry=Ocu_SetPinAction
        Ocu_SetPinState: can-enter-exclusive-area=OCU_EXCLUSIVE_AREA_14, implemented-entry=Ocu_SetPinState
        Ocu_SetRelativeThreshold: implemented-entry=Ocu_SetRelativeThreshold
        Ocu_StartChannel: can-enter-exclusive-area=OCU_EXCLUSIVE_AREA_11, implemented-entry=Ocu_StartChannel
        Ocu_StopChannel: can-enter-exclusive-area=OCU_EXCLUSIVE_AREA_12, implemented-entry=Ocu_StopChannel
      72 x bsw interrupt entity, all with interrupt-category=CAT-2, interrupt-source=Hardware:
        FTM_0_CH_0_CH_1_ISR: can-enter-exclusive-area=[OCU_EXCLUSIVE_AREA_10, OCU_EXCLUSIVE_AREA_15], implemented-entry=FTM_0_CH_0_CH_1_ISR
        FTM_0_CH_0_ISR: implemented-entry=FTM_0_CH_0_ISR
        FTM_0_CH_1_ISR: implemented-entry=FTM_0_CH_1_ISR
        FTM_0_CH_2_CH_3_ISR: can-enter-exclusive-area=[OCU_EXCLUSIVE_AREA_10, OCU_EXCLUSIVE_AREA_15], implemented-entry=FTM_0_CH_2_CH_3_ISR
        FTM_0_CH_2_ISR: implemented-entry=FTM_0_CH_2_ISR
        FTM_0_CH_3_ISR: implemented-entry=FTM_0_CH_3_ISR
        FTM_0_CH_4_CH_5_ISR: can-enter-exclusive-area=[OCU_EXCLUSIVE_AREA_10, OCU_EXCLUSIVE_AREA_15], implemented-entry=FTM_0_CH_4_CH_5_ISR
        FTM_0_CH_4_ISR: implemented-entry=FTM_0_CH_4_ISR
        FTM_0_CH_5_ISR: implemented-entry=FTM_0_CH_5_ISR
        FTM_0_CH_6_CH_7_ISR: can-enter-exclusive-area=[OCU_EXCLUSIVE_AREA_10, OCU_EXCLUSIVE_AREA_15], implemented-entry=FTM_0_CH_6_CH_7_ISR
        FTM_0_ISR: implemented-entry=FTM_0_ISR
        FTM_1_CH_0_CH_1_ISR: can-enter-exclusive-area=[OCU_EXCLUSIVE_AREA_10, OCU_EXCLUSIVE_AREA_15], implemented-entry=FTM_1_CH_0_CH_1_ISR
        FTM_1_CH_0_ISR: implemented-entry=FTM_1_CH_0_ISR
        FTM_1_CH_1_ISR: implemented-entry=FTM_1_CH_1_ISR
        FTM_1_CH_2_CH_3_ISR: can-enter-exclusive-area=[OCU_EXCLUSIVE_AREA_10, OCU_EXCLUSIVE_AREA_15], implemented-entry=FTM_1_CH_2_CH_3_ISR
        FTM_1_CH_2_ISR: implemented-entry=FTM_1_CH_2_ISR
        FTM_1_CH_3_ISR: implemented-entry=FTM_1_CH_3_ISR
        FTM_1_CH_4_CH_5_ISR: can-enter-exclusive-area=[OCU_EXCLUSIVE_AREA_10, OCU_EXCLUSIVE_AREA_15], implemented-entry=FTM_1_CH_4_CH_5_ISR
        FTM_1_CH_4_ISR: implemented-entry=FTM_1_CH_4_ISR
        FTM_1_CH_5_ISR: implemented-entry=FTM_1_CH_5_ISR
        FTM_1_CH_6_CH_7_ISR: can-enter-exclusive-area=[OCU_EXCLUSIVE_AREA_10, OCU_EXCLUSIVE_AREA_15], implemented-entry=FTM_1_CH_6_CH_7_ISR
        FTM_1_ISR: implemented-entry=FTM_1_ISR
        FTM_2_CH_0_CH_1_ISR: can-enter-exclusive-area=[OCU_EXCLUSIVE_AREA_10, OCU_EXCLUSIVE_AREA_15], implemented-entry=FTM_2_CH_0_CH_1_ISR
        FTM_2_CH_0_ISR: implemented-entry=FTM_2_CH_0_ISR
        FTM_2_CH_1_ISR: implemented-entry=FTM_2_CH_1_ISR
        FTM_2_CH_2_CH_3_ISR: can-enter-exclusive-area=[OCU_EXCLUSIVE_AREA_10, OCU_EXCLUSIVE_AREA_15], implemented-entry=FTM_2_CH_2_CH_3_ISR
        FTM_2_CH_2_ISR: implemented-entry=FTM_2_CH_2_ISR
        FTM_2_CH_3_ISR: implemented-entry=FTM_2_CH_3_ISR
        FTM_2_CH_4_CH_5_ISR: can-enter-exclusive-area=[OCU_EXCLUSIVE_AREA_10, OCU_EXCLUSIVE_AREA_15], implemented-entry=FTM_2_CH_4_CH_5_ISR
        FTM_2_CH_4_ISR: implemented-entry=FTM_2_CH_4_ISR
        FTM_2_CH_5_ISR: implemented-entry=FTM_2_CH_5_ISR
        FTM_2_CH_6_CH_7_ISR: can-enter-exclusive-area=[OCU_EXCLUSIVE_AREA_10, OCU_EXCLUSIVE_AREA_15], implemented-entry=FTM_2_CH_6_CH_7_ISR
        FTM_3_CH_0_CH_1_ISR: can-enter-exclusive-area=[OCU_EXCLUSIVE_AREA_10, OCU_EXCLUSIVE_AREA_15], implemented-entry=FTM_3_CH_0_CH_1_ISR
        FTM_3_CH_0_ISR: implemented-entry=FTM_3_CH_0_ISR
        FTM_3_CH_1_ISR: implemented-entry=FTM_3_CH_1_ISR
        FTM_3_CH_2_CH_3_ISR: can-enter-exclusive-area=[OCU_EXCLUSIVE_AREA_10, OCU_EXCLUSIVE_AREA_15], implemented-entry=FTM_3_CH_2_CH_3_ISR
        FTM_3_CH_2_ISR: implemented-entry=FTM_3_CH_2_ISR
        FTM_3_CH_3_ISR: implemented-entry=FTM_3_CH_3_ISR
        FTM_3_CH_4_CH_5_ISR: can-enter-exclusive-area=[OCU_EXCLUSIVE_AREA_10, OCU_EXCLUSIVE_AREA_15], implemented-entry=FTM_3_CH_4_CH_5_ISR
        FTM_3_CH_4_ISR: implemented-entry=FTM_3_CH_4_ISR
        FTM_3_CH_5_ISR: implemented-entry=FTM_3_CH_5_ISR
        FTM_3_CH_6_CH_7_ISR: can-enter-exclusive-area=[OCU_EXCLUSIVE_AREA_10, OCU_EXCLUSIVE_AREA_15], implemented-entry=FTM_3_CH_6_CH_7_ISR
        FTM_4_CH_0_CH_1_ISR: can-enter-exclusive-area=[OCU_EXCLUSIVE_AREA_10, OCU_EXCLUSIVE_AREA_15], implemented-entry=FTM_4_CH_0_CH_1_ISR
        FTM_4_CH_0_ISR: implemented-entry=FTM_4_CH_0_ISR
        FTM_4_CH_1_ISR: implemented-entry=FTM_4_CH_1_ISR
        FTM_4_CH_2_CH_3_ISR: can-enter-exclusive-area=[OCU_EXCLUSIVE_AREA_10, OCU_EXCLUSIVE_AREA_15], implemented-entry=FTM_4_CH_2_CH_3_ISR
        FTM_4_CH_2_ISR: implemented-entry=FTM_4_CH_2_ISR
        FTM_4_CH_3_ISR: implemented-entry=FTM_4_CH_3_ISR
        FTM_4_CH_4_CH_5_ISR: can-enter-exclusive-area=[OCU_EXCLUSIVE_AREA_10, OCU_EXCLUSIVE_AREA_15], implemented-entry=FTM_4_CH_4_CH_5_ISR
        FTM_4_CH_4_ISR: implemented-entry=FTM_4_CH_4_ISR
        FTM_4_CH_5_ISR: implemented-entry=FTM_4_CH_5_ISR
        FTM_4_CH_6_CH_7_ISR: can-enter-exclusive-area=[OCU_EXCLUSIVE_AREA_10, OCU_EXCLUSIVE_AREA_15], implemented-entry=FTM_4_CH_6_CH_7_ISR
        FTM_4_ISR: implemented-entry=FTM_4_ISR
        FTM_5_CH_0_CH_1_ISR: can-enter-exclusive-area=[OCU_EXCLUSIVE_AREA_10, OCU_EXCLUSIVE_AREA_15], implemented-entry=FTM_5_CH_0_CH_1_ISR
        FTM_5_CH_0_ISR: implemented-entry=FTM_5_CH_0_ISR
        FTM_5_CH_1_ISR: implemented-entry=FTM_5_CH_1_ISR
        FTM_5_CH_2_CH_3_ISR: can-enter-exclusive-area=[OCU_EXCLUSIVE_AREA_10, OCU_EXCLUSIVE_AREA_15], implemented-entry=FTM_5_CH_2_CH_3_ISR
        FTM_5_CH_2_ISR: implemented-entry=FTM_5_CH_2_ISR
        FTM_5_CH_3_ISR: implemented-entry=FTM_5_CH_3_ISR
        FTM_5_CH_4_CH_5_ISR: can-enter-exclusive-area=[OCU_EXCLUSIVE_AREA_10, OCU_EXCLUSIVE_AREA_15], implemented-entry=FTM_5_CH_4_CH_5_ISR
        FTM_5_CH_4_ISR: implemented-entry=FTM_5_CH_4_ISR
        FTM_5_CH_5_ISR: implemented-entry=FTM_5_CH_5_ISR
        FTM_5_CH_6_CH_7_ISR: can-enter-exclusive-area=[OCU_EXCLUSIVE_AREA_10, OCU_EXCLUSIVE_AREA_15], implemented-entry=FTM_5_CH_6_CH_7_ISR
        FTM_5_ISR: implemented-entry=FTM_5_ISR
        FTM_6_CH_0_CH_1_ISR: can-enter-exclusive-area=[OCU_EXCLUSIVE_AREA_10, OCU_EXCLUSIVE_AREA_15], implemented-entry=FTM_6_CH_0_CH_1_ISR
        FTM_6_CH_2_CH_3_ISR: can-enter-exclusive-area=[OCU_EXCLUSIVE_AREA_10, OCU_EXCLUSIVE_AREA_15], implemented-entry=FTM_6_CH_2_CH_3_ISR
        FTM_6_CH_4_CH_5_ISR: can-enter-exclusive-area=[OCU_EXCLUSIVE_AREA_10, OCU_EXCLUSIVE_AREA_15], implemented-entry=FTM_6_CH_4_CH_5_ISR
        FTM_6_CH_6_CH_7_ISR: can-enter-exclusive-area=[OCU_EXCLUSIVE_AREA_10, OCU_EXCLUSIVE_AREA_15], implemented-entry=FTM_6_CH_6_CH_7_ISR
        FTM_7_CH_0_CH_1_ISR: can-enter-exclusive-area=[OCU_EXCLUSIVE_AREA_10, OCU_EXCLUSIVE_AREA_15], implemented-entry=FTM_7_CH_0_CH_1_ISR
        FTM_7_CH_2_CH_3_ISR: can-enter-exclusive-area=[OCU_EXCLUSIVE_AREA_10, OCU_EXCLUSIVE_AREA_15], implemented-entry=FTM_7_CH_2_CH_3_ISR
        FTM_7_CH_4_CH_5_ISR: can-enter-exclusive-area=[OCU_EXCLUSIVE_AREA_10, OCU_EXCLUSIVE_AREA_15], implemented-entry=FTM_7_CH_4_CH_5_ISR
        FTM_7_CH_6_CH_7_ISR: can-enter-exclusive-area=[OCU_EXCLUSIVE_AREA_10, OCU_EXCLUSIVE_AREA_15], implemented-entry=FTM_7_CH_6_CH_7_ISR
package /AUTOSAR_Ocu/BswModuleEntrys
  86 x bsw module entry, all with is-synchronous=true, sw-service-impl-policy=STANDARD:
    Ftm_Ocu_Ip_SetClockMode: service-id=0x7b, is-reentrant=false, call-type=REGULAR, execution-context=UNSPECIFIED
    Ocu_DeInit: service-id=0x01, is-reentrant=false, call-type=REGULAR, execution-context=UNSPECIFIED
    Ocu_DisableNotification: service-id=0x0a, is-reentrant=false, call-type=REGULAR, execution-context=UNSPECIFIED
    Ocu_EnableNotification: service-id=0x0b, is-reentrant=false, call-type=REGULAR, execution-context=UNSPECIFIED
    Ocu_GetCounter: service-id=0x06, is-reentrant=true, call-type=REGULAR, execution-context=UNSPECIFIED
    Ocu_GetVersionInfo: service-id=0x09, is-reentrant=true, call-type=REGULAR, execution-context=UNSPECIFIED
    Ocu_Init: service-id=0x00, is-reentrant=false, call-type=REGULAR, execution-context=UNSPECIFIED
    Ocu_SetAbsoluteThreshold: service-id=0x07, is-reentrant=false, call-type=REGULAR, execution-context=UNSPECIFIED
    Ocu_SetClockMode: service-id=0x7a, is-reentrant=false, call-type=REGULAR, execution-context=UNSPECIFIED
    Ocu_SetPinAction: service-id=0x05, is-reentrant=false, call-type=REGULAR, execution-context=UNSPECIFIED
    Ocu_SetPinState: service-id=0x04, is-reentrant=false, call-type=REGULAR, execution-context=UNSPECIFIED
    Ocu_SetRelativeThreshold: service-id=0x08, is-reentrant=false, call-type=REGULAR, execution-context=UNSPECIFIED
    Ocu_StartChannel: service-id=0x02, is-reentrant=false, call-type=REGULAR, execution-context=UNSPECIFIED
    Ocu_StopChannel: service-id=0x03, is-reentrant=false, call-type=REGULAR, execution-context=UNSPECIFIED
    FTM_0_CH_0_CH_1_ISR: service-id=0, is-reentrant=false, call-type=INTERRUPT, execution-context=INTERRUPT-CAT-2
    FTM_0_CH_0_ISR: service-id=0, is-reentrant=false, call-type=INTERRUPT, execution-context=INTERRUPT-CAT-2
    FTM_0_CH_1_ISR: service-id=0, is-reentrant=false, call-type=INTERRUPT, execution-context=INTERRUPT-CAT-2
    FTM_0_CH_2_CH_3_ISR: service-id=0, is-reentrant=false, call-type=INTERRUPT, execution-context=INTERRUPT-CAT-2
    FTM_0_CH_2_ISR: service-id=0, is-reentrant=false, call-type=INTERRUPT, execution-context=INTERRUPT-CAT-2
    FTM_0_CH_3_ISR: service-id=0, is-reentrant=false, call-type=INTERRUPT, execution-context=INTERRUPT-CAT-2
    FTM_0_CH_4_CH_5_ISR: service-id=0, is-reentrant=false, call-type=INTERRUPT, execution-context=INTERRUPT-CAT-2
    FTM_0_CH_4_ISR: service-id=0, is-reentrant=false, call-type=INTERRUPT, execution-context=INTERRUPT-CAT-2
    FTM_0_CH_5_ISR: service-id=0, is-reentrant=false, call-type=INTERRUPT, execution-context=INTERRUPT-CAT-2
    FTM_0_CH_6_CH_7_ISR: service-id=0, is-reentrant=false, call-type=INTERRUPT, execution-context=INTERRUPT-CAT-2
    FTM_0_ISR: service-id=0, is-reentrant=false, call-type=INTERRUPT, execution-context=INTERRUPT-CAT-2
    FTM_1_CH_0_CH_1_ISR: service-id=0, is-reentrant=false, call-type=INTERRUPT, execution-context=INTERRUPT-CAT-2
    FTM_1_CH_0_ISR: service-id=0, is-reentrant=false, call-type=INTERRUPT, execution-context=INTERRUPT-CAT-2
    FTM_1_CH_1_ISR: service-id=0, is-reentrant=false, call-type=INTERRUPT, execution-context=INTERRUPT-CAT-2
    FTM_1_CH_2_CH_3_ISR: service-id=0, is-reentrant=false, call-type=INTERRUPT, execution-context=INTERRUPT-CAT-2
    FTM_1_CH_2_ISR: service-id=0, is-reentrant=false, call-type=INTERRUPT, execution-context=INTERRUPT-CAT-2
    FTM_1_CH_3_ISR: service-id=0, is-reentrant=false, call-type=INTERRUPT, execution-context=INTERRUPT-CAT-2
    FTM_1_CH_4_CH_5_ISR: service-id=0, is-reentrant=false, call-type=INTERRUPT, execution-context=INTERRUPT-CAT-2
    FTM_1_CH_4_ISR: service-id=0, is-reentrant=false, call-type=INTERRUPT, execution-context=INTERRUPT-CAT-2
    FTM_1_CH_5_ISR: service-id=0, is-reentrant=false, call-type=INTERRUPT, execution-context=INTERRUPT-CAT-2
    FTM_1_CH_6_CH_7_ISR: service-id=0, is-reentrant=false, call-type=INTERRUPT, execution-context=INTERRUPT-CAT-2
    FTM_1_ISR: service-id=0, is-reentrant=false, call-type=INTERRUPT, execution-context=INTERRUPT-CAT-2
    FTM_2_CH_0_CH_1_ISR: service-id=0, is-reentrant=false, call-type=INTERRUPT, execution-context=INTERRUPT-CAT-2
    FTM_2_CH_0_ISR: service-id=0, is-reentrant=false, call-type=INTERRUPT, execution-context=INTERRUPT-CAT-2
    FTM_2_CH_1_ISR: service-id=0, is-reentrant=false, call-type=INTERRUPT, execution-context=INTERRUPT-CAT-2
    FTM_2_CH_2_CH_3_ISR: service-id=0, is-reentrant=false, call-type=INTERRUPT, execution-context=INTERRUPT-CAT-2
    FTM_2_CH_2_ISR: service-id=0, is-reentrant=false, call-type=INTERRUPT, execution-context=INTERRUPT-CAT-2
    FTM_2_CH_3_ISR: service-id=0, is-reentrant=false, call-type=INTERRUPT, execution-context=INTERRUPT-CAT-2
    FTM_2_CH_4_CH_5_ISR: service-id=0, is-reentrant=false, call-type=INTERRUPT, execution-context=INTERRUPT-CAT-2
    FTM_2_CH_4_ISR: service-id=0, is-reentrant=false, call-type=INTERRUPT, execution-context=INTERRUPT-CAT-2
    FTM_2_CH_5_ISR: service-id=0, is-reentrant=false, call-type=INTERRUPT, execution-context=INTERRUPT-CAT-2
    FTM_2_CH_6_CH_7_ISR: service-id=0, is-reentrant=false, call-type=INTERRUPT, execution-context=INTERRUPT-CAT-2
    FTM_3_CH_0_CH_1_ISR: service-id=0, is-reentrant=false, call-type=INTERRUPT, execution-context=INTERRUPT-CAT-2
    FTM_3_CH_0_ISR: service-id=0, is-reentrant=false, call-type=INTERRUPT, execution-context=INTERRUPT-CAT-2
    FTM_3_CH_1_ISR: service-id=0, is-reentrant=false, call-type=INTERRUPT, execution-context=INTERRUPT-CAT-2
    FTM_3_CH_2_CH_3_ISR: service-id=0, is-reentrant=false, call-type=INTERRUPT, execution-context=INTERRUPT-CAT-2
    FTM_3_CH_2_ISR: service-id=0, is-reentrant=false, call-type=INTERRUPT, execution-context=INTERRUPT-CAT-2
    FTM_3_CH_3_ISR: service-id=0, is-reentrant=false, call-type=INTERRUPT, execution-context=INTERRUPT-CAT-2
    FTM_3_CH_4_CH_5_ISR: service-id=0, is-reentrant=false, call-type=INTERRUPT, execution-context=INTERRUPT-CAT-2
    FTM_3_CH_4_ISR: service-id=0, is-reentrant=false, call-type=INTERRUPT, execution-context=INTERRUPT-CAT-2
    FTM_3_CH_5_ISR: service-id=0, is-reentrant=false, call-type=INTERRUPT, execution-context=INTERRUPT-CAT-2
    FTM_3_CH_6_CH_7_ISR: service-id=0, is-reentrant=false, call-type=INTERRUPT, execution-context=INTERRUPT-CAT-2
    FTM_4_CH_0_CH_1_ISR: service-id=0, is-reentrant=false, call-type=INTERRUPT, execution-context=INTERRUPT-CAT-2
    FTM_4_CH_0_ISR: service-id=0, is-reentrant=false, call-type=INTERRUPT, execution-context=INTERRUPT-CAT-2
    FTM_4_CH_1_ISR: service-id=0, is-reentrant=false, call-type=INTERRUPT, execution-context=INTERRUPT-CAT-2
    FTM_4_CH_2_CH_3_ISR: service-id=0, is-reentrant=false, call-type=INTERRUPT, execution-context=INTERRUPT-CAT-2
    FTM_4_CH_2_ISR: service-id=0, is-reentrant=false, call-type=INTERRUPT, execution-context=INTERRUPT-CAT-2
    FTM_4_CH_3_ISR: service-id=0, is-reentrant=false, call-type=INTERRUPT, execution-context=INTERRUPT-CAT-2
    FTM_4_CH_4_CH_5_ISR: service-id=0, is-reentrant=false, call-type=INTERRUPT, execution-context=INTERRUPT-CAT-2
    FTM_4_CH_4_ISR: service-id=0, is-reentrant=false, call-type=INTERRUPT, execution-context=INTERRUPT-CAT-2
    FTM_4_CH_5_ISR: service-id=0, is-reentrant=false, call-type=INTERRUPT, execution-context=INTERRUPT-CAT-2
    FTM_4_CH_6_CH_7_ISR: service-id=0, is-reentrant=false, call-type=INTERRUPT, execution-context=INTERRUPT-CAT-2
    FTM_4_ISR: service-id=0, is-reentrant=false, call-type=INTERRUPT, execution-context=INTERRUPT-CAT-2
    FTM_5_CH_0_CH_1_ISR: service-id=0, is-reentrant=false, call-type=INTERRUPT, execution-context=INTERRUPT-CAT-2
    FTM_5_CH_0_ISR: service-id=0, is-reentrant=false, call-type=INTERRUPT, execution-context=INTERRUPT-CAT-2
    FTM_5_CH_1_ISR: service-id=0, is-reentrant=false, call-type=INTERRUPT, execution-context=INTERRUPT-CAT-2
    FTM_5_CH_2_CH_3_ISR: service-id=0, is-reentrant=false, call-type=INTERRUPT, execution-context=INTERRUPT-CAT-2
    FTM_5_CH_2_ISR: service-id=0, is-reentrant=false, call-type=INTERRUPT, execution-context=INTERRUPT-CAT-2
    FTM_5_CH_3_ISR: service-id=0, is-reentrant=false, call-type=INTERRUPT, execution-context=INTERRUPT-CAT-2
    FTM_5_CH_4_CH_5_ISR: service-id=0, is-reentrant=false, call-type=INTERRUPT, execution-context=INTERRUPT-CAT-2
    FTM_5_CH_4_ISR: service-id=0, is-reentrant=false, call-type=INTERRUPT, execution-context=INTERRUPT-CAT-2
    FTM_5_CH_5_ISR: service-id=0, is-reentrant=false, call-type=INTERRUPT, execution-context=INTERRUPT-CAT-2
    FTM_5_CH_6_CH_7_ISR: service-id=0, is-reentrant=false, call-type=INTERRUPT, execution-context=INTERRUPT-CAT-2
    FTM_5_ISR: service-id=0, is-reentrant=false, call-type=INTERRUPT, execution-context=INTERRUPT-CAT-2
    FTM_6_CH_0_CH_1_ISR: service-id=0, is-reentrant=false, call-type=INTERRUPT, execution-context=INTERRUPT-CAT-2
    FTM_6_CH_2_CH_3_ISR: service-id=0, is-reentrant=false, call-type=INTERRUPT, execution-context=INTERRUPT-CAT-2
    FTM_6_CH_4_CH_5_ISR: service-id=0, is-reentrant=false, call-type=INTERRUPT, execution-context=INTERRUPT-CAT-2
    FTM_6_CH_6_CH_7_ISR: service-id=0, is-reentrant=false, call-type=INTERRUPT, execution-context=INTERRUPT-CAT-2
    FTM_7_CH_0_CH_1_ISR: service-id=0, is-reentrant=false, call-type=INTERRUPT, execution-context=INTERRUPT-CAT-2
    FTM_7_CH_2_CH_3_ISR: service-id=0, is-reentrant=false, call-type=INTERRUPT, execution-context=INTERRUPT-CAT-2
    FTM_7_CH_4_CH_5_ISR: service-id=0, is-reentrant=false, call-type=INTERRUPT, execution-context=INTERRUPT-CAT-2
    FTM_7_CH_6_CH_7_ISR: service-id=0, is-reentrant=false, call-type=INTERRUPT, execution-context=INTERRUPT-CAT-2
package /Ocu_TS_T40D2M30I0R0/Implementations
  bsw implementation BswImplementation_0: programming-language=C, sw-version=3.0.0_QLP02, vendor-id=43, ar-release-version=4.7.0, behavior=InternalBehavior_0, vendor-specific-module-def=Ocu
    code-descriptors:
      code Files
        artifact-descriptors:
          short-label=config::Ocu.xdm, category=SWCFG
          short-label=doc::RTD_OCU_IM.pdf, category=SWDOC
          short-label=doc::RTD_OCU_UM.pdf, category=SWDOC
          short-label=examples::EBT::S32K1::Ocu_Example_S32K118::generate::epc::BaseNXP.xdm, category=SWCFG
          short-label=examples::EBT::S32K1::Ocu_Example_S32K118::generate::epc::Dem.xdm, category=SWCFG
          short-label=examples::EBT::S32K1::Ocu_Example_S32K118::generate::epc::Dio.xdm, category=SWCFG
          short-label=examples::EBT::S32K1::Ocu_Example_S32K118::generate::epc::EcuC.xdm, category=SWCFG
          short-label=examples::EBT::S32K1::Ocu_Example_S32K118::generate::epc::Mcu.xdm, category=SWCFG
          short-label=examples::EBT::S32K1::Ocu_Example_S32K118::generate::epc::Ocu.xdm, category=SWCFG
          short-label=examples::EBT::S32K1::Ocu_Example_S32K118::generate::epc::Platform.xdm, category=SWCFG
          short-label=examples::EBT::S32K1::Ocu_Example_S32K118::generate::epc::Port.xdm, category=SWCFG
          short-label=examples::EBT::S32K1::Ocu_Example_S32K118::generate::epc::Resource.xdm, category=SWCFG
          short-label=examples::EBT::S32K1::Ocu_Example_S32K118::include::check_example.h, category=SWHDR
          short-label=examples::EBT::S32K1::Ocu_Example_S32K118::src::main.c, category=SWSRC
          short-label=examples::EBT::S32K1::Ocu_Example_S32K118::TresosProject::Ocu_Example_S32K118::.prefs::preferences.xdm, category=SWCFG
          short-label=examples::EBT::S32K1::Ocu_Example_S32K118::TresosProject::Ocu_Example_S32K118::config::BaseNXP.xdm, category=SWCFG
          short-label=examples::EBT::S32K1::Ocu_Example_S32K118::TresosProject::Ocu_Example_S32K118::config::Dem.xdm, category=SWCFG
          short-label=examples::EBT::S32K1::Ocu_Example_S32K118::TresosProject::Ocu_Example_S32K118::config::Dio.xdm, category=SWCFG
          short-label=examples::EBT::S32K1::Ocu_Example_S32K118::TresosProject::Ocu_Example_S32K118::config::EcuC.xdm, category=SWCFG
          short-label=examples::EBT::S32K1::Ocu_Example_S32K118::TresosProject::Ocu_Example_S32K118::config::Mcu.xdm, category=SWCFG
          short-label=examples::EBT::S32K1::Ocu_Example_S32K118::TresosProject::Ocu_Example_S32K118::config::Ocu.xdm, category=SWCFG
          short-label=examples::EBT::S32K1::Ocu_Example_S32K118::TresosProject::Ocu_Example_S32K118::config::Platform.xdm, category=SWCFG
          short-label=examples::EBT::S32K1::Ocu_Example_S32K118::TresosProject::Ocu_Example_S32K118::config::Port.xdm, category=SWCFG
          short-label=examples::EBT::S32K1::Ocu_Example_S32K118::TresosProject::Ocu_Example_S32K118::config::Resource.xdm, category=SWCFG
          short-label=examples::EBT::S32K1::Ocu_Example_S32K144::generate::epc::BaseNXP.xdm, category=SWCFG
          short-label=examples::EBT::S32K1::Ocu_Example_S32K144::generate::epc::Dem.xdm, category=SWCFG
          short-label=examples::EBT::S32K1::Ocu_Example_S32K144::generate::epc::Dio.xdm, category=SWCFG
          short-label=examples::EBT::S32K1::Ocu_Example_S32K144::generate::epc::EcuC.xdm, category=SWCFG
          short-label=examples::EBT::S32K1::Ocu_Example_S32K144::generate::epc::Mcu.xdm, category=SWCFG
          short-label=examples::EBT::S32K1::Ocu_Example_S32K144::generate::epc::Ocu.xdm, category=SWCFG
          short-label=examples::EBT::S32K1::Ocu_Example_S32K144::generate::epc::Platform.xdm, category=SWCFG
          short-label=examples::EBT::S32K1::Ocu_Example_S32K144::generate::epc::Port.xdm, category=SWCFG
          short-label=examples::EBT::S32K1::Ocu_Example_S32K144::generate::epc::Resource.xdm, category=SWCFG
          short-label=examples::EBT::S32K1::Ocu_Example_S32K144::include::check_example.h, category=SWHDR
          short-label=examples::EBT::S32K1::Ocu_Example_S32K144::src::main.c, category=SWSRC
          short-label=examples::EBT::S32K1::Ocu_Example_S32K144::TresosProject::Ocu_Example_S32K144::.prefs::preferences.xdm, category=SWCFG
          short-label=examples::EBT::S32K1::Ocu_Example_S32K144::TresosProject::Ocu_Example_S32K144::config::BaseNXP.xdm, category=SWCFG
          short-label=examples::EBT::S32K1::Ocu_Example_S32K144::TresosProject::Ocu_Example_S32K144::config::Dem.xdm, category=SWCFG
          short-label=examples::EBT::S32K1::Ocu_Example_S32K144::TresosProject::Ocu_Example_S32K144::config::Dio.xdm, category=SWCFG
          short-label=examples::EBT::S32K1::Ocu_Example_S32K144::TresosProject::Ocu_Example_S32K144::config::EcuC.xdm, category=SWCFG
          short-label=examples::EBT::S32K1::Ocu_Example_S32K144::TresosProject::Ocu_Example_S32K144::config::Mcu.xdm, category=SWCFG
          short-label=examples::EBT::S32K1::Ocu_Example_S32K144::TresosProject::Ocu_Example_S32K144::config::Ocu.xdm, category=SWCFG
          short-label=examples::EBT::S32K1::Ocu_Example_S32K144::TresosProject::Ocu_Example_S32K144::config::Platform.xdm, category=SWCFG
          short-label=examples::EBT::S32K1::Ocu_Example_S32K144::TresosProject::Ocu_Example_S32K144::config::Port.xdm, category=SWCFG
          short-label=examples::EBT::S32K1::Ocu_Example_S32K144::TresosProject::Ocu_Example_S32K144::config::Resource.xdm, category=SWCFG
          short-label=examples::EBT::S32K1::Ocu_Example_S32K144W::generate::epc::BaseNXP.xdm, category=SWCFG
          short-label=examples::EBT::S32K1::Ocu_Example_S32K144W::generate::epc::Dem.xdm, category=SWCFG
          short-label=examples::EBT::S32K1::Ocu_Example_S32K144W::generate::epc::Dio.xdm, category=SWCFG
          short-label=examples::EBT::S32K1::Ocu_Example_S32K144W::generate::epc::EcuC.xdm, category=SWCFG
          short-label=examples::EBT::S32K1::Ocu_Example_S32K144W::generate::epc::Mcu.xdm, category=SWCFG
          short-label=examples::EBT::S32K1::Ocu_Example_S32K144W::generate::epc::Ocu.xdm, category=SWCFG
          short-label=examples::EBT::S32K1::Ocu_Example_S32K144W::generate::epc::Platform.xdm, category=SWCFG
          short-label=examples::EBT::S32K1::Ocu_Example_S32K144W::generate::epc::Port.xdm, category=SWCFG
          short-label=examples::EBT::S32K1::Ocu_Example_S32K144W::generate::epc::Resource.xdm, category=SWCFG
          short-label=examples::EBT::S32K1::Ocu_Example_S32K144W::include::check_example.h, category=SWHDR
          short-label=examples::EBT::S32K1::Ocu_Example_S32K144W::src::main.c, category=SWSRC
          short-label=examples::EBT::S32K1::Ocu_Example_S32K144W::TresosProject::Ocu_Example_S32K144W::.prefs::preferences.xdm, category=SWCFG
          short-label=examples::EBT::S32K1::Ocu_Example_S32K144W::TresosProject::Ocu_Example_S32K144W::config::BaseNXP.xdm, category=SWCFG
          short-label=examples::EBT::S32K1::Ocu_Example_S32K144W::TresosProject::Ocu_Example_S32K144W::config::Dem.xdm, category=SWCFG
          short-label=examples::EBT::S32K1::Ocu_Example_S32K144W::TresosProject::Ocu_Example_S32K144W::config::Dio.xdm, category=SWCFG
          short-label=examples::EBT::S32K1::Ocu_Example_S32K144W::TresosProject::Ocu_Example_S32K144W::config::EcuC.xdm, category=SWCFG
          short-label=examples::EBT::S32K1::Ocu_Example_S32K144W::TresosProject::Ocu_Example_S32K144W::config::Mcu.xdm, category=SWCFG
          short-label=examples::EBT::S32K1::Ocu_Example_S32K144W::TresosProject::Ocu_Example_S32K144W::config::Ocu.xdm, category=SWCFG
          short-label=examples::EBT::S32K1::Ocu_Example_S32K144W::TresosProject::Ocu_Example_S32K144W::config::Platform.xdm, category=SWCFG
          short-label=examples::EBT::S32K1::Ocu_Example_S32K144W::TresosProject::Ocu_Example_S32K144W::config::Port.xdm, category=SWCFG
          short-label=examples::EBT::S32K1::Ocu_Example_S32K144W::TresosProject::Ocu_Example_S32K144W::config::Resource.xdm, category=SWCFG
          short-label=examples::EBT::S32K1::Ocu_Example_S32K148::generate::epc::BaseNXP.xdm, category=SWCFG
          short-label=examples::EBT::S32K1::Ocu_Example_S32K148::generate::epc::Dem.xdm, category=SWCFG
          short-label=examples::EBT::S32K1::Ocu_Example_S32K148::generate::epc::Dio.xdm, category=SWCFG
          short-label=examples::EBT::S32K1::Ocu_Example_S32K148::generate::epc::EcuC.xdm, category=SWCFG
          short-label=examples::EBT::S32K1::Ocu_Example_S32K148::generate::epc::Mcu.xdm, category=SWCFG
          short-label=examples::EBT::S32K1::Ocu_Example_S32K148::generate::epc::Ocu.xdm, category=SWCFG
          short-label=examples::EBT::S32K1::Ocu_Example_S32K148::generate::epc::Platform.xdm, category=SWCFG
          short-label=examples::EBT::S32K1::Ocu_Example_S32K148::generate::epc::Port.xdm, category=SWCFG
          short-label=examples::EBT::S32K1::Ocu_Example_S32K148::generate::epc::Resource.xdm, category=SWCFG
          short-label=examples::EBT::S32K1::Ocu_Example_S32K148::include::check_example.h, category=SWHDR
          short-label=examples::EBT::S32K1::Ocu_Example_S32K148::src::main.c, category=SWSRC
          short-label=examples::EBT::S32K1::Ocu_Example_S32K148::TresosProject::Ocu_Example_S32K148::.prefs::preferences.xdm, category=SWCFG
          short-label=examples::EBT::S32K1::Ocu_Example_S32K148::TresosProject::Ocu_Example_S32K148::config::BaseNXP.xdm, category=SWCFG
          short-label=examples::EBT::S32K1::Ocu_Example_S32K148::TresosProject::Ocu_Example_S32K148::config::Dem.xdm, category=SWCFG
          short-label=examples::EBT::S32K1::Ocu_Example_S32K148::TresosProject::Ocu_Example_S32K148::config::Dio.xdm, category=SWCFG
          short-label=examples::EBT::S32K1::Ocu_Example_S32K148::TresosProject::Ocu_Example_S32K148::config::EcuC.xdm, category=SWCFG
          short-label=examples::EBT::S32K1::Ocu_Example_S32K148::TresosProject::Ocu_Example_S32K148::config::Mcu.xdm, category=SWCFG
          short-label=examples::EBT::S32K1::Ocu_Example_S32K148::TresosProject::Ocu_Example_S32K148::config::Ocu.xdm, category=SWCFG
          short-label=examples::EBT::S32K1::Ocu_Example_S32K148::TresosProject::Ocu_Example_S32K148::config::Platform.xdm, category=SWCFG
          short-label=examples::EBT::S32K1::Ocu_Example_S32K148::TresosProject::Ocu_Example_S32K148::config::Port.xdm, category=SWCFG
          short-label=examples::EBT::S32K1::Ocu_Example_S32K148::TresosProject::Ocu_Example_S32K148::config::Resource.xdm, category=SWCFG
          short-label=examples::S32DS::S32K1::Ftm_Ocu_Ip_Example_S32K118::include::check_example.h, category=SWHDR
          short-label=examples::S32DS::S32K1::Ftm_Ocu_Ip_Example_S32K118::Project_Settings::Startup_Code::exceptions.c, category=SWSRC
          short-label=examples::S32DS::S32K1::Ftm_Ocu_Ip_Example_S32K118::Project_Settings::Startup_Code::nvic.c, category=SWSRC
          short-label=examples::S32DS::S32K1::Ftm_Ocu_Ip_Example_S32K118::Project_Settings::Startup_Code::startup.c, category=SWSRC
          short-label=examples::S32DS::S32K1::Ftm_Ocu_Ip_Example_S32K118::Project_Settings::Startup_Code::system.c, category=SWSRC
          short-label=examples::S32DS::S32K1::Ftm_Ocu_Ip_Example_S32K118::src::main.c, category=SWSRC
          short-label=examples::S32DS::S32K1::Ftm_Ocu_Ip_Example_S32K144::include::check_example.h, category=SWHDR
          short-label=examples::S32DS::S32K1::Ftm_Ocu_Ip_Example_S32K144::Project_Settings::Startup_Code::exceptions.c, category=SWSRC
          short-label=examples::S32DS::S32K1::Ftm_Ocu_Ip_Example_S32K144::Project_Settings::Startup_Code::nvic.c, category=SWSRC
          short-label=examples::S32DS::S32K1::Ftm_Ocu_Ip_Example_S32K144::Project_Settings::Startup_Code::startup.c, category=SWSRC
          short-label=examples::S32DS::S32K1::Ftm_Ocu_Ip_Example_S32K144::Project_Settings::Startup_Code::system.c, category=SWSRC
          short-label=examples::S32DS::S32K1::Ftm_Ocu_Ip_Example_S32K144::src::main.c, category=SWSRC
          short-label=examples::S32DS::S32K1::Ftm_Ocu_Ip_Example_S32K144W::include::check_example.h, category=SWHDR
          short-label=examples::S32DS::S32K1::Ftm_Ocu_Ip_Example_S32K144W::Project_Settings::Startup_Code::exceptions.c, category=SWSRC
          short-label=examples::S32DS::S32K1::Ftm_Ocu_Ip_Example_S32K144W::Project_Settings::Startup_Code::nvic.c, category=SWSRC
          short-label=examples::S32DS::S32K1::Ftm_Ocu_Ip_Example_S32K144W::Project_Settings::Startup_Code::startup.c, category=SWSRC
          short-label=examples::S32DS::S32K1::Ftm_Ocu_Ip_Example_S32K144W::Project_Settings::Startup_Code::system.c, category=SWSRC
          short-label=examples::S32DS::S32K1::Ftm_Ocu_Ip_Example_S32K144W::src::main.c, category=SWSRC
          short-label=examples::S32DS::S32K1::Ftm_Ocu_Ip_Example_S32K148::include::check_example.h, category=SWHDR
          short-label=examples::S32DS::S32K1::Ftm_Ocu_Ip_Example_S32K148::Project_Settings::Startup_Code::exceptions.c, category=SWSRC
          short-label=examples::S32DS::S32K1::Ftm_Ocu_Ip_Example_S32K148::Project_Settings::Startup_Code::nvic.c, category=SWSRC
          short-label=examples::S32DS::S32K1::Ftm_Ocu_Ip_Example_S32K148::Project_Settings::Startup_Code::startup.c, category=SWSRC
          short-label=examples::S32DS::S32K1::Ftm_Ocu_Ip_Example_S32K148::Project_Settings::Startup_Code::system.c, category=SWSRC
          short-label=examples::S32DS::S32K1::Ftm_Ocu_Ip_Example_S32K148::src::main.c, category=SWSRC
          short-label=examples::S32DS::S32K1::Ocu_Example_S32K118::include::check_example.h, category=SWHDR
          short-label=examples::S32DS::S32K1::Ocu_Example_S32K118::Project_Settings::Startup_Code::exceptions.c, category=SWSRC
          short-label=examples::S32DS::S32K1::Ocu_Example_S32K118::Project_Settings::Startup_Code::nvic.c, category=SWSRC
          short-label=examples::S32DS::S32K1::Ocu_Example_S32K118::Project_Settings::Startup_Code::startup.c, category=SWSRC
          short-label=examples::S32DS::S32K1::Ocu_Example_S32K118::Project_Settings::Startup_Code::system.c, category=SWSRC
          short-label=examples::S32DS::S32K1::Ocu_Example_S32K118::src::main.c, category=SWSRC
          short-label=examples::S32DS::S32K1::Ocu_Example_S32K144::include::check_example.h, category=SWHDR
          short-label=examples::S32DS::S32K1::Ocu_Example_S32K144::Project_Settings::Startup_Code::exceptions.c, category=SWSRC
          short-label=examples::S32DS::S32K1::Ocu_Example_S32K144::Project_Settings::Startup_Code::nvic.c, category=SWSRC
          short-label=examples::S32DS::S32K1::Ocu_Example_S32K144::Project_Settings::Startup_Code::startup.c, category=SWSRC
          short-label=examples::S32DS::S32K1::Ocu_Example_S32K144::Project_Settings::Startup_Code::system.c, category=SWSRC
          short-label=examples::S32DS::S32K1::Ocu_Example_S32K144::src::main.c, category=SWSRC
          short-label=examples::S32DS::S32K1::Ocu_Example_S32K144W::include::check_example.h, category=SWHDR
          short-label=examples::S32DS::S32K1::Ocu_Example_S32K144W::Project_Settings::Startup_Code::exceptions.c, category=SWSRC
          short-label=examples::S32DS::S32K1::Ocu_Example_S32K144W::Project_Settings::Startup_Code::nvic.c, category=SWSRC
          short-label=examples::S32DS::S32K1::Ocu_Example_S32K144W::Project_Settings::Startup_Code::startup.c, category=SWSRC
          short-label=examples::S32DS::S32K1::Ocu_Example_S32K144W::Project_Settings::Startup_Code::system.c, category=SWSRC
          short-label=examples::S32DS::S32K1::Ocu_Example_S32K144W::src::main.c, category=SWSRC
          short-label=examples::S32DS::S32K1::Ocu_Example_S32K148::include::check_example.h, category=SWHDR
          short-label=examples::S32DS::S32K1::Ocu_Example_S32K148::Project_Settings::Startup_Code::exceptions.c, category=SWSRC
          short-label=examples::S32DS::S32K1::Ocu_Example_S32K148::Project_Settings::Startup_Code::nvic.c, category=SWSRC
          short-label=examples::S32DS::S32K1::Ocu_Example_S32K148::Project_Settings::Startup_Code::startup.c, category=SWSRC
          short-label=examples::S32DS::S32K1::Ocu_Example_S32K148::Project_Settings::Startup_Code::system.c, category=SWSRC
          short-label=examples::S32DS::S32K1::Ocu_Example_S32K148::src::main.c, category=SWSRC
          short-label=include::Ftm_Ocu_Ip.h, category=SWHDR
          short-label=include::Ftm_Ocu_Ip_HwAccess.h, category=SWHDR
          short-label=include::Ftm_Ocu_Ip_Irq.h, category=SWHDR
          short-label=include::Ftm_Ocu_Ip_TrustedFunctions.h, category=SWHDR
          short-label=include::Ftm_Ocu_Ip_Types.h, category=SWHDR
          short-label=include::Ocu.h, category=SWHDR
          short-label=include::Ocu_EnvCfg.h, category=SWHDR
          short-label=include::Ocu_Ipw.h, category=SWHDR
          short-label=include::Ocu_Ipw_Types.h, category=SWHDR
          short-label=include::Ocu_Irq.h, category=SWHDR
          short-label=include::Ocu_Types.h, category=SWHDR
          short-label=src::Ftm_Ocu_Ip.c, category=SWSRC
          short-label=src::Ftm_Ocu_Ip_Irq.c, category=SWSRC
          short-label=src::Ocu.c, category=SWSRC
          short-label=src::Ocu_Ipw.c, category=SWSRC
    compiler GCC_Compiler:
      name=GCC Compiler
      options=-mcpu=cortex-m4 -mcpu=cortex-m0plus -mthumb -mlittle-endian -mfpu=fpv4-sp-d16 -mfloat-abi=hard -mfpu=auto -mfloat-abi=soft -std=c99 -Os -ggdb3 -Wall -Wextra -pedantic -Wstrict-prototypes -Wundef -Wunused -Werror=implicit-function-declaration -Wsign-compare -Wdouble-promotion -fno-short-enums -funsigned-char -funsigned-bitfields -fomit-frame-pointer -fno-common -fstack-usage -fdump-ipa-all -c -DUSE_SW_VECTOR_MODE -DI_CACHE_ENABLE -DENABLE_FPU -DMCAL_ENABLE_USER_MODE_SUPPORT --sysroot=$(NEWLIB_DIR) -specs=nano.specs -specs=nosys.specs
      vendor=GCC Systems
      version=NXP GCC 10.2.0 20200723 (Build 1728 Revision g5963bc8)
    compiler GHS_Compiler:
      name=Green Hills
      options=-cpu=cortexm4 -cpu=cortexm0plus -thumb -fpu=vfpv4_d16 -fsingle -fsoft -C99 --ghstd=last -Osize --gnu_asm -dual_debug -G -keeptempfiles -Wimplicit-int -Wshadow -Wtrigraphs -Wundef --unsigned_chars --unsigned_fields --no_commons --no_exceptions --no_slash_comment --prototype_errors --incorrect_pragma_warnings -c -DUSE_SW_VECTOR_MODE -DI_CACHE_ENABLE -DENABLE_FPU -DMCAL_ENABLE_USER_MODE_SUPPORT
      vendor=Green Hills
      version=Green Hills Multi 7.1.6d / Compiler 2020.1.4
    compiler IAR_Compiler:
      name=IAR Compiler
      options=--cpu=Cortex-M4 --cpu=Cortex-M0+ --cpu_mode=thumb --endian=little --fpu=FPv4-SP --fpu=none -e -Ohz --debug --no_clustering --no_mem_idioms --no_explicit_zero_opt --require_prototypes --no_wrap_diagnostics --diag_suppress=Pa050 -DIAR -DUSE_SW_VECTOR_MODE -DI_CACHE_ENABLE -DENABLE_FPU -DMCAL_ENABLE_USER_MODE_SUPPORT
      vendor=IAR Systems
      version=IAR ANSI C/C++ Compiler V8.40.3.228/W32 for ARM Functional Safety
    generated-artifacts:
      12 x dependency on artifact:
        Ftm_Ocu_Ip_PBcfg_h: artifact-descriptor={short-label=generate_PB::include::Ftm_Ocu_Ip_PBcfg.h, category=SWHDR}, usages=EXECUTE
        Ocu_Ipw_PBcfg_h: artifact-descriptor={short-label=generate_PB::include::Ocu_Ipw_PBcfg.h, category=SWHDR}, usages=EXECUTE
        Ocu_PBcfg_h: artifact-descriptor={short-label=generate_PB::include::Ocu_PBcfg.h, category=SWHDR}, usages=EXECUTE
        Ftm_Ocu_Ip_PBcfg_c: artifact-descriptor={short-label=generate_PB::src::Ftm_Ocu_Ip_PBcfg.c, category=SWSRC}, usages=EXECUTE
        Ocu_Ipw_PBcfg_c: artifact-descriptor={short-label=generate_PB::src::Ocu_Ipw_PBcfg.c, category=SWSRC}, usages=EXECUTE
        Ocu_PBcfg_c: artifact-descriptor={short-label=generate_PB::src::Ocu_PBcfg.c, category=SWSRC}, usages=EXECUTE
        Ftm_Ocu_Ip_Cfg_h: artifact-descriptor={short-label=generate_PC::include::Ftm_Ocu_Ip_Cfg.h, category=SWHDR}, usages=COMPILE
        Ftm_Ocu_Ip_CfgDefines_h: artifact-descriptor={short-label=generate_PC::include::Ftm_Ocu_Ip_CfgDefines.h, category=SWHDR}, usages=COMPILE
        Ocu_Cfg_h: artifact-descriptor={short-label=generate_PC::include::Ocu_Cfg.h, category=SWHDR}, usages=COMPILE
        Ocu_CfgDefines_h: artifact-descriptor={short-label=generate_PC::include::Ocu_CfgDefines.h, category=SWHDR}, usages=COMPILE
        Ocu_Ipw_Cfg_h: artifact-descriptor={short-label=generate_PC::include::Ocu_Ipw_Cfg.h, category=SWHDR}, usages=COMPILE
        Ocu_Ipw_CfgDefines_h: artifact-descriptor={short-label=generate_PC::include::Ocu_Ipw_CfgDefines.h, category=SWHDR}, usages=COMPILE
    linker GCC_Linker: name=GCC Compiler, options=-Wl,-Map,filename -T linkerfile --entry=Reset_Handler -nostartfiles -mcpu=cortex-m4 -mcpu=cortex-m0plus -mthumb -mfpu=fpv4-sp-d16 -mfloat-abi=hard -mfpu=auto -mfloat-abi=soft -mlittle-endian -ggdb3 -lc -lm -lgcc -n --sysroot=$(NEWLIB_DIR) -specs=nano.specs -specs=nosys.specs, vendor=GCC Systems, version=NXP GCC 10.2.0 20200723 (Build 1728 Revision g5963bc8)
    linker GHS_Linker: name=Green Hills, options=-e Reset_Handler -T linker_script_file.ld -map -keepmap -Mn -delete -ignore_debug_references -Llibrary_path -larch -lstartup -lind_sd -lind_sf -v -keep=C40_Ip_AccessCode -nostartfiles, vendor=Green Hills, version=Green Hills Multi 7.1.6d / Compiler 2020.1.4
    linker IAR_Linker: name=IAR Compiler, options=--map filename --config linkerfile --cpu=Cortex-M4 --cpu=Cortex-M0+ --fpu=FPv4-SP --fpu=none --entry _start --enable_stack_usage --skip_dynamic_initialization --no_wrap_diagnostics, vendor=IAR Systems, version=IAR ANSI C/C++ Compiler V8.40.3.228/W32 for ARM Functional Safety
    resource consumption ResourceConsumption
      10 x memory section:
        OCU_CODE: alignment=UNSPECIFIED, sw-addrmethod=CODE, symbol=CODE
        OCU_CONFIG_DATA_UNSPECIFIED: alignment=UNSPECIFIED, sw-addrmethod=CONFIG_DATA, symbol=CONFIG_DATA_UNSPECIFIED
        OCU_CONFIG_DATA_UNSPECIFIED_NO_CACHEABLE: alignment=UNSPECIFIED, sw-addrmethod=CONFIG_DATA_NO_CACHEABLE, symbol=CONFIG_DATA_UNSPECIFIED_NO_CACHEABLE
        OCU_CONST_UNSPECIFIED: alignment=UNSPECIFIED, sw-addrmethod=CONST, symbol=CONST_UNSPECIFIED
        OCU_VAR_CLEARED_16: alignment=16, sw-addrmethod=VAR_CLEARED, symbol=VAR_CLEARED_16
        OCU_VAR_CLEARED_8: alignment=8, sw-addrmethod=VAR_CLEARED, symbol=VAR_CLEARED_8
        OCU_VAR_CLEARED_BOOLEAN: alignment=BOOLEAN, sw-addrmethod=VAR_CLEARED, symbol=VAR_CLEARED_BOOLEAN
        OCU_VAR_CLEARED_UNSPECIFIED: alignment=UNSPECIFIED, sw-addrmethod=VAR_CLEARED, symbol=VAR_CLEARED_UNSPECIFIED
        OCU_VAR_CLEARED_UNSPECIFIED_NO_CACHEABLE: alignment=UNSPECIFIED, sw-addrmethod=VAR_CLEARED_NO_CACHEABLE, symbol=VAR_CLEARED_UNSPECIFIED_NO_CACHEABLE
        OCU_VAR_INIT_UNSPECIFIED_NO_CACHEABLE: alignment=UNSPECIFIED, sw-addrmethod=VAR_INIT_NO_CACHEABLE, symbol=VAR_INIT_UNSPECIFIED_NO_CACHEABLE
