AUTOSAR XML (schema 00050)
package /AUTOSAR_Uart/BswModuleDescriptions
  bsw module description Uart: module-id=255
    provided-entrys:
      Uart_Abort
      Uart_AsyncReceive
      Uart_AsyncSend
      Uart_Deinit
      Uart_GetBaudrate
      Uart_GetStatus
      Uart_GetVersionInfo
      Uart_Init
      Uart_SetBaudrate
      Uart_SetBuffer
      Uart_SyncReceive
      Uart_SyncSend
      LPUART_UART_IP_0_IRQHandler
      LPUART_UART_IP_{10..15}_IRQHandler
      LPUART_UART_IP_{1..9}_IRQHandler
      LPUART_UART_IP_MSC_IRQHandler
    bsw internal behavior InternalBehavior_0
      11 x exclusive area:
        UART_EXCLUSIVE_AREA_{00..10}
      12 x bsw called entity:
        Uart_Abort: implemented-entry=Uart_Abort
        Uart_AsyncReceive: can-enter-exclusive-area=[UART_EXCLUSIVE_AREA_03, UART_EXCLUSIVE_AREA_06, UART_EXCLUSIVE_AREA_09], implemented-entry=Uart_AsyncReceive
        Uart_AsyncSend: can-enter-exclusive-area=[UART_EXCLUSIVE_AREA_01, UART_EXCLUSIVE_AREA_04, UART_EXCLUSIVE_AREA_08, UART_EXCLUSIVE_AREA_09], implemented-entry=Uart_AsyncSend
        Uart_Deinit: can-enter-exclusive-area=UART_EXCLUSIVE_AREA_09, implemented-entry=Uart_Deinit
        Uart_GetBaudrate: implemented-entry=Uart_GetBaudrate
        Uart_GetStatus: can-enter-exclusive-area=UART_EXCLUSIVE_AREA_09, implemented-entry=Uart_GetStatus
        Uart_GetVersionInfo: implemented-entry=Uart_GetVersionInfo
        Uart_Init: implemented-entry=Uart_Init
        Uart_SetBaudrate: can-enter-exclusive-area=UART_EXCLUSIVE_AREA_09, implemented-entry=Uart_SetBaudrate
        Uart_SetBuffer: implemented-entry=Uart_SetBuffer
        Uart_SyncReceive: can-enter-exclusive-area=[UART_EXCLUSIVE_AREA_02, UART_EXCLUSIVE_AREA_07, UART_EXCLUSIVE_AREA_09], implemented-entry=Uart_SyncReceive
        Uart_SyncSend: can-enter-exclusive-area=[UART_EXCLUSIVE_AREA_00, UART_EXCLUSIVE_AREA_05, UART_EXCLUSIVE_AREA_09, UART_EXCLUSIVE_AREA_10], implemented-entry=Uart_SyncSend
      17 x bsw interrupt entity, all with interrupt-category=CAT-2, interrupt-source=Hardware:
        LPUART_UART_IP_0_IRQHandler: implemented-entry=LPUART_UART_IP_0_IRQHandler
        LPUART_UART_IP_{10..15}_IRQHandler: implemented-entry=LPUART_UART_IP_{10..15}_IRQHandler
        LPUART_UART_IP_{1..9}_IRQHandler: implemented-entry=LPUART_UART_IP_{1..9}_IRQHandler
        LPUART_UART_IP_MSC_IRQHandler: implemented-entry=LPUART_UART_IP_MSC_IRQHandler
package /AUTOSAR_Uart/BswModuleEntrys
  29 x bsw module entry, all with sw-service-impl-policy=STANDARD:
    Uart_Abort: service-id=0x04, is-reentrant=true, is-synchronous=true, call-type=REGULAR, execution-context=UNSPECIFIED
    Uart_AsyncReceive: service-id=0x08, is-reentrant=false, is-synchronous=false, call-type=REGULAR, execution-context=UNSPECIFIED
    Uart_AsyncSend: service-id=0x09, is-reentrant=true, is-synchronous=false, call-type=REGULAR, execution-context=UNSPECIFIED
    Uart_Deinit: service-id=0x01, is-reentrant=false, is-synchronous=true, call-type=REGULAR, execution-context=UNSPECIFIED
    Uart_GetBaudrate: service-id=0x03, is-reentrant=false, is-synchronous=true, call-type=REGULAR, execution-context=UNSPECIFIED
    Uart_GetStatus: service-id=0x0a, is-reentrant=true, is-synchronous=true, call-type=REGULAR, execution-context=UNSPECIFIED
    Uart_GetVersionInfo: service-id=0x0b, is-reentrant=false, is-synchronous=true, call-type=REGULAR, execution-context=UNSPECIFIED
    Uart_Init: service-id=0x00, is-reentrant=false, is-synchronous=true, call-type=REGULAR, execution-context=UNSPECIFIED
    Uart_SetBaudrate: service-id=0x02, is-reentrant=false, is-synchronous=true, call-type=REGULAR, execution-context=UNSPECIFIED
    Uart_SetBuffer: service-id=0x05, is-reentrant=true, is-synchronous=true, call-type=REGULAR, execution-context=UNSPECIFIED
    Uart_SyncReceive: service-id=0x07, is-reentrant=true, is-synchronous=true, call-type=REGULAR, execution-context=UNSPECIFIED
    Uart_SyncSend: service-id=0x06, is-reentrant=true, is-synchronous=true, call-type=REGULAR, execution-context=UNSPECIFIED
    LPUART_UART_IP_0_IRQHandler: service-id=0, is-reentrant=false, is-synchronous=true, call-type=INTERRUPT, execution-context=INTERRUPT-CAT-2
    LPUART_UART_IP_{10..15}_IRQHandler: service-id=0, is-reentrant=false, is-synchronous=true, call-type=INTERRUPT, execution-context=INTERRUPT-CAT-2
    LPUART_UART_IP_{1..9}_IRQHandler: service-id=0, is-reentrant=false, is-synchronous=true, call-type=INTERRUPT, execution-context=INTERRUPT-CAT-2
    LPUART_UART_IP_MSC_IRQHandler: service-id=0, is-reentrant=false, is-synchronous=true, call-type=INTERRUPT, execution-context=INTERRUPT-CAT-2
package /Uart_TS_T40D2M30I0R0/Implementations
  bsw implementation BswImplementation_0: programming-language=C, sw-version=3.0.0_QLP02, vendor-id=43, ar-release-version=4.7.0, behavior=InternalBehavior_0, vendor-specific-module-def=Uart
    code-descriptors:
      code Files
        artifact-descriptors:
          short-label=config::Uart.xdm, category=SWCFG
          short-label=doc::RTD_UART_IM.pdf, category=SWDOC
          short-label=doc::RTD_UART_UM.pdf, category=SWDOC
          short-label=examples::EBT::S32K1::Uart_Example_S32K118::generate::epc::BaseNXP.xdm, category=SWCFG
          short-label=examples::EBT::S32K1::Uart_Example_S32K118::generate::epc::EcuC.xdm, category=SWCFG
          short-label=examples::EBT::S32K1::Uart_Example_S32K118::generate::epc::Mcl.xdm, category=SWCFG
          short-label=examples::EBT::S32K1::Uart_Example_S32K118::generate::epc::Mcu.xdm, category=SWCFG
          short-label=examples::EBT::S32K1::Uart_Example_S32K118::generate::epc::Platform.xdm, category=SWCFG
          short-label=examples::EBT::S32K1::Uart_Example_S32K118::generate::epc::Port.xdm, category=SWCFG
          short-label=examples::EBT::S32K1::Uart_Example_S32K118::generate::epc::Resource.xdm, category=SWCFG
          short-label=examples::EBT::S32K1::Uart_Example_S32K118::generate::epc::Uart.xdm, category=SWCFG
          short-label=examples::EBT::S32K1::Uart_Example_S32K118::include::check_example.h, category=SWHDR
          short-label=examples::EBT::S32K1::Uart_Example_S32K118::src::main.c, category=SWSRC
          short-label=examples::EBT::S32K1::Uart_Example_S32K118::TresosProject::Uart_Example_S32K118::.prefs::preferences.xdm, category=SWCFG
          short-label=examples::EBT::S32K1::Uart_Example_S32K118::TresosProject::Uart_Example_S32K118::config::BaseNXP.xdm, category=SWCFG
          short-label=examples::EBT::S32K1::Uart_Example_S32K118::TresosProject::Uart_Example_S32K118::config::EcuC.xdm, category=SWCFG
          short-label=examples::EBT::S32K1::Uart_Example_S32K118::TresosProject::Uart_Example_S32K118::config::Mcl.xdm, category=SWCFG
          short-label=examples::EBT::S32K1::Uart_Example_S32K118::TresosProject::Uart_Example_S32K118::config::Mcu.xdm, category=SWCFG
          short-label=examples::EBT::S32K1::Uart_Example_S32K118::TresosProject::Uart_Example_S32K118::config::Platform.xdm, category=SWCFG
          short-label=examples::EBT::S32K1::Uart_Example_S32K118::TresosProject::Uart_Example_S32K118::config::Port.xdm, category=SWCFG
          short-label=examples::EBT::S32K1::Uart_Example_S32K118::TresosProject::Uart_Example_S32K118::config::Resource.xdm, category=SWCFG
          short-label=examples::EBT::S32K1::Uart_Example_S32K118::TresosProject::Uart_Example_S32K118::config::Uart.xdm, category=SWCFG
          short-label=examples::EBT::S32K1::Uart_Example_S32K144::generate::epc::BaseNXP.xdm, category=SWCFG
          short-label=examples::EBT::S32K1::Uart_Example_S32K144::generate::epc::EcuC.xdm, category=SWCFG
          short-label=examples::EBT::S32K1::Uart_Example_S32K144::generate::epc::Mcl.xdm, category=SWCFG
          short-label=examples::EBT::S32K1::Uart_Example_S32K144::generate::epc::Mcu.xdm, category=SWCFG
          short-label=examples::EBT::S32K1::Uart_Example_S32K144::generate::epc::Platform.xdm, category=SWCFG
          short-label=examples::EBT::S32K1::Uart_Example_S32K144::generate::epc::Port.xdm, category=SWCFG
          short-label=examples::EBT::S32K1::Uart_Example_S32K144::generate::epc::Resource.xdm, category=SWCFG
          short-label=examples::EBT::S32K1::Uart_Example_S32K144::generate::epc::Uart.xdm, category=SWCFG
          short-label=examples::EBT::S32K1::Uart_Example_S32K144::include::check_example.h, category=SWHDR
          short-label=examples::EBT::S32K1::Uart_Example_S32K144::src::main.c, category=SWSRC
          short-label=examples::EBT::S32K1::Uart_Example_S32K144::TresosProject::Uart_Example_S32K144::.prefs::preferences.xdm, category=SWCFG
          short-label=examples::EBT::S32K1::Uart_Example_S32K144::TresosProject::Uart_Example_S32K144::config::BaseNXP.xdm, category=SWCFG
          short-label=examples::EBT::S32K1::Uart_Example_S32K144::TresosProject::Uart_Example_S32K144::config::EcuC.xdm, category=SWCFG
          short-label=examples::EBT::S32K1::Uart_Example_S32K144::TresosProject::Uart_Example_S32K144::config::Mcl.xdm, category=SWCFG
          short-label=examples::EBT::S32K1::Uart_Example_S32K144::TresosProject::Uart_Example_S32K144::config::Mcu.xdm, category=SWCFG
          short-label=examples::EBT::S32K1::Uart_Example_S32K144::TresosProject::Uart_Example_S32K144::config::Platform.xdm, category=SWCFG
          short-label=examples::EBT::S32K1::Uart_Example_S32K144::TresosProject::Uart_Example_S32K144::config::Port.xdm, category=SWCFG
          short-label=examples::EBT::S32K1::Uart_Example_S32K144::TresosProject::Uart_Example_S32K144::config::Resource.xdm, category=SWCFG
          short-label=examples::EBT::S32K1::Uart_Example_S32K144::TresosProject::Uart_Example_S32K144::config::Uart.xdm, category=SWCFG
          short-label=examples::EBT::S32K1::Uart_Example_S32K144W::generate::epc::BaseNXP.xdm, category=SWCFG
          short-label=examples::EBT::S32K1::Uart_Example_S32K144W::generate::epc::EcuC.xdm, category=SWCFG
          short-label=examples::EBT::S32K1::Uart_Example_S32K144W::generate::epc::Mcl.xdm, category=SWCFG
          short-label=examples::EBT::S32K1::Uart_Example_S32K144W::generate::epc::Mcu.xdm, category=SWCFG
          short-label=examples::EBT::S32K1::Uart_Example_S32K144W::generate::epc::Platform.xdm, category=SWCFG
          short-label=examples::EBT::S32K1::Uart_Example_S32K144W::generate::epc::Port.xdm, category=SWCFG
          short-label=examples::EBT::S32K1::Uart_Example_S32K144W::generate::epc::Resource.xdm, category=SWCFG
          short-label=examples::EBT::S32K1::Uart_Example_S32K144W::generate::epc::Uart.xdm, category=SWCFG
          short-label=examples::EBT::S32K1::Uart_Example_S32K144W::include::check_example.h, category=SWHDR
          short-label=examples::EBT::S32K1::Uart_Example_S32K144W::src::main.c, category=SWSRC
          short-label=examples::EBT::S32K1::Uart_Example_S32K144W::TresosProject::Uart_Example_S32K144W::.prefs::preferences.xdm, category=SWCFG
          short-label=examples::EBT::S32K1::Uart_Example_S32K144W::TresosProject::Uart_Example_S32K144W::config::BaseNXP.xdm, category=SWCFG
          short-label=examples::EBT::S32K1::Uart_Example_S32K144W::TresosProject::Uart_Example_S32K144W::config::EcuC.xdm, category=SWCFG
          short-label=examples::EBT::S32K1::Uart_Example_S32K144W::TresosProject::Uart_Example_S32K144W::config::Mcl.xdm, category=SWCFG
          short-label=examples::EBT::S32K1::Uart_Example_S32K144W::TresosProject::Uart_Example_S32K144W::config::Mcu.xdm, category=SWCFG
          short-label=examples::EBT::S32K1::Uart_Example_S32K144W::TresosProject::Uart_Example_S32K144W::config::Platform.xdm, category=SWCFG
          short-label=examples::EBT::S32K1::Uart_Example_S32K144W::TresosProject::Uart_Example_S32K144W::config::Port.xdm, category=SWCFG
          short-label=examples::EBT::S32K1::Uart_Example_S32K144W::TresosProject::Uart_Example_S32K144W::config::Resource.xdm, category=SWCFG
          short-label=examples::EBT::S32K1::Uart_Example_S32K144W::TresosProject::Uart_Example_S32K144W::config::Uart.xdm, category=SWCFG
          short-label=examples::EBT::S32K1::Uart_Example_S32K148::generate::epc::BaseNXP.xdm, category=SWCFG
          short-label=examples::EBT::S32K1::Uart_Example_S32K148::generate::epc::EcuC.xdm, category=SWCFG
          short-label=examples::EBT::S32K1::Uart_Example_S32K148::generate::epc::Mcl.xdm, category=SWCFG
          short-label=examples::EBT::S32K1::Uart_Example_S32K148::generate::epc::Mcu.xdm, category=SWCFG
          short-label=examples::EBT::S32K1::Uart_Example_S32K148::generate::epc::Platform.xdm, category=SWCFG
          short-label=examples::EBT::S32K1::Uart_Example_S32K148::generate::epc::Port.xdm, category=SWCFG
          short-label=examples::EBT::S32K1::Uart_Example_S32K148::generate::epc::Resource.xdm, category=SWCFG
          short-label=examples::EBT::S32K1::Uart_Example_S32K148::generate::epc::Uart.xdm, category=SWCFG
          short-label=examples::EBT::S32K1::Uart_Example_S32K148::include::check_example.h, category=SWHDR
          short-label=examples::EBT::S32K1::Uart_Example_S32K148::src::main.c, category=SWSRC
          short-label=examples::EBT::S32K1::Uart_Example_S32K148::TresosProject::Uart_Example_S32K148::.prefs::preferences.xdm, category=SWCFG
          short-label=examples::EBT::S32K1::Uart_Example_S32K148::TresosProject::Uart_Example_S32K148::config::BaseNXP.xdm, category=SWCFG
          short-label=examples::EBT::S32K1::Uart_Example_S32K148::TresosProject::Uart_Example_S32K148::config::EcuC.xdm, category=SWCFG
          short-label=examples::EBT::S32K1::Uart_Example_S32K148::TresosProject::Uart_Example_S32K148::config::Mcl.xdm, category=SWCFG
          short-label=examples::EBT::S32K1::Uart_Example_S32K148::TresosProject::Uart_Example_S32K148::config::Mcu.xdm, category=SWCFG
          short-label=examples::EBT::S32K1::Uart_Example_S32K148::TresosProject::Uart_Example_S32K148::config::Platform.xdm, category=SWCFG
          short-label=examples::EBT::S32K1::Uart_Example_S32K148::TresosProject::Uart_Example_S32K148::config::Port.xdm, category=SWCFG
          short-label=examples::EBT::S32K1::Uart_Example_S32K148::TresosProject::Uart_Example_S32K148::config::Resource.xdm, category=SWCFG
          short-label=examples::EBT::S32K1::Uart_Example_S32K148::TresosProject::Uart_Example_S32K148::config::Uart.xdm, category=SWCFG
          short-label=examples::S32DS::S32K1::LpuartFlexio_Uart_Ip_Example_S32K118::include::check_example.h, category=SWHDR
          short-label=examples::S32DS::S32K1::LpuartFlexio_Uart_Ip_Example_S32K118::Project_Settings::Startup_Code::exceptions.c, category=SWSRC
          short-label=examples::S32DS::S32K1::LpuartFlexio_Uart_Ip_Example_S32K118::Project_Settings::Startup_Code::nvic.c, category=SWSRC
          short-label=examples::S32DS::S32K1::LpuartFlexio_Uart_Ip_Example_S32K118::Project_Settings::Startup_Code::startup.c, category=SWSRC
          short-label=examples::S32DS::S32K1::LpuartFlexio_Uart_Ip_Example_S32K118::Project_Settings::Startup_Code::system.c, category=SWSRC
          short-label=examples::S32DS::S32K1::LpuartFlexio_Uart_Ip_Example_S32K118::src::main.c, category=SWSRC
          short-label=examples::S32DS::S32K1::LpuartFlexio_Uart_Ip_Example_S32K144::include::check_example.h, category=SWHDR
          short-label=examples::S32DS::S32K1::LpuartFlexio_Uart_Ip_Example_S32K144::Project_Settings::Startup_Code::exceptions.c, category=SWSRC
          short-label=examples::S32DS::S32K1::LpuartFlexio_Uart_Ip_Example_S32K144::Project_Settings::Startup_Code::nvic.c, category=SWSRC
          short-label=examples::S32DS::S32K1::LpuartFlexio_Uart_Ip_Example_S32K144::Project_Settings::Startup_Code::startup.c, category=SWSRC
          short-label=examples::S32DS::S32K1::LpuartFlexio_Uart_Ip_Example_S32K144::Project_Settings::Startup_Code::system.c, category=SWSRC
          short-label=examples::S32DS::S32K1::LpuartFlexio_Uart_Ip_Example_S32K144::src::main.c, category=SWSRC
          short-label=examples::S32DS::S32K1::LpuartFlexio_Uart_Ip_Example_S32K144W::include::check_example.h, category=SWHDR
          short-label=examples::S32DS::S32K1::LpuartFlexio_Uart_Ip_Example_S32K144W::Project_Settings::Startup_Code::exceptions.c, category=SWSRC
          short-label=examples::S32DS::S32K1::LpuartFlexio_Uart_Ip_Example_S32K144W::Project_Settings::Startup_Code::nvic.c, category=SWSRC
          short-label=examples::S32DS::S32K1::LpuartFlexio_Uart_Ip_Example_S32K144W::Project_Settings::Startup_Code::startup.c, category=SWSRC
          short-label=examples::S32DS::S32K1::LpuartFlexio_Uart_Ip_Example_S32K144W::Project_Settings::Startup_Code::system.c, category=SWSRC
          short-label=examples::S32DS::S32K1::LpuartFlexio_Uart_Ip_Example_S32K144W::src::main.c, category=SWSRC
          short-label=examples::S32DS::S32K1::LpuartFlexio_Uart_Ip_Example_S32K148::include::check_example.h, category=SWHDR
          short-label=examples::S32DS::S32K1::LpuartFlexio_Uart_Ip_Example_S32K148::Project_Settings::Startup_Code::exceptions.c, category=SWSRC
          short-label=examples::S32DS::S32K1::LpuartFlexio_Uart_Ip_Example_S32K148::Project_Settings::Startup_Code::nvic.c, category=SWSRC
          short-label=examples::S32DS::S32K1::LpuartFlexio_Uart_Ip_Example_S32K148::Project_Settings::Startup_Code::startup.c, category=SWSRC
          short-label=examples::S32DS::S32K1::LpuartFlexio_Uart_Ip_Example_S32K148::Project_Settings::Startup_Code::system.c, category=SWSRC
          short-label=examples::S32DS::S32K1::LpuartFlexio_Uart_Ip_Example_S32K148::src::main.c, category=SWSRC
          short-label=examples::S32DS::S32K1::Uart_Example_S32K118::include::check_example.h, category=SWHDR
          short-label=examples::S32DS::S32K1::Uart_Example_S32K118::Project_Settings::Startup_Code::exceptions.c, category=SWSRC
          short-label=examples::S32DS::S32K1::Uart_Example_S32K118::Project_Settings::Startup_Code::nvic.c, category=SWSRC
          short-label=examples::S32DS::S32K1::Uart_Example_S32K118::Project_Settings::Startup_Code::startup.c, category=SWSRC
          short-label=examples::S32DS::S32K1::Uart_Example_S32K118::Project_Settings::Startup_Code::system.c, category=SWSRC
          short-label=examples::S32DS::S32K1::Uart_Example_S32K118::src::main.c, category=SWSRC
          short-label=examples::S32DS::S32K1::Uart_Example_S32K144::include::check_example.h, category=SWHDR
          short-label=examples::S32DS::S32K1::Uart_Example_S32K144::Project_Settings::Startup_Code::exceptions.c, category=SWSRC
          short-label=examples::S32DS::S32K1::Uart_Example_S32K144::Project_Settings::Startup_Code::nvic.c, category=SWSRC
          short-label=examples::S32DS::S32K1::Uart_Example_S32K144::Project_Settings::Startup_Code::startup.c, category=SWSRC
          short-label=examples::S32DS::S32K1::Uart_Example_S32K144::Project_Settings::Startup_Code::system.c, category=SWSRC
          short-label=examples::S32DS::S32K1::Uart_Example_S32K144::src::main.c, category=SWSRC
          short-label=examples::S32DS::S32K1::Uart_Example_S32K144W::include::check_example.h, category=SWHDR
          short-label=examples::S32DS::S32K1::Uart_Example_S32K144W::Project_Settings::Startup_Code::exceptions.c, category=SWSRC
          short-label=examples::S32DS::S32K1::Uart_Example_S32K144W::Project_Settings::Startup_Code::nvic.c, category=SWSRC
          short-label=examples::S32DS::S32K1::Uart_Example_S32K144W::Project_Settings::Startup_Code::startup.c, category=SWSRC
          short-label=examples::S32DS::S32K1::Uart_Example_S32K144W::Project_Settings::Startup_Code::system.c, category=SWSRC
          short-label=examples::S32DS::S32K1::Uart_Example_S32K144W::src::main.c, category=SWSRC
          short-label=examples::S32DS::S32K1::Uart_Example_S32K148::include::check_example.h, category=SWHDR
          short-label=examples::S32DS::S32K1::Uart_Example_S32K148::Project_Settings::Startup_Code::exceptions.c, category=SWSRC
          short-label=examples::S32DS::S32K1::Uart_Example_S32K148::Project_Settings::Startup_Code::nvic.c, category=SWSRC
          short-label=examples::S32DS::S32K1::Uart_Example_S32K148::Project_Settings::Startup_Code::startup.c, category=SWSRC
          short-label=examples::S32DS::S32K1::Uart_Example_S32K148::Project_Settings::Startup_Code::system.c, category=SWSRC
          short-label=examples::S32DS::S32K1::Uart_Example_S32K148::src::main.c, category=SWSRC
          short-label=include::CDD_Uart.h, category=SWHDR
          short-label=include::Flexio_Uart_Ip.h, category=SWHDR
          short-label=include::Flexio_Uart_Ip_HwAccess.h, category=SWHDR
          short-label=include::Flexio_Uart_Ip_Irq.h, category=SWHDR
          short-label=include::Flexio_Uart_Ip_Types.h, category=SWHDR
          short-label=include::Lpuart_Uart_Ip.h, category=SWHDR
          short-label=include::Lpuart_Uart_Ip_HwAccess.h, category=SWHDR
          short-label=include::Lpuart_Uart_Ip_Irq.h, category=SWHDR
          short-label=include::Lpuart_Uart_Ip_Types.h, category=SWHDR
          short-label=include::Uart_Ipw.h, category=SWHDR
          short-label=include::Uart_Ipw_Types.h, category=SWHDR
          short-label=include::Uart_Types.h, category=SWHDR
          short-label=src::CDD_Uart.c, category=SWSRC
          short-label=src::Flexio_Uart_Ip.c, category=SWSRC
          short-label=src::Flexio_Uart_Ip_Irq.c, category=SWSRC
          short-label=src::Lpuart_Uart_Ip.c, category=SWSRC
          short-label=src::Lpuart_Uart_Ip_Irq.c, category=SWSRC
          short-label=src::Uart_Ipw.c, category=SWSRC
    compiler GCC_Compiler:
      name=GCC Compiler
      options=-mcpu=cortex-m4 -mcpu=cortex-m0plus -mthumb -mlittle-endian -mfpu=fpv4-sp-d16 -mfloat-abi=hard -mfpu=auto -mfloat-abi=soft -std=c99 -Os -ggdb3 -Wall -Wextra -pedantic -Wstrict-prototypes -Wundef -Wunused -Werror=implicit-function-declaration -Wsign-compare -Wdouble-promotion -fno-short-enums -funsigned-char -funsigned-bitfields -fomit-frame-pointer -fno-common -fstack-usage -fdump-ipa-all -c -DUSE_SW_VECTOR_MODE -DI_CACHE_ENABLE -DENABLE_FPU -DMCAL_ENABLE_USER_MODE_SUPPORT --sysroot=$(NEWLIB_DIR) -specs=nano.specs -specs=nosys.specs
      vendor=GCC Systems
      version=NXP GCC 10.2.0 20200723 (Build 1728 Revision g5963bc8)
    compiler GHS_Compiler:
      name=Green Hills
      options=-cpu=cortexm4 -cpu=cortexm0plus -thumb -fpu=vfpv4_d16 -fsingle -fsoft -C99 --ghstd=last -Osize --gnu_asm -dual_debug -G -keeptempfiles -Wimplicit-int -Wshadow -Wtrigraphs -Wundef --unsigned_chars --unsigned_fields --no_commons --no_exceptions --no_slash_comment --prototype_errors --incorrect_pragma_warnings -c -DUSE_SW_VECTOR_MODE -DI_CACHE_ENABLE -DENABLE_FPU -DMCAL_ENABLE_USER_MODE_SUPPORT
      vendor=Green Hills
      version=Green Hills Multi 7.1.6d / Compiler 2020.1.4
    compiler IAR_Compiler:
      name=IAR Compiler
      options=--cpu=Cortex-M4 --cpu=Cortex-M0+ --cpu_mode=thumb --endian=little --fpu=FPv4-SP --fpu=none -e -Ohz --debug --no_clustering --no_mem_idioms --no_explicit_zero_opt --require_prototypes --no_wrap_diagnostics --diag_suppress=Pa050 -DIAR -DUSE_SW_VECTOR_MODE -DI_CACHE_ENABLE -DENABLE_FPU -DMCAL_ENABLE_USER_MODE_SUPPORT
      vendor=IAR Systems
      version=IAR ANSI C/C++ Compiler V8.40.3.228/W32 for ARM Functional Safety
    generated-artifacts:
      16 x dependency on artifact:
        CDD_Uart_PBcfg_h: artifact-descriptor={short-label=generate_PB::include::CDD_Uart_PBcfg.h, category=SWHDR}, usages=EXECUTE
        Flexio_Uart_Ip_PBcfg_h: artifact-descriptor={short-label=generate_PB::include::Flexio_Uart_Ip_PBcfg.h, category=SWHDR}, usages=EXECUTE
        Lpuart_Uart_Ip_PBcfg_h: artifact-descriptor={short-label=generate_PB::include::Lpuart_Uart_Ip_PBcfg.h, category=SWHDR}, usages=EXECUTE
        Uart_Ipw_PBcfg_h: artifact-descriptor={short-label=generate_PB::include::Uart_Ipw_PBcfg.h, category=SWHDR}, usages=EXECUTE
        CDD_Uart_PBcfg_c: artifact-descriptor={short-label=generate_PB::src::CDD_Uart_PBcfg.c, category=SWSRC}, usages=EXECUTE
        Flexio_Uart_Ip_PBcfg_c: artifact-descriptor={short-label=generate_PB::src::Flexio_Uart_Ip_PBcfg.c, category=SWSRC}, usages=EXECUTE
        Lpuart_Uart_Ip_PBcfg_c: artifact-descriptor={short-label=generate_PB::src::Lpuart_Uart_Ip_PBcfg.c, category=SWSRC}, usages=EXECUTE
        Uart_Ipw_PBcfg_c: artifact-descriptor={short-label=generate_PB::src::Uart_Ipw_PBcfg.c, category=SWSRC}, usages=EXECUTE
        CDD_Uart_Cfg_h: artifact-descriptor={short-label=generate_PC::include::CDD_Uart_Cfg.h, category=SWHDR}, usages=COMPILE
        CDD_Uart_Defines_h: artifact-descriptor={short-label=generate_PC::include::CDD_Uart_Defines.h, category=SWHDR}, usages=COMPILE
        Flexio_Uart_Ip_Cfg_h: artifact-descriptor={short-label=generate_PC::include::Flexio_Uart_Ip_Cfg.h, category=SWHDR}, usages=COMPILE
        Flexio_Uart_Ip_CfgDefines_h: artifact-descriptor={short-label=generate_PC::include::Flexio_Uart_Ip_CfgDefines.h, category=SWHDR}, usages=COMPILE
        Flexio_Uart_Ip_Defines_h: artifact-descriptor={short-label=generate_PC::include::Flexio_Uart_Ip_Defines.h, category=SWHDR}, usages=COMPILE
        Lpuart_Uart_Ip_Cfg_h: artifact-descriptor={short-label=generate_PC::include::Lpuart_Uart_Ip_Cfg.h, category=SWHDR}, usages=COMPILE
        Lpuart_Uart_Ip_Defines_h: artifact-descriptor={short-label=generate_PC::include::Lpuart_Uart_Ip_Defines.h, category=SWHDR}, usages=COMPILE
        Uart_Ipw_Cfg_h: artifact-descriptor={short-label=generate_PC::include::Uart_Ipw_Cfg.h, category=SWHDR}, usages=COMPILE
    linker GCC_Linker: name=GCC Compiler, options=-Wl,-Map,filename -T linkerfile --entry=Reset_Handler -nostartfiles -mcpu=cortex-m4 -mcpu=cortex-m0plus -mthumb -mfpu=fpv4-sp-d16 -mfloat-abi=hard -mfpu=auto -mfloat-abi=soft -mlittle-endian -ggdb3 -lc -lm -lgcc -n --sysroot=$(NEWLIB_DIR) -specs=nano.specs -specs=nosys.specs, vendor=GCC Systems, version=NXP GCC 10.2.0 20200723 (Build 1728 Revision g5963bc8)
    linker GHS_Linker: name=Green Hills, options=-e Reset_Handler -T linker_script_file.ld -map -keepmap -Mn -delete -ignore_debug_references -Llibrary_path -larch -lstartup -lind_sd -lind_sf -v -keep=C40_Ip_AccessCode -nostartfiles, vendor=Green Hills, version=Green Hills Multi 7.1.6d / Compiler 2020.1.4
    linker IAR_Linker: name=IAR Compiler, options=--map filename --config linkerfile --cpu=Cortex-M4 --cpu=Cortex-M0+ --fpu=FPv4-SP --fpu=none --entry _start --enable_stack_usage --skip_dynamic_initialization --no_wrap_diagnostics, vendor=IAR Systems, version=IAR ANSI C/C++ Compiler V8.40.3.228/W32 for ARM Functional Safety
    resource consumption ResourceConsumption
      8 x memory section:
        UART_CODE: alignment=UNSPECIFIED, sw-addrmethod=CODE, symbol=CODE
        UART_CONFIG_DATA_UNSPECIFIED: alignment=UNSPECIFIED, sw-addrmethod=CONFIG_DATA, symbol=CONFIG_DATA_UNSPECIFIED
        UART_CONST_BOOLEAN: alignment=BOOLEAN, sw-addrmethod=CONST, symbol=CONST_BOOLEAN
        UART_CONST_UNSPECIFIED: alignment=UNSPECIFIED, sw-addrmethod=CONST, symbol=CONST_UNSPECIFIED
        UART_VAR_CLEARED_32_NO_CACHEABLE: alignment=32, sw-addrmethod=VAR_CLEARED_NO_CACHEABLE, symbol=VAR_CLEARED_32_NO_CACHEABLE
        UART_VAR_CLEARED_UNSPECIFIED: alignment=UNSPECIFIED, sw-addrmethod=VAR_CLEARED, symbol=VAR_CLEARED_UNSPECIFIED
        UART_VAR_CLEARED_UNSPECIFIED_NO_CACHEABLE: alignment=UNSPECIFIED, sw-addrmethod=VAR_CLEARED_NO_CACHEABLE, symbol=VAR_CLEARED_UNSPECIFIED_NO_CACHEABLE
        UART_VAR_INIT_8_NO_CACHEABLE: alignment=8, sw-addrmethod=VAR_INIT_NO_CACHEABLE, symbol=VAR_INIT_8_NO_CACHEABLE
