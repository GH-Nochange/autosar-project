AUTOSAR XML (schema 00050)
package /AUTOSAR_LinTrcv_43_AE/BswModuleDescriptions
  bsw module description LinTrcv: module-id=64
    provided-entrys:
      LinTrcv_CheckWakeup
      LinTrcv_GetBusWuReason
      LinTrcv_GetOpMode
      LinTrcv_GetVersionInfo
      LinTrcv_Init
      LinTrcv_SetOpMode
      LinTrcv_SetWakeupMode
    bsw internal behavior InternalBehavior_0
      7 x bsw called entity:
        LinTrcv_43_AE_CheckWakeup: implemented-entry=LinTrcv_CheckWakeup
        LinTrcv_43_AE_GetBusWuReason: implemented-entry=LinTrcv_GetBusWuReason
        LinTrcv_43_AE_GetOpMode: implemented-entry=LinTrcv_GetOpMode
        LinTrcv_43_AE_GetVersionInfo: implemented-entry=LinTrcv_GetVersionInfo
        LinTrcv_43_AE_Init: implemented-entry=LinTrcv_Init
        LinTrcv_43_AE_SetOpMode: implemented-entry=LinTrcv_SetOpMode
        LinTrcv_43_AE_SetWakeupMode: implemented-entry=LinTrcv_SetWakeupMode
package /AUTOSAR_LinTrcv_43_AE/BswModuleEntrys
  7 x bsw module entry, all with is-synchronous=true, call-type=REGULAR, execution-context=UNSPECIFIED, sw-service-impl-policy=STANDARD:
    LinTrcv_CheckWakeup: service-id=0x07, is-reentrant=true
    LinTrcv_GetBusWuReason: service-id=0x03, is-reentrant=true
    LinTrcv_GetOpMode: service-id=0x02, is-reentrant=true
    LinTrcv_GetVersionInfo: service-id=0x04, is-reentrant=true
    LinTrcv_Init: service-id=0x00, is-reentrant=false
    LinTrcv_SetOpMode: service-id=0x01, is-reentrant=false
    LinTrcv_SetWakeupMode: service-id=0x05, is-reentrant=false
package /LinTrcv_43_AE_TS_T40D2M30I0R0/Implementations
  bsw implementation BswImplementation_0: programming-language=C, sw-version=3.0.0_QLP02, vendor-id=43, ar-release-version=4.7.0, behavior=InternalBehavior_0, vendor-api-infix=AE, vendor-specific-module-def=LinTrcv
    code-descriptors:
      code Files
        artifact-descriptors:
          short-label=config::LinTrcv_43_AE.xdm, category=SWCFG
          short-label=doc::RTD_LINTRCV_43_AE_IM.pdf, category=SWDOC
          short-label=doc::RTD_LINTRCV_43_AE_UM.pdf, category=SWDOC
          short-label=EBT::LinTrcv.xdm, category=SWCFG
          short-label=include::AeLinPhy_LinTrcv_Ip.h, category=SWHDR
          short-label=include::AeLinPhy_LinTrcv_Ip_Types.h, category=SWHDR
          short-label=include::LinTrcv_43_AE.h, category=SWHDR
          short-label=include::LinTrcv_43_AE_Ipw.h, category=SWHDR
          short-label=include::LinTrcv_43_AE_Ipw_Types.h, category=SWHDR
          short-label=include::LinTrcv_43_AE_Types.h, category=SWHDR
          short-label=src::AeLinPhy_LinTrcv_Ip.c, category=SWSRC
          short-label=src::LinTrcv_43_AE.c, category=SWSRC
          short-label=src::LinTrcv_43_AE_Ipw.c, category=SWSRC
    compiler GCC_Compiler:
      name=GCC Compiler
      options=-mcpu=cortex-m4 -mcpu=cortex-m0plus -mthumb -mlittle-endian -mfpu=fpv4-sp-d16 -mfloat-abi=hard -mfpu=auto -mfloat-abi=soft -std=c99 -Os -ggdb3 -Wall -Wextra -pedantic -Wstrict-prototypes -Wundef -Wunused -Werror=implicit-function-declaration -Wsign-compare -Wdouble-promotion -fno-short-enums -funsigned-char -funsigned-bitfields -fomit-frame-pointer -fno-common -fstack-usage -fdump-ipa-all -c -DUSE_SW_VECTOR_MODE -DI_CACHE_ENABLE -DENABLE_FPU -DMCAL_ENABLE_USER_MODE_SUPPORT --sysroot=$(NEWLIB_DIR) -specs=nano.specs -specs=nosys.specs
      vendor=GCC Systems
      version=NXP GCC 10.2.0 20200723 (Build 1728 Revision g5963bc8)
    compiler GHS_Compiler:
      name=Green Hills
      options=-cpu=cortexm4 -cpu=cortexm0plus -thumb -fpu=vfpv4_d16 -fsingle -fsoft -C99 --ghstd=last -Osize --gnu_asm -dual_debug -G -keeptempfiles -Wimplicit-int -Wshadow -Wtrigraphs -Wundef --unsigned_chars --unsigned_fields --no_commons --no_exceptions --no_slash_comment --prototype_errors --incorrect_pragma_warnings -c -DUSE_SW_VECTOR_MODE -DI_CACHE_ENABLE -DENABLE_FPU -DMCAL_ENABLE_USER_MODE_SUPPORT
      vendor=Green Hills
      version=Green Hills Multi 7.1.6d / Compiler 2020.1.4
    compiler IAR_Compiler:
      name=IAR Compiler
      options=--cpu=Cortex-M4 --cpu=Cortex-M0+ --cpu_mode=thumb --endian=little --fpu=FPv4-SP --fpu=none -e -Ohz --debug --no_clustering --no_mem_idioms --no_explicit_zero_opt --require_prototypes --no_wrap_diagnostics --diag_suppress=Pa050 -DIAR -DUSE_SW_VECTOR_MODE -DI_CACHE_ENABLE -DENABLE_FPU -DMCAL_ENABLE_USER_MODE_SUPPORT
      vendor=IAR Systems
      version=IAR ANSI C/C++ Compiler V8.40.3.228/W32 for ARM Functional Safety
    generated-artifacts:
      6 x dependency on artifact, all with usages=COMPILE:
        AeLinPhy_LinTrcv_Ip_Cfg_h: artifact-descriptor={short-label=generate::include::AeLinPhy_LinTrcv_Ip_Cfg.h, category=SWHDR}
        LinTrcv_43_AE_Cfg_h: artifact-descriptor={short-label=generate::include::LinTrcv_43_AE_Cfg.h, category=SWHDR}
        LinTrcv_43_AE_Ipw_Cfg_h: artifact-descriptor={short-label=generate::include::LinTrcv_43_AE_Ipw_Cfg.h, category=SWHDR}
        AeLinPhy_LinTrcv_Ip_Cfg_c: artifact-descriptor={short-label=generate::src::AeLinPhy_LinTrcv_Ip_Cfg.c, category=SWSRC}
        LinTrcv_43_AE_Cfg_c: artifact-descriptor={short-label=generate::src::LinTrcv_43_AE_Cfg.c, category=SWSRC}
        LinTrcv_43_AE_Ipw_Cfg_c: artifact-descriptor={short-label=generate::src::LinTrcv_43_AE_Ipw_Cfg.c, category=SWSRC}
    linker GCC_Linker: name=GCC Compiler, options=-Wl,-Map,filename -T linkerfile --entry=Reset_Handler -nostartfiles -mcpu=cortex-m4 -mcpu=cortex-m0plus -mthumb -mfpu=fpv4-sp-d16 -mfloat-abi=hard -mfpu=auto -mfloat-abi=soft -mlittle-endian -ggdb3 -lc -lm -lgcc -n --sysroot=$(NEWLIB_DIR) -specs=nano.specs -specs=nosys.specs, vendor=GCC Systems, version=NXP GCC 10.2.0 20200723 (Build 1728 Revision g5963bc8)
    linker GHS_Linker: name=Green Hills, options=-e Reset_Handler -T linker_script_file.ld -map -keepmap -Mn -delete -ignore_debug_references -Llibrary_path -larch -lstartup -lind_sd -lind_sf -v -keep=C40_Ip_AccessCode -nostartfiles, vendor=Green Hills, version=Green Hills Multi 7.1.6d / Compiler 2020.1.4
    linker IAR_Linker: name=IAR Compiler, options=--map filename --config linkerfile --cpu=Cortex-M4 --cpu=Cortex-M0+ --fpu=FPv4-SP --fpu=none --entry _start --enable_stack_usage --skip_dynamic_initialization --no_wrap_diagnostics, vendor=IAR Systems, version=IAR ANSI C/C++ Compiler V8.40.3.228/W32 for ARM Functional Safety
    resource consumption ResourceConsumption
      5 x memory section:
        LINTRCV_43_AE_CODE: alignment=UNSPECIFIED, sw-addrmethod=CODE, symbol=CODE
        LINTRCV_43_AE_CONFIG_DATA_UNSPECIFIED: alignment=UNSPECIFIED, sw-addrmethod=CONFIG_DATA, symbol=CONFIG_DATA_UNSPECIFIED
        LINTRCV_43_AE_VAR_CLEARED_8: alignment=8, sw-addrmethod=VAR_CLEARED, symbol=VAR_CLEARED_8
        LINTRCV_43_AE_VAR_CLEARED_UNSPECIFIED: alignment=UNSPECIFIED, sw-addrmethod=VAR_CLEARED, symbol=VAR_CLEARED_UNSPECIFIED
        LINTRCV_43_AE_VAR_INIT_8: alignment=8, sw-addrmethod=VAR_INIT, symbol=VAR_INIT_8
