AUTOSAR XML (schema 00050)
package /AUTOSAR_Adc/BswModuleDescriptions
  bsw module description Adc: module-id=123
    provided-entrys:
      Adc_Calibrate
      Adc_DeInit
      Adc_DisableGroupNotification
      Adc_DisableHardwareTrigger
      Adc_EnableGroupNotification
      Adc_EnableHardwareTrigger
      Adc_GetCurrentPowerState
      Adc_GetGroupStatus
      Adc_GetStreamLastPointer
      Adc_GetTargetPowerState
      Adc_GetVersionInfo
      Adc_Init
      Adc_Ip_ClearLatchedTriggers
      Adc_Ip_ClearTrigErrReg
      Adc_Ip_DisableChannelNotification
      Adc_Ip_EnableChannelNotification
      Adc_Ip_SetSoftwarePretrigger
      Adc_Ip_StartConversion
      Adc_Main_PowerTransitionManager
      Adc_PreparePowerState
      Adc_ReadGroup
      Adc_ReadRawData
      Adc_SetChannel
      Adc_SetClockMode
      Adc_SetPowerState
      Adc_SetupResultBuffer
      Adc_StartGroupConversion
      Adc_StopGroupConversion
      Pdb_Adc_Ip_ClearAdcPretriggerFlags
      Pdb_Adc_Ip_SetAdcPretriggerBackToBack
      Pdb_Adc_Ip_SetAdcPretriggerDelayEnable
      Pdb_Adc_Ip_SetAdcPretriggerEnable
      Adc_0_Isr
      Adc_1_Isr
      Pdb_0_Isr
      Pdb_1_Isr
    bsw internal behavior InternalBehavior_0
      42 x exclusive area:
        ADC_EXCLUSIVE_AREA_{00..03}
        ADC_EXCLUSIVE_AREA_{10..32}
        ADC_EXCLUSIVE_AREA_{34..48}
      32 x bsw called entity:
        Adc_Calibrate: can-enter-exclusive-area=[ADC_EXCLUSIVE_AREA_13, ADC_EXCLUSIVE_AREA_15, ADC_EXCLUSIVE_AREA_24, ADC_EXCLUSIVE_AREA_29], implemented-entry=Adc_Calibrate
        Adc_DeInit: implemented-entry=Adc_DeInit
        Adc_DisableGroupNotification: implemented-entry=Adc_DisableGroupNotification
        Adc_DisableHardwareTrigger: can-enter-exclusive-area=[ADC_EXCLUSIVE_AREA_21, ADC_EXCLUSIVE_AREA_22, ADC_EXCLUSIVE_AREA_32, ADC_EXCLUSIVE_AREA_40, ADC_EXCLUSIVE_AREA_45, ADC_EXCLUSIVE_AREA_47], implemented-entry=Adc_DisableHardwareTrigger
        Adc_EnableGroupNotification: implemented-entry=Adc_EnableGroupNotification
        Adc_EnableHardwareTrigger: can-enter-exclusive-area=[ADC_EXCLUSIVE_AREA_16, ADC_EXCLUSIVE_AREA_21, ADC_EXCLUSIVE_AREA_26, ADC_EXCLUSIVE_AREA_27, ADC_EXCLUSIVE_AREA_32, ADC_EXCLUSIVE_AREA_34, ADC_EXCLUSIVE_AREA_35, ADC_EXCLUSIVE_AREA_36, ADC_EXCLUSIVE_AREA_38, ADC_EXCLUSIVE_AREA_39, ADC_EXCLUSIVE_AREA_40, ADC_EXCLUSIVE_AREA_41, ADC_EXCLUSIVE_AREA_45, ADC_EXCLUSIVE_AREA_47, ADC_EXCLUSIVE_AREA_48], implemented-entry=Adc_EnableHardwareTrigger
        Adc_GetCurrentPowerState: implemented-entry=Adc_GetCurrentPowerState
        Adc_GetGroupStatus: implemented-entry=Adc_GetGroupStatus
        Adc_GetStreamLastPointer: implemented-entry=Adc_GetStreamLastPointer
        Adc_GetTargetPowerState: implemented-entry=Adc_GetTargetPowerState
        Adc_GetVersionInfo: implemented-entry=Adc_GetVersionInfo
        Adc_Init: can-enter-exclusive-area=ADC_EXCLUSIVE_AREA_10, implemented-entry=Adc_Init
        Adc_Ip_ClearLatchedTriggers: can-enter-exclusive-area=ADC_EXCLUSIVE_AREA_12, implemented-entry=Adc_Ip_ClearLatchedTriggers
        Adc_Ip_ClearTrigErrReg: can-enter-exclusive-area=ADC_EXCLUSIVE_AREA_25, implemented-entry=Adc_Ip_ClearTrigErrReg
        Adc_Ip_DisableChannelNotification: can-enter-exclusive-area=ADC_EXCLUSIVE_AREA_20, implemented-entry=Adc_Ip_DisableChannelNotification
        Adc_Ip_EnableChannelNotification: can-enter-exclusive-area=ADC_EXCLUSIVE_AREA_19, implemented-entry=Adc_Ip_EnableChannelNotification
        Adc_Ip_SetSoftwarePretrigger: can-enter-exclusive-area=ADC_EXCLUSIVE_AREA_31, implemented-entry=Adc_Ip_SetSoftwarePretrigger
        Adc_Ip_StartConversion: can-enter-exclusive-area=ADC_EXCLUSIVE_AREA_18, implemented-entry=Adc_Ip_StartConversion
        Adc_Main_PowerTransitionManager: implemented-entry=Adc_Main_PowerTransitionManager
        Adc_PreparePowerState: implemented-entry=Adc_PreparePowerState
        Adc_ReadGroup: can-enter-exclusive-area=[ADC_EXCLUSIVE_AREA_00, ADC_EXCLUSIVE_AREA_03, ADC_EXCLUSIVE_AREA_16, ADC_EXCLUSIVE_AREA_17, ADC_EXCLUSIVE_AREA_21, ADC_EXCLUSIVE_AREA_22, ADC_EXCLUSIVE_AREA_23, ADC_EXCLUSIVE_AREA_26, ADC_EXCLUSIVE_AREA_27, ADC_EXCLUSIVE_AREA_32, ADC_EXCLUSIVE_AREA_34, ADC_EXCLUSIVE_AREA_35, ADC_EXCLUSIVE_AREA_36, ADC_EXCLUSIVE_AREA_37, ADC_EXCLUSIVE_AREA_38, ADC_EXCLUSIVE_AREA_39, ADC_EXCLUSIVE_AREA_40, ADC_EXCLUSIVE_AREA_41, ADC_EXCLUSIVE_AREA_45, ADC_EXCLUSIVE_AREA_47, ADC_EXCLUSIVE_AREA_48], implemented-entry=Adc_ReadGroup
        Adc_ReadRawData: implemented-entry=Adc_ReadRawData
        Adc_SetChannel: implemented-entry=Adc_SetChannel
        Adc_SetClockMode: can-enter-exclusive-area=[ADC_EXCLUSIVE_AREA_11, ADC_EXCLUSIVE_AREA_14, ADC_EXCLUSIVE_AREA_28], implemented-entry=Adc_SetClockMode
        Adc_SetPowerState: implemented-entry=Adc_SetPowerState
        Adc_SetupResultBuffer: implemented-entry=Adc_SetupResultBuffer
        Adc_StartGroupConversion: can-enter-exclusive-area=[ADC_EXCLUSIVE_AREA_01, ADC_EXCLUSIVE_AREA_16, ADC_EXCLUSIVE_AREA_17, ADC_EXCLUSIVE_AREA_21, ADC_EXCLUSIVE_AREA_22, ADC_EXCLUSIVE_AREA_23, ADC_EXCLUSIVE_AREA_26, ADC_EXCLUSIVE_AREA_27, ADC_EXCLUSIVE_AREA_30, ADC_EXCLUSIVE_AREA_32, ADC_EXCLUSIVE_AREA_34, ADC_EXCLUSIVE_AREA_35, ADC_EXCLUSIVE_AREA_36, ADC_EXCLUSIVE_AREA_37, ADC_EXCLUSIVE_AREA_38, ADC_EXCLUSIVE_AREA_39, ADC_EXCLUSIVE_AREA_40, ADC_EXCLUSIVE_AREA_41, ADC_EXCLUSIVE_AREA_45, ADC_EXCLUSIVE_AREA_47, ADC_EXCLUSIVE_AREA_48], implemented-entry=Adc_StartGroupConversion
        Adc_StopGroupConversion: can-enter-exclusive-area=[ADC_EXCLUSIVE_AREA_00, ADC_EXCLUSIVE_AREA_02, ADC_EXCLUSIVE_AREA_16, ADC_EXCLUSIVE_AREA_17, ADC_EXCLUSIVE_AREA_21, ADC_EXCLUSIVE_AREA_22, ADC_EXCLUSIVE_AREA_23, ADC_EXCLUSIVE_AREA_26, ADC_EXCLUSIVE_AREA_27, ADC_EXCLUSIVE_AREA_30, ADC_EXCLUSIVE_AREA_32, ADC_EXCLUSIVE_AREA_34, ADC_EXCLUSIVE_AREA_35, ADC_EXCLUSIVE_AREA_36, ADC_EXCLUSIVE_AREA_37, ADC_EXCLUSIVE_AREA_38, ADC_EXCLUSIVE_AREA_39, ADC_EXCLUSIVE_AREA_40, ADC_EXCLUSIVE_AREA_41, ADC_EXCLUSIVE_AREA_45, ADC_EXCLUSIVE_AREA_47, ADC_EXCLUSIVE_AREA_48], implemented-entry=Adc_StopGroupConversion
        Pdb_Adc_Ip_ClearAdcPretriggerFlags: can-enter-exclusive-area=ADC_EXCLUSIVE_AREA_46, implemented-entry=Pdb_Adc_Ip_ClearAdcPretriggerFlags
        Pdb_Adc_Ip_SetAdcPretriggerBackToBack: can-enter-exclusive-area=ADC_EXCLUSIVE_AREA_42, implemented-entry=Pdb_Adc_Ip_SetAdcPretriggerBackToBack
        Pdb_Adc_Ip_SetAdcPretriggerDelayEnable: can-enter-exclusive-area=ADC_EXCLUSIVE_AREA_44, implemented-entry=Pdb_Adc_Ip_SetAdcPretriggerDelayEnable
        Pdb_Adc_Ip_SetAdcPretriggerEnable: can-enter-exclusive-area=ADC_EXCLUSIVE_AREA_43, implemented-entry=Pdb_Adc_Ip_SetAdcPretriggerEnable
      4 x bsw interrupt entity, all with interrupt-category=CAT-2, interrupt-source=Hardware:
        Adc_0_Isr: implemented-entry=Adc_0_Isr
        Adc_1_Isr: implemented-entry=Adc_1_Isr
        Pdb_0_Isr: implemented-entry=Pdb_0_Isr
        Pdb_1_Isr: implemented-entry=Pdb_1_Isr
package /AUTOSAR_Adc/BswModuleEntrys
  36 x bsw module entry, all with sw-service-impl-policy=STANDARD:
    Adc_Calibrate: service-id=0x29, is-reentrant=false, is-synchronous=true, call-type=REGULAR, execution-context=UNSPECIFIED
    Adc_DeInit: service-id=0x01, is-reentrant=false, is-synchronous=true, call-type=REGULAR, execution-context=UNSPECIFIED
    Adc_DisableGroupNotification: service-id=0x08, is-reentrant=true, is-synchronous=false, call-type=REGULAR, execution-context=UNSPECIFIED
    Adc_DisableHardwareTrigger: service-id=0x06, is-reentrant=true, is-synchronous=false, call-type=REGULAR, execution-context=UNSPECIFIED
    Adc_EnableGroupNotification: service-id=0x07, is-reentrant=true, is-synchronous=false, call-type=REGULAR, execution-context=UNSPECIFIED
    Adc_EnableHardwareTrigger: service-id=0x05, is-reentrant=true, is-synchronous=false, call-type=REGULAR, execution-context=UNSPECIFIED
    Adc_GetCurrentPowerState: service-id=0x11, is-reentrant=false, is-synchronous=true, call-type=REGULAR, execution-context=UNSPECIFIED
    Adc_GetGroupStatus: service-id=0x09, is-reentrant=true, is-synchronous=true, call-type=REGULAR, execution-context=UNSPECIFIED
    Adc_GetStreamLastPointer: service-id=0x0b, is-reentrant=true, is-synchronous=true, call-type=REGULAR, execution-context=UNSPECIFIED
    Adc_GetTargetPowerState: service-id=0x12, is-reentrant=false, is-synchronous=true, call-type=REGULAR, execution-context=UNSPECIFIED
    Adc_GetVersionInfo: service-id=0x0a, is-reentrant=true, is-synchronous=true, call-type=REGULAR, execution-context=UNSPECIFIED
    Adc_Init: service-id=0x00, is-reentrant=false, is-synchronous=true, call-type=REGULAR, execution-context=UNSPECIFIED
    Adc_Ip_ClearLatchedTriggers: service-id=0xf7, is-reentrant=false, is-synchronous=true, call-type=REGULAR, execution-context=UNSPECIFIED
    Adc_Ip_ClearTrigErrReg: service-id=0xf3, is-reentrant=false, is-synchronous=true, call-type=REGULAR, execution-context=UNSPECIFIED
    Adc_Ip_DisableChannelNotification: service-id=0xf4, is-reentrant=false, is-synchronous=true, call-type=REGULAR, execution-context=UNSPECIFIED
    Adc_Ip_EnableChannelNotification: service-id=0xf5, is-reentrant=false, is-synchronous=true, call-type=REGULAR, execution-context=UNSPECIFIED
    Adc_Ip_SetSoftwarePretrigger: service-id=0xf2, is-reentrant=false, is-synchronous=true, call-type=REGULAR, execution-context=UNSPECIFIED
    Adc_Ip_StartConversion: service-id=0xf6, is-reentrant=false, is-synchronous=true, call-type=REGULAR, execution-context=UNSPECIFIED
    Adc_Main_PowerTransitionManager: service-id=0x14, is-reentrant=false, is-synchronous=true, call-type=REGULAR, execution-context=UNSPECIFIED
    Adc_PreparePowerState: service-id=0x13, is-reentrant=false, is-synchronous=true, call-type=REGULAR, execution-context=UNSPECIFIED
    Adc_ReadGroup: service-id=0x04, is-reentrant=true, is-synchronous=true, call-type=REGULAR, execution-context=UNSPECIFIED
    Adc_ReadRawData: service-id=0x42, is-reentrant=false, is-synchronous=true, call-type=REGULAR, execution-context=UNSPECIFIED
    Adc_SetChannel: service-id=0x30, is-reentrant=false, is-synchronous=true, call-type=REGULAR, execution-context=UNSPECIFIED
    Adc_SetClockMode: service-id=0x25, is-reentrant=false, is-synchronous=true, call-type=REGULAR, execution-context=UNSPECIFIED
    Adc_SetPowerState: service-id=0x10, is-reentrant=false, is-synchronous=true, call-type=REGULAR, execution-context=UNSPECIFIED
    Adc_SetupResultBuffer: service-id=0x0c, is-reentrant=true, is-synchronous=false, call-type=REGULAR, execution-context=UNSPECIFIED
    Adc_StartGroupConversion: service-id=0x02, is-reentrant=true, is-synchronous=false, call-type=REGULAR, execution-context=UNSPECIFIED
    Adc_StopGroupConversion: service-id=0x03, is-reentrant=true, is-synchronous=true, call-type=REGULAR, execution-context=UNSPECIFIED
    Pdb_Adc_Ip_ClearAdcPretriggerFlags: service-id=0xee, is-reentrant=false, is-synchronous=true, call-type=REGULAR, execution-context=UNSPECIFIED
    Pdb_Adc_Ip_SetAdcPretriggerBackToBack: service-id=0xf1, is-reentrant=false, is-synchronous=true, call-type=REGULAR, execution-context=UNSPECIFIED
    Pdb_Adc_Ip_SetAdcPretriggerDelayEnable: service-id=0xef, is-reentrant=false, is-synchronous=true, call-type=REGULAR, execution-context=UNSPECIFIED
    Pdb_Adc_Ip_SetAdcPretriggerEnable: service-id=0xf0, is-reentrant=false, is-synchronous=true, call-type=REGULAR, execution-context=UNSPECIFIED
    Adc_0_Isr: service-id=0, is-reentrant=false, is-synchronous=true, call-type=INTERRUPT, execution-context=INTERRUPT-CAT-2
    Adc_1_Isr: service-id=0, is-reentrant=false, is-synchronous=true, call-type=INTERRUPT, execution-context=INTERRUPT-CAT-2
    Pdb_0_Isr: service-id=0, is-reentrant=false, is-synchronous=true, call-type=INTERRUPT, execution-context=INTERRUPT-CAT-2
    Pdb_1_Isr: service-id=0, is-reentrant=false, is-synchronous=true, call-type=INTERRUPT, execution-context=INTERRUPT-CAT-2
package /Adc_TS_T40D2M30I0R0/Implementations
  bsw implementation BswImplementation_0: programming-language=C, sw-version=3.0.0_QLP02, vendor-id=43, ar-release-version=4.7.0, behavior=InternalBehavior_0, vendor-specific-module-def=Adc
    code-descriptors:
      code Files
        artifact-descriptors:
          short-label=config::Adc.xdm, category=SWCFG
          short-label=doc::RTD_ADC_IM.pdf, category=SWDOC
          short-label=doc::RTD_ADC_UM.pdf, category=SWDOC
          short-label=EBT::Adc.xdm, category=SWCFG
          short-label=examples::EBT::S32K1::Adc_example_S32K118::generate::epc::Adc.xdm, category=SWCFG
          short-label=examples::EBT::S32K1::Adc_example_S32K118::generate::epc::BaseNXP.xdm, category=SWCFG
          short-label=examples::EBT::S32K1::Adc_example_S32K118::generate::epc::Dem.xdm, category=SWCFG
          short-label=examples::EBT::S32K1::Adc_example_S32K118::generate::epc::EcuC.xdm, category=SWCFG
          short-label=examples::EBT::S32K1::Adc_example_S32K118::generate::epc::Mcu.xdm, category=SWCFG
          short-label=examples::EBT::S32K1::Adc_example_S32K118::generate::epc::Platform.xdm, category=SWCFG
          short-label=examples::EBT::S32K1::Adc_example_S32K118::generate::epc::Resource.xdm, category=SWCFG
          short-label=examples::EBT::S32K1::Adc_example_S32K118::include::check_example.h, category=SWHDR
          short-label=examples::EBT::S32K1::Adc_example_S32K118::src::main.c, category=SWSRC
          short-label=examples::EBT::S32K1::Adc_example_S32K118::TresosProject::Adc_example_S32K118::.prefs::preferences.xdm, category=SWCFG
          short-label=examples::EBT::S32K1::Adc_example_S32K118::TresosProject::Adc_example_S32K118::config::Adc.xdm, category=SWCFG
          short-label=examples::EBT::S32K1::Adc_example_S32K118::TresosProject::Adc_example_S32K118::config::BaseNXP.xdm, category=SWCFG
          short-label=examples::EBT::S32K1::Adc_example_S32K118::TresosProject::Adc_example_S32K118::config::Dem.xdm, category=SWCFG
          short-label=examples::EBT::S32K1::Adc_example_S32K118::TresosProject::Adc_example_S32K118::config::EcuC.xdm, category=SWCFG
          short-label=examples::EBT::S32K1::Adc_example_S32K118::TresosProject::Adc_example_S32K118::config::Mcu.xdm, category=SWCFG
          short-label=examples::EBT::S32K1::Adc_example_S32K118::TresosProject::Adc_example_S32K118::config::Platform.xdm, category=SWCFG
          short-label=examples::EBT::S32K1::Adc_example_S32K118::TresosProject::Adc_example_S32K118::config::Resource.xdm, category=SWCFG
          short-label=examples::EBT::S32K1::Adc_example_S32K144::generate::epc::Adc.xdm, category=SWCFG
          short-label=examples::EBT::S32K1::Adc_example_S32K144::generate::epc::BaseNXP.xdm, category=SWCFG
          short-label=examples::EBT::S32K1::Adc_example_S32K144::generate::epc::Dem.xdm, category=SWCFG
          short-label=examples::EBT::S32K1::Adc_example_S32K144::generate::epc::EcuC.xdm, category=SWCFG
          short-label=examples::EBT::S32K1::Adc_example_S32K144::generate::epc::Mcl.xdm, category=SWCFG
          short-label=examples::EBT::S32K1::Adc_example_S32K144::generate::epc::Mcu.xdm, category=SWCFG
          short-label=examples::EBT::S32K1::Adc_example_S32K144::generate::epc::Platform.xdm, category=SWCFG
          short-label=examples::EBT::S32K1::Adc_example_S32K144::generate::epc::Resource.xdm, category=SWCFG
          short-label=examples::EBT::S32K1::Adc_example_S32K144::generate::epc::Rm.xdm, category=SWCFG
          short-label=examples::EBT::S32K1::Adc_example_S32K144::include::check_example.h, category=SWHDR
          short-label=examples::EBT::S32K1::Adc_example_S32K144::src::main.c, category=SWSRC
          short-label=examples::EBT::S32K1::Adc_example_S32K144::TresosProject::Adc_example_S32K144::.prefs::preferences.xdm, category=SWCFG
          short-label=examples::EBT::S32K1::Adc_example_S32K144::TresosProject::Adc_example_S32K144::config::Adc.xdm, category=SWCFG
          short-label=examples::EBT::S32K1::Adc_example_S32K144::TresosProject::Adc_example_S32K144::config::BaseNXP.xdm, category=SWCFG
          short-label=examples::EBT::S32K1::Adc_example_S32K144::TresosProject::Adc_example_S32K144::config::Dem.xdm, category=SWCFG
          short-label=examples::EBT::S32K1::Adc_example_S32K144::TresosProject::Adc_example_S32K144::config::EcuC.xdm, category=SWCFG
          short-label=examples::EBT::S32K1::Adc_example_S32K144::TresosProject::Adc_example_S32K144::config::Mcl.xdm, category=SWCFG
          short-label=examples::EBT::S32K1::Adc_example_S32K144::TresosProject::Adc_example_S32K144::config::Mcu.xdm, category=SWCFG
          short-label=examples::EBT::S32K1::Adc_example_S32K144::TresosProject::Adc_example_S32K144::config::Platform.xdm, category=SWCFG
          short-label=examples::EBT::S32K1::Adc_example_S32K144::TresosProject::Adc_example_S32K144::config::Resource.xdm, category=SWCFG
          short-label=examples::EBT::S32K1::Adc_example_S32K144::TresosProject::Adc_example_S32K144::config::Rm.xdm, category=SWCFG
          short-label=examples::EBT::S32K1::Adc_example_S32K144W::generate::epc::Adc.xdm, category=SWCFG
          short-label=examples::EBT::S32K1::Adc_example_S32K144W::generate::epc::BaseNXP.xdm, category=SWCFG
          short-label=examples::EBT::S32K1::Adc_example_S32K144W::generate::epc::Dem.xdm, category=SWCFG
          short-label=examples::EBT::S32K1::Adc_example_S32K144W::generate::epc::EcuC.xdm, category=SWCFG
          short-label=examples::EBT::S32K1::Adc_example_S32K144W::generate::epc::Mcl.xdm, category=SWCFG
          short-label=examples::EBT::S32K1::Adc_example_S32K144W::generate::epc::Mcu.xdm, category=SWCFG
          short-label=examples::EBT::S32K1::Adc_example_S32K144W::generate::epc::Platform.xdm, category=SWCFG
          short-label=examples::EBT::S32K1::Adc_example_S32K144W::generate::epc::Resource.xdm, category=SWCFG
          short-label=examples::EBT::S32K1::Adc_example_S32K144W::generate::epc::Rm.xdm, category=SWCFG
          short-label=examples::EBT::S32K1::Adc_example_S32K144W::include::check_example.h, category=SWHDR
          short-label=examples::EBT::S32K1::Adc_example_S32K144W::src::main.c, category=SWSRC
          short-label=examples::EBT::S32K1::Adc_example_S32K144W::TresosProject::Adc_example_S32K144W::.prefs::preferences.xdm, category=SWCFG
          short-label=examples::EBT::S32K1::Adc_example_S32K144W::TresosProject::Adc_example_S32K144W::config::Adc.xdm, category=SWCFG
          short-label=examples::EBT::S32K1::Adc_example_S32K144W::TresosProject::Adc_example_S32K144W::config::BaseNXP.xdm, category=SWCFG
          short-label=examples::EBT::S32K1::Adc_example_S32K144W::TresosProject::Adc_example_S32K144W::config::Dem.xdm, category=SWCFG
          short-label=examples::EBT::S32K1::Adc_example_S32K144W::TresosProject::Adc_example_S32K144W::config::EcuC.xdm, category=SWCFG
          short-label=examples::EBT::S32K1::Adc_example_S32K144W::TresosProject::Adc_example_S32K144W::config::Mcl.xdm, category=SWCFG
          short-label=examples::EBT::S32K1::Adc_example_S32K144W::TresosProject::Adc_example_S32K144W::config::Mcu.xdm, category=SWCFG
          short-label=examples::EBT::S32K1::Adc_example_S32K144W::TresosProject::Adc_example_S32K144W::config::Platform.xdm, category=SWCFG
          short-label=examples::EBT::S32K1::Adc_example_S32K144W::TresosProject::Adc_example_S32K144W::config::Resource.xdm, category=SWCFG
          short-label=examples::EBT::S32K1::Adc_example_S32K144W::TresosProject::Adc_example_S32K144W::config::Rm.xdm, category=SWCFG
          short-label=examples::EBT::S32K1::Adc_example_S32K148::generate::epc::Adc.xdm, category=SWCFG
          short-label=examples::EBT::S32K1::Adc_example_S32K148::generate::epc::BaseNXP.xdm, category=SWCFG
          short-label=examples::EBT::S32K1::Adc_example_S32K148::generate::epc::Dem.xdm, category=SWCFG
          short-label=examples::EBT::S32K1::Adc_example_S32K148::generate::epc::EcuC.xdm, category=SWCFG
          short-label=examples::EBT::S32K1::Adc_example_S32K148::generate::epc::Mcl.xdm, category=SWCFG
          short-label=examples::EBT::S32K1::Adc_example_S32K148::generate::epc::Mcu.xdm, category=SWCFG
          short-label=examples::EBT::S32K1::Adc_example_S32K148::generate::epc::Platform.xdm, category=SWCFG
          short-label=examples::EBT::S32K1::Adc_example_S32K148::generate::epc::Resource.xdm, category=SWCFG
          short-label=examples::EBT::S32K1::Adc_example_S32K148::generate::epc::Rm.xdm, category=SWCFG
          short-label=examples::EBT::S32K1::Adc_example_S32K148::include::check_example.h, category=SWHDR
          short-label=examples::EBT::S32K1::Adc_example_S32K148::src::main.c, category=SWSRC
          short-label=examples::EBT::S32K1::Adc_example_S32K148::TresosProject::Adc_example_S32K148::.prefs::preferences.xdm, category=SWCFG
          short-label=examples::EBT::S32K1::Adc_example_S32K148::TresosProject::Adc_example_S32K148::config::Adc.xdm, category=SWCFG
          short-label=examples::EBT::S32K1::Adc_example_S32K148::TresosProject::Adc_example_S32K148::config::BaseNXP.xdm, category=SWCFG
          short-label=examples::EBT::S32K1::Adc_example_S32K148::TresosProject::Adc_example_S32K148::config::Dem.xdm, category=SWCFG
          short-label=examples::EBT::S32K1::Adc_example_S32K148::TresosProject::Adc_example_S32K148::config::EcuC.xdm, category=SWCFG
          short-label=examples::EBT::S32K1::Adc_example_S32K148::TresosProject::Adc_example_S32K148::config::Mcl.xdm, category=SWCFG
          short-label=examples::EBT::S32K1::Adc_example_S32K148::TresosProject::Adc_example_S32K148::config::Mcu.xdm, category=SWCFG
          short-label=examples::EBT::S32K1::Adc_example_S32K148::TresosProject::Adc_example_S32K148::config::Platform.xdm, category=SWCFG
          short-label=examples::EBT::S32K1::Adc_example_S32K148::TresosProject::Adc_example_S32K148::config::Resource.xdm, category=SWCFG
          short-label=examples::EBT::S32K1::Adc_example_S32K148::TresosProject::Adc_example_S32K148::config::Rm.xdm, category=SWCFG
          short-label=examples::S32DS::S32K1::Adc_example_S32K118::include::check_example.h, category=SWHDR
          short-label=examples::S32DS::S32K1::Adc_example_S32K118::Project_Settings::Startup_Code::exceptions.c, category=SWSRC
          short-label=examples::S32DS::S32K1::Adc_example_S32K118::Project_Settings::Startup_Code::nvic.c, category=SWSRC
          short-label=examples::S32DS::S32K1::Adc_example_S32K118::Project_Settings::Startup_Code::startup.c, category=SWSRC
          short-label=examples::S32DS::S32K1::Adc_example_S32K118::Project_Settings::Startup_Code::system.c, category=SWSRC
          short-label=examples::S32DS::S32K1::Adc_example_S32K118::src::main.c, category=SWSRC
          short-label=examples::S32DS::S32K1::Adc_example_S32K144::include::check_example.h, category=SWHDR
          short-label=examples::S32DS::S32K1::Adc_example_S32K144::Project_Settings::Startup_Code::exceptions.c, category=SWSRC
          short-label=examples::S32DS::S32K1::Adc_example_S32K144::Project_Settings::Startup_Code::nvic.c, category=SWSRC
          short-label=examples::S32DS::S32K1::Adc_example_S32K144::Project_Settings::Startup_Code::startup.c, category=SWSRC
          short-label=examples::S32DS::S32K1::Adc_example_S32K144::Project_Settings::Startup_Code::system.c, category=SWSRC
          short-label=examples::S32DS::S32K1::Adc_example_S32K144::src::main.c, category=SWSRC
          short-label=examples::S32DS::S32K1::Adc_example_S32K144W::include::check_example.h, category=SWHDR
          short-label=examples::S32DS::S32K1::Adc_example_S32K144W::Project_Settings::Startup_Code::exceptions.c, category=SWSRC
          short-label=examples::S32DS::S32K1::Adc_example_S32K144W::Project_Settings::Startup_Code::nvic.c, category=SWSRC
          short-label=examples::S32DS::S32K1::Adc_example_S32K144W::Project_Settings::Startup_Code::startup.c, category=SWSRC
          short-label=examples::S32DS::S32K1::Adc_example_S32K144W::Project_Settings::Startup_Code::system.c, category=SWSRC
          short-label=examples::S32DS::S32K1::Adc_example_S32K144W::src::main.c, category=SWSRC
          short-label=examples::S32DS::S32K1::Adc_example_S32K148::include::check_example.h, category=SWHDR
          short-label=examples::S32DS::S32K1::Adc_example_S32K148::Project_Settings::Startup_Code::exceptions.c, category=SWSRC
          short-label=examples::S32DS::S32K1::Adc_example_S32K148::Project_Settings::Startup_Code::nvic.c, category=SWSRC
          short-label=examples::S32DS::S32K1::Adc_example_S32K148::Project_Settings::Startup_Code::startup.c, category=SWSRC
          short-label=examples::S32DS::S32K1::Adc_example_S32K148::Project_Settings::Startup_Code::system.c, category=SWSRC
          short-label=examples::S32DS::S32K1::Adc_example_S32K148::src::main.c, category=SWSRC
          short-label=examples::S32DS::S32K1::Adc_Pdb_Ip_example_S32K118::include::check_example.h, category=SWHDR
          short-label=examples::S32DS::S32K1::Adc_Pdb_Ip_example_S32K118::Project_Settings::Startup_Code::exceptions.c, category=SWSRC
          short-label=examples::S32DS::S32K1::Adc_Pdb_Ip_example_S32K118::Project_Settings::Startup_Code::nvic.c, category=SWSRC
          short-label=examples::S32DS::S32K1::Adc_Pdb_Ip_example_S32K118::Project_Settings::Startup_Code::startup.c, category=SWSRC
          short-label=examples::S32DS::S32K1::Adc_Pdb_Ip_example_S32K118::Project_Settings::Startup_Code::system.c, category=SWSRC
          short-label=examples::S32DS::S32K1::Adc_Pdb_Ip_example_S32K118::src::main.c, category=SWSRC
          short-label=examples::S32DS::S32K1::Adc_Pdb_Ip_example_S32K144::include::check_example.h, category=SWHDR
          short-label=examples::S32DS::S32K1::Adc_Pdb_Ip_example_S32K144::Project_Settings::Startup_Code::exceptions.c, category=SWSRC
          short-label=examples::S32DS::S32K1::Adc_Pdb_Ip_example_S32K144::Project_Settings::Startup_Code::nvic.c, category=SWSRC
          short-label=examples::S32DS::S32K1::Adc_Pdb_Ip_example_S32K144::Project_Settings::Startup_Code::startup.c, category=SWSRC
          short-label=examples::S32DS::S32K1::Adc_Pdb_Ip_example_S32K144::Project_Settings::Startup_Code::system.c, category=SWSRC
          short-label=examples::S32DS::S32K1::Adc_Pdb_Ip_example_S32K144::src::main.c, category=SWSRC
          short-label=examples::S32DS::S32K1::Adc_Pdb_Ip_example_S32K144W::include::check_example.h, category=SWHDR
          short-label=examples::S32DS::S32K1::Adc_Pdb_Ip_example_S32K144W::Project_Settings::Startup_Code::exceptions.c, category=SWSRC
          short-label=examples::S32DS::S32K1::Adc_Pdb_Ip_example_S32K144W::Project_Settings::Startup_Code::nvic.c, category=SWSRC
          short-label=examples::S32DS::S32K1::Adc_Pdb_Ip_example_S32K144W::Project_Settings::Startup_Code::startup.c, category=SWSRC
          short-label=examples::S32DS::S32K1::Adc_Pdb_Ip_example_S32K144W::Project_Settings::Startup_Code::system.c, category=SWSRC
          short-label=examples::S32DS::S32K1::Adc_Pdb_Ip_example_S32K144W::src::main.c, category=SWSRC
          short-label=examples::S32DS::S32K1::Adc_Pdb_Ip_example_S32K148::include::check_example.h, category=SWHDR
          short-label=examples::S32DS::S32K1::Adc_Pdb_Ip_example_S32K148::Project_Settings::Startup_Code::exceptions.c, category=SWSRC
          short-label=examples::S32DS::S32K1::Adc_Pdb_Ip_example_S32K148::Project_Settings::Startup_Code::nvic.c, category=SWSRC
          short-label=examples::S32DS::S32K1::Adc_Pdb_Ip_example_S32K148::Project_Settings::Startup_Code::startup.c, category=SWSRC
          short-label=examples::S32DS::S32K1::Adc_Pdb_Ip_example_S32K148::Project_Settings::Startup_Code::system.c, category=SWSRC
          short-label=examples::S32DS::S32K1::Adc_Pdb_Ip_example_S32K148::src::main.c, category=SWSRC
          short-label=include::Adc.h, category=SWHDR
          short-label=include::Adc_Ip.h, category=SWHDR
          short-label=include::Adc_Ipw.h, category=SWHDR
          short-label=include::Adc_Ipw_Irq.h, category=SWHDR
          short-label=include::Adc_Ipw_Types.h, category=SWHDR
          short-label=include::Adc_Ip_HeaderWrapper_S32K14x_Extended.h, category=SWHDR
          short-label=include::Adc_Ip_HeaderWrapper_S32K1xx.h, category=SWHDR
          short-label=include::Adc_Ip_HwAccess.h, category=SWHDR
          short-label=include::Adc_Ip_Irq.h, category=SWHDR
          short-label=include::Adc_Ip_TrustedFunctions.h, category=SWHDR
          short-label=include::Adc_Ip_Types.h, category=SWHDR
          short-label=include::Adc_Types.h, category=SWHDR
          short-label=include::Pdb_Adc_Ip.h, category=SWHDR
          short-label=include::Pdb_Adc_Ip_HwAccess.h, category=SWHDR
          short-label=include::Pdb_Adc_Ip_Irq.h, category=SWHDR
          short-label=include::Pdb_Adc_Ip_TrustedFunctions.h, category=SWHDR
          short-label=include::Pdb_Adc_Ip_Types.h, category=SWHDR
          short-label=src::Adc.c, category=SWSRC
          short-label=src::Adc_Ip.c, category=SWSRC
          short-label=src::Adc_Ipw.c, category=SWSRC
          short-label=src::Adc_Ipw_Irq.c, category=SWSRC
          short-label=src::Adc_Ip_Irq.c, category=SWSRC
          short-label=src::Pdb_Adc_Ip.c, category=SWSRC
          short-label=src::Pdb_Adc_Ip_Irq.c, category=SWSRC
    compiler GCC_Compiler:
      name=GCC Compiler
      options=-mcpu=cortex-m4 -mcpu=cortex-m0plus -mthumb -mlittle-endian -mfpu=fpv4-sp-d16 -mfloat-abi=hard -mfpu=auto -mfloat-abi=soft -std=c99 -Os -ggdb3 -Wall -Wextra -pedantic -Wstrict-prototypes -Wundef -Wunused -Werror=implicit-function-declaration -Wsign-compare -Wdouble-promotion -fno-short-enums -funsigned-char -funsigned-bitfields -fomit-frame-pointer -fno-common -fstack-usage -fdump-ipa-all -c -DUSE_SW_VECTOR_MODE -DI_CACHE_ENABLE -DENABLE_FPU -DMCAL_ENABLE_USER_MODE_SUPPORT --sysroot=$(NEWLIB_DIR) -specs=nano.specs -specs=nosys.specs
      vendor=GCC Systems
      version=NXP GCC 10.2.0 20200723 (Build 1728 Revision g5963bc8)
    compiler GHS_Compiler:
      name=Green Hills
      options=-cpu=cortexm4 -cpu=cortexm0plus -thumb -fpu=vfpv4_d16 -fsingle -fsoft -C99 --ghstd=last -Osize --gnu_asm -dual_debug -G -keeptempfiles -Wimplicit-int -Wshadow -Wtrigraphs -Wundef --unsigned_chars --unsigned_fields --no_commons --no_exceptions --no_slash_comment --prototype_errors --incorrect_pragma_warnings -c -DUSE_SW_VECTOR_MODE -DI_CACHE_ENABLE -DENABLE_FPU -DMCAL_ENABLE_USER_MODE_SUPPORT
      vendor=Green Hills
      version=Green Hills Multi 7.1.6d / Compiler 2020.1.4
    compiler IAR_Compiler:
      name=IAR Compiler
      options=--cpu=Cortex-M4 --cpu=Cortex-M0+ --cpu_mode=thumb --endian=little --fpu=FPv4-SP --fpu=none -e -Ohz --debug --no_clustering --no_mem_idioms --no_explicit_zero_opt --require_prototypes --no_wrap_diagnostics --diag_suppress=Pa050 -DIAR -DUSE_SW_VECTOR_MODE -DI_CACHE_ENABLE -DENABLE_FPU -DMCAL_ENABLE_USER_MODE_SUPPORT
      vendor=IAR Systems
      version=IAR ANSI C/C++ Compiler V8.40.3.228/W32 for ARM Functional Safety
    generated-artifacts:
      17 x dependency on artifact:
        Adc_Ipw_PBcfg_h: artifact-descriptor={short-label=generate_PB::include::Adc_Ipw_PBcfg.h, category=SWHDR}, usages=EXECUTE
        Adc_Ip_PBcfg_h: artifact-descriptor={short-label=generate_PB::include::Adc_Ip_PBcfg.h, category=SWHDR}, usages=EXECUTE
        Adc_PBcfg_h: artifact-descriptor={short-label=generate_PB::include::Adc_PBcfg.h, category=SWHDR}, usages=EXECUTE
        Pdb_Adc_Ip_PBcfg_h: artifact-descriptor={short-label=generate_PB::include::Pdb_Adc_Ip_PBcfg.h, category=SWHDR}, usages=EXECUTE
        Adc_Ipw_PBcfg_c: artifact-descriptor={short-label=generate_PB::src::Adc_Ipw_PBcfg.c, category=SWSRC}, usages=EXECUTE
        Adc_Ip_PBcfg_c: artifact-descriptor={short-label=generate_PB::src::Adc_Ip_PBcfg.c, category=SWSRC}, usages=EXECUTE
        Adc_PBcfg_c: artifact-descriptor={short-label=generate_PB::src::Adc_PBcfg.c, category=SWSRC}, usages=EXECUTE
        Pdb_Adc_Ip_PBcfg_c: artifact-descriptor={short-label=generate_PB::src::Pdb_Adc_Ip_PBcfg.c, category=SWSRC}, usages=EXECUTE
        Adc_Cfg_h: artifact-descriptor={short-label=generate_PC::include::Adc_Cfg.h, category=SWHDR}, usages=COMPILE
        Adc_CfgDefines_h: artifact-descriptor={short-label=generate_PC::include::Adc_CfgDefines.h, category=SWHDR}, usages=COMPILE
        Adc_Ipw_Cfg_h: artifact-descriptor={short-label=generate_PC::include::Adc_Ipw_Cfg.h, category=SWHDR}, usages=COMPILE
        Adc_Ipw_CfgDefines_h: artifact-descriptor={short-label=generate_PC::include::Adc_Ipw_CfgDefines.h, category=SWHDR}, usages=COMPILE
        Adc_Ip_Cfg_h: artifact-descriptor={short-label=generate_PC::include::Adc_Ip_Cfg.h, category=SWHDR}, usages=COMPILE
        Adc_Ip_CfgDefines_h: artifact-descriptor={short-label=generate_PC::include::Adc_Ip_CfgDefines.h, category=SWHDR}, usages=COMPILE
        Pdb_Adc_Ip_Cfg_h: artifact-descriptor={short-label=generate_PC::include::Pdb_Adc_Ip_Cfg.h, category=SWHDR}, usages=COMPILE
        Pdb_Adc_Ip_CfgDefines_h: artifact-descriptor={short-label=generate_PC::include::Pdb_Adc_Ip_CfgDefines.h, category=SWHDR}, usages=COMPILE
        Adc_Cfg_c: artifact-descriptor={short-label=generate_PC::src::Adc_Cfg.c, category=SWSRC}, usages=COMPILE
    linker GCC_Linker: name=GCC Compiler, options=-Wl,-Map,filename -T linkerfile --entry=Reset_Handler -nostartfiles -mcpu=cortex-m4 -mcpu=cortex-m0plus -mthumb -mfpu=fpv4-sp-d16 -mfloat-abi=hard -mfpu=auto -mfloat-abi=soft -mlittle-endian -ggdb3 -lc -lm -lgcc -n --sysroot=$(NEWLIB_DIR) -specs=nano.specs -specs=nosys.specs, vendor=GCC Systems, version=NXP GCC 10.2.0 20200723 (Build 1728 Revision g5963bc8)
    linker GHS_Linker: name=Green Hills, options=-e Reset_Handler -T linker_script_file.ld -map -keepmap -Mn -delete -ignore_debug_references -Llibrary_path -larch -lstartup -lind_sd -lind_sf -v -keep=C40_Ip_AccessCode -nostartfiles, vendor=Green Hills, version=Green Hills Multi 7.1.6d / Compiler 2020.1.4
    linker IAR_Linker: name=IAR Compiler, options=--map filename --config linkerfile --cpu=Cortex-M4 --cpu=Cortex-M0+ --fpu=FPv4-SP --fpu=none --entry _start --enable_stack_usage --skip_dynamic_initialization --no_wrap_diagnostics, vendor=IAR Systems, version=IAR ANSI C/C++ Compiler V8.40.3.228/W32 for ARM Functional Safety
    resource consumption ResourceConsumption
      11 x memory section:
        ADC_CODE: alignment=UNSPECIFIED, sw-addrmethod=CODE, symbol=CODE
        ADC_CONFIG_DATA_16: alignment=16, sw-addrmethod=CONFIG_DATA, symbol=CONFIG_DATA_16
        ADC_CONFIG_DATA_8: alignment=8, sw-addrmethod=CONFIG_DATA, symbol=CONFIG_DATA_8
        ADC_CONFIG_DATA_UNSPECIFIED: alignment=UNSPECIFIED, sw-addrmethod=CONFIG_DATA, symbol=CONFIG_DATA_UNSPECIFIED
        ADC_CONST_UNSPECIFIED: alignment=UNSPECIFIED, sw-addrmethod=CONST, symbol=CONST_UNSPECIFIED
        ADC_VAR_CLEARED_16_NO_CACHEABLE: alignment=16, sw-addrmethod=VAR_CLEARED_NO_CACHEABLE, symbol=VAR_CLEARED_16_NO_CACHEABLE
        ADC_VAR_CLEARED_8_NO_CACHEABLE: alignment=8, sw-addrmethod=VAR_CLEARED_NO_CACHEABLE, symbol=VAR_CLEARED_8_NO_CACHEABLE
        ADC_VAR_CLEARED_BOOLEAN_NO_CACHEABLE: alignment=BOOLEAN, sw-addrmethod=VAR_CLEARED_NO_CACHEABLE, symbol=VAR_CLEARED_BOOLEAN_NO_CACHEABLE
        ADC_VAR_CLEARED_UNSPECIFIED: alignment=UNSPECIFIED, sw-addrmethod=VAR_CLEARED, symbol=VAR_CLEARED_UNSPECIFIED
        ADC_VAR_CLEARED_UNSPECIFIED_NO_CACHEABLE: alignment=UNSPECIFIED, sw-addrmethod=VAR_CLEARED_NO_CACHEABLE, symbol=VAR_CLEARED_UNSPECIFIED_NO_CACHEABLE
        ADC_VAR_INIT_UNSPECIFIED_NO_CACHEABLE: alignment=UNSPECIFIED, sw-addrmethod=VAR_INIT_NO_CACHEABLE, symbol=VAR_INIT_UNSPECIFIED_NO_CACHEABLE
