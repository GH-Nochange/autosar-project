AUTOSAR XML (schema 00050)
package /AUTOSAR_Port/BswModuleDescriptions
  bsw module description Port: module-id=124
    provided-entrys:
      Port_Ci_Port_Ip_ConfigureInterleave
      Port_Ci_Port_Ip_DisableDigitalFilter
      Port_Ci_Port_Ip_EnableDigitalFilter
      Port_Ci_Port_Ip_Init
      Port_Ci_Port_Ip_SetMuxModeSel
      Port_GetVersionInfo
      Port_Init
      Port_RefreshPortDirection
      Port_ResetPinMode
      Port_Set2PinsDirection
      Port_SetAsUnusedPin
      Port_SetAsUsedPin
      Port_SetPinDirection
      Port_SetPinMode
    bsw internal behavior InternalBehavior_0
      28 x exclusive area:
        PORT_EXCLUSIVE_AREA_{00..27}
      14 x bsw called entity:
        Port_Ci_Port_Ip_ConfigureInterleave: can-enter-exclusive-area=PORT_EXCLUSIVE_AREA_05, implemented-entry=Port_Ci_Port_Ip_ConfigureInterleave
        Port_Ci_Port_Ip_DisableDigitalFilter: can-enter-exclusive-area=PORT_EXCLUSIVE_AREA_08, implemented-entry=Port_Ci_Port_Ip_DisableDigitalFilter
        Port_Ci_Port_Ip_EnableDigitalFilter: can-enter-exclusive-area=PORT_EXCLUSIVE_AREA_07, implemented-entry=Port_Ci_Port_Ip_EnableDigitalFilter
        Port_Ci_Port_Ip_Init: can-enter-exclusive-area=[PORT_EXCLUSIVE_AREA_00, PORT_EXCLUSIVE_AREA_01, PORT_EXCLUSIVE_AREA_02, PORT_EXCLUSIVE_AREA_03, PORT_EXCLUSIVE_AREA_04], implemented-entry=Port_Ci_Port_Ip_Init
        Port_Ci_Port_Ip_SetMuxModeSel: can-enter-exclusive-area=PORT_EXCLUSIVE_AREA_06, implemented-entry=Port_Ci_Port_Ip_SetMuxModeSel
        Port_GetVersionInfo: implemented-entry=Port_GetVersionInfo
        Port_Init: can-enter-exclusive-area=[PORT_EXCLUSIVE_AREA_09, PORT_EXCLUSIVE_AREA_10, PORT_EXCLUSIVE_AREA_15], implemented-entry=Port_Init
        Port_RefreshPortDirection: can-enter-exclusive-area=[PORT_EXCLUSIVE_AREA_19, PORT_EXCLUSIVE_AREA_20], implemented-entry=Port_RefreshPortDirection
        Port_ResetPinMode: can-enter-exclusive-area=[PORT_EXCLUSIVE_AREA_25, PORT_EXCLUSIVE_AREA_26], implemented-entry=Port_ResetPinMode
        Port_Set2PinsDirection: can-enter-exclusive-area=[PORT_EXCLUSIVE_AREA_11, PORT_EXCLUSIVE_AREA_12, PORT_EXCLUSIVE_AREA_13, PORT_EXCLUSIVE_AREA_14], implemented-entry=Port_Set2PinsDirection
        Port_SetAsUnusedPin: can-enter-exclusive-area=[PORT_EXCLUSIVE_AREA_21, PORT_EXCLUSIVE_AREA_22], implemented-entry=Port_SetAsUnusedPin
        Port_SetAsUsedPin: can-enter-exclusive-area=[PORT_EXCLUSIVE_AREA_23, PORT_EXCLUSIVE_AREA_24], implemented-entry=Port_SetAsUsedPin
        Port_SetPinDirection: can-enter-exclusive-area=[PORT_EXCLUSIVE_AREA_16, PORT_EXCLUSIVE_AREA_17], implemented-entry=Port_SetPinDirection
        Port_SetPinMode: can-enter-exclusive-area=[PORT_EXCLUSIVE_AREA_18, PORT_EXCLUSIVE_AREA_27], implemented-entry=Port_SetPinMode
package /AUTOSAR_Port/BswModuleEntrys
  14 x bsw module entry, all with is-synchronous=true, call-type=REGULAR, execution-context=UNSPECIFIED, sw-service-impl-policy=STANDARD:
    Port_Ci_Port_Ip_ConfigureInterleave: service-id=0x100, is-reentrant=false
    Port_Ci_Port_Ip_DisableDigitalFilter: service-id=0xf7, is-reentrant=false
    Port_Ci_Port_Ip_EnableDigitalFilter: service-id=0xf6, is-reentrant=false
    Port_Ci_Port_Ip_Init: service-id=0xf4, is-reentrant=false
    Port_Ci_Port_Ip_SetMuxModeSel: service-id=0xf5, is-reentrant=false
    Port_GetVersionInfo: service-id=0x03, is-reentrant=true
    Port_Init: service-id=0x00, is-reentrant=false
    Port_RefreshPortDirection: service-id=0x02, is-reentrant=false
    Port_ResetPinMode: service-id=0x07, is-reentrant=false
    Port_Set2PinsDirection: service-id=0x08, is-reentrant=false
    Port_SetAsUnusedPin: service-id=0x05, is-reentrant=false
    Port_SetAsUsedPin: service-id=0x06, is-reentrant=false
    Port_SetPinDirection: service-id=0x01, is-reentrant=true
    Port_SetPinMode: service-id=0x04, is-reentrant=true
package /Port_TS_T40D2M30I0R0/Implementations
  bsw implementation BswImplementation_0: programming-language=C, sw-version=3.0.0_QLP02, vendor-id=43, ar-release-version=4.7.0, behavior=InternalBehavior_0, recommended-configuration=Port, vendor-specific-module-def=Port
    code-descriptors:
      code Files
        artifact-descriptors:
          short-label=config::Port.xdm, category=SWCFG
          short-label=config::Xdm_Epd.xdm, category=SWCFG
          short-label=config_ext::PortRecConfiguration_JtagPins.xdm, category=SWCFG
          short-label=doc::RTD_PORT_IM.pdf, category=SWDOC
          short-label=doc::RTD_PORT_UM.pdf, category=SWDOC
          short-label=examples::EBT::S32K1::Port_Example_S32K118::generate::epc::BaseNXP.xdm, category=SWCFG
          short-label=examples::EBT::S32K1::Port_Example_S32K118::generate::epc::Dem.xdm, category=SWCFG
          short-label=examples::EBT::S32K1::Port_Example_S32K118::generate::epc::Dio.xdm, category=SWCFG
          short-label=examples::EBT::S32K1::Port_Example_S32K118::generate::epc::Mcu.xdm, category=SWCFG
          short-label=examples::EBT::S32K1::Port_Example_S32K118::generate::epc::Port.xdm, category=SWCFG
          short-label=examples::EBT::S32K1::Port_Example_S32K118::generate::epc::Resource.xdm, category=SWCFG
          short-label=examples::EBT::S32K1::Port_Example_S32K118::include::check_example.h, category=SWHDR
          short-label=examples::EBT::S32K1::Port_Example_S32K118::src::main.c, category=SWSRC
          short-label=examples::EBT::S32K1::Port_Example_S32K118::TresosProject::Port_Example_S32K118::.prefs::preferences.xdm, category=SWCFG
          short-label=examples::EBT::S32K1::Port_Example_S32K118::TresosProject::Port_Example_S32K118::config::BaseNXP.xdm, category=SWCFG
          short-label=examples::EBT::S32K1::Port_Example_S32K118::TresosProject::Port_Example_S32K118::config::Dem.xdm, category=SWCFG
          short-label=examples::EBT::S32K1::Port_Example_S32K118::TresosProject::Port_Example_S32K118::config::Dio.xdm, category=SWCFG
          short-label=examples::EBT::S32K1::Port_Example_S32K118::TresosProject::Port_Example_S32K118::config::EcuC.xdm, category=SWCFG
          short-label=examples::EBT::S32K1::Port_Example_S32K118::TresosProject::Port_Example_S32K118::config::Mcu.xdm, category=SWCFG
          short-label=examples::EBT::S32K1::Port_Example_S32K118::TresosProject::Port_Example_S32K118::config::Port.xdm, category=SWCFG
          short-label=examples::EBT::S32K1::Port_Example_S32K118::TresosProject::Port_Example_S32K118::config::Resource.xdm, category=SWCFG
          short-label=examples::EBT::S32K1::Port_Example_S32K144::generate::epc::BaseNXP.xdm, category=SWCFG
          short-label=examples::EBT::S32K1::Port_Example_S32K144::generate::epc::Dem.xdm, category=SWCFG
          short-label=examples::EBT::S32K1::Port_Example_S32K144::generate::epc::Dio.xdm, category=SWCFG
          short-label=examples::EBT::S32K1::Port_Example_S32K144::generate::epc::Mcu.xdm, category=SWCFG
          short-label=examples::EBT::S32K1::Port_Example_S32K144::generate::epc::Port.xdm, category=SWCFG
          short-label=examples::EBT::S32K1::Port_Example_S32K144::generate::epc::Resource.xdm, category=SWCFG
          short-label=examples::EBT::S32K1::Port_Example_S32K144::include::check_example.h, category=SWHDR
          short-label=examples::EBT::S32K1::Port_Example_S32K144::src::main.c, category=SWSRC
          short-label=examples::EBT::S32K1::Port_Example_S32K144::TresosProject::Port_Example_S32K144::.prefs::preferences.xdm, category=SWCFG
          short-label=examples::EBT::S32K1::Port_Example_S32K144::TresosProject::Port_Example_S32K144::config::BaseNXP.xdm, category=SWCFG
          short-label=examples::EBT::S32K1::Port_Example_S32K144::TresosProject::Port_Example_S32K144::config::Dem.xdm, category=SWCFG
          short-label=examples::EBT::S32K1::Port_Example_S32K144::TresosProject::Port_Example_S32K144::config::Dio.xdm, category=SWCFG
          short-label=examples::EBT::S32K1::Port_Example_S32K144::TresosProject::Port_Example_S32K144::config::EcuC.xdm, category=SWCFG
          short-label=examples::EBT::S32K1::Port_Example_S32K144::TresosProject::Port_Example_S32K144::config::Mcu.xdm, category=SWCFG
          short-label=examples::EBT::S32K1::Port_Example_S32K144::TresosProject::Port_Example_S32K144::config::Port.xdm, category=SWCFG
          short-label=examples::EBT::S32K1::Port_Example_S32K144::TresosProject::Port_Example_S32K144::config::Resource.xdm, category=SWCFG
          short-label=examples::EBT::S32K1::Port_Example_S32K144W::generate::epc::BaseNXP.xdm, category=SWCFG
          short-label=examples::EBT::S32K1::Port_Example_S32K144W::generate::epc::Dem.xdm, category=SWCFG
          short-label=examples::EBT::S32K1::Port_Example_S32K144W::generate::epc::Dio.xdm, category=SWCFG
          short-label=examples::EBT::S32K1::Port_Example_S32K144W::generate::epc::Mcu.xdm, category=SWCFG
          short-label=examples::EBT::S32K1::Port_Example_S32K144W::generate::epc::Port.xdm, category=SWCFG
          short-label=examples::EBT::S32K1::Port_Example_S32K144W::generate::epc::Resource.xdm, category=SWCFG
          short-label=examples::EBT::S32K1::Port_Example_S32K144W::include::check_example.h, category=SWHDR
          short-label=examples::EBT::S32K1::Port_Example_S32K144W::src::main.c, category=SWSRC
          short-label=examples::EBT::S32K1::Port_Example_S32K144W::TresosProject::Port_Example_S32K144W::.prefs::preferences.xdm, category=SWCFG
          short-label=examples::EBT::S32K1::Port_Example_S32K144W::TresosProject::Port_Example_S32K144W::config::BaseNXP.xdm, category=SWCFG
          short-label=examples::EBT::S32K1::Port_Example_S32K144W::TresosProject::Port_Example_S32K144W::config::Dem.xdm, category=SWCFG
          short-label=examples::EBT::S32K1::Port_Example_S32K144W::TresosProject::Port_Example_S32K144W::config::Dio.xdm, category=SWCFG
          short-label=examples::EBT::S32K1::Port_Example_S32K144W::TresosProject::Port_Example_S32K144W::config::EcuC.xdm, category=SWCFG
          short-label=examples::EBT::S32K1::Port_Example_S32K144W::TresosProject::Port_Example_S32K144W::config::Mcu.xdm, category=SWCFG
          short-label=examples::EBT::S32K1::Port_Example_S32K144W::TresosProject::Port_Example_S32K144W::config::Port.xdm, category=SWCFG
          short-label=examples::EBT::S32K1::Port_Example_S32K144W::TresosProject::Port_Example_S32K144W::config::Resource.xdm, category=SWCFG
          short-label=examples::EBT::S32K1::Port_Example_S32K148::generate::epc::BaseNXP.xdm, category=SWCFG
          short-label=examples::EBT::S32K1::Port_Example_S32K148::generate::epc::Dem.xdm, category=SWCFG
          short-label=examples::EBT::S32K1::Port_Example_S32K148::generate::epc::Dio.xdm, category=SWCFG
          short-label=examples::EBT::S32K1::Port_Example_S32K148::generate::epc::Mcu.xdm, category=SWCFG
          short-label=examples::EBT::S32K1::Port_Example_S32K148::generate::epc::Port.xdm, category=SWCFG
          short-label=examples::EBT::S32K1::Port_Example_S32K148::generate::epc::Resource.xdm, category=SWCFG
          short-label=examples::EBT::S32K1::Port_Example_S32K148::include::check_example.h, category=SWHDR
          short-label=examples::EBT::S32K1::Port_Example_S32K148::src::main.c, category=SWSRC
          short-label=examples::EBT::S32K1::Port_Example_S32K148::TresosProject::Port_Example_S32K148::.prefs::preferences.xdm, category=SWCFG
          short-label=examples::EBT::S32K1::Port_Example_S32K148::TresosProject::Port_Example_S32K148::config::BaseNXP.xdm, category=SWCFG
          short-label=examples::EBT::S32K1::Port_Example_S32K148::TresosProject::Port_Example_S32K148::config::Dem.xdm, category=SWCFG
          short-label=examples::EBT::S32K1::Port_Example_S32K148::TresosProject::Port_Example_S32K148::config::Dio.xdm, category=SWCFG
          short-label=examples::EBT::S32K1::Port_Example_S32K148::TresosProject::Port_Example_S32K148::config::EcuC.xdm, category=SWCFG
          short-label=examples::EBT::S32K1::Port_Example_S32K148::TresosProject::Port_Example_S32K148::config::Mcu.xdm, category=SWCFG
          short-label=examples::EBT::S32K1::Port_Example_S32K148::TresosProject::Port_Example_S32K148::config::Port.xdm, category=SWCFG
          short-label=examples::EBT::S32K1::Port_Example_S32K148::TresosProject::Port_Example_S32K148::config::Resource.xdm, category=SWCFG
          short-label=examples::EBT::S32M24::Port_Example_S32M244::generate::epc::BaseNXP.xdm, category=SWCFG
          short-label=examples::EBT::S32M24::Port_Example_S32M244::generate::epc::Dem.xdm, category=SWCFG
          short-label=examples::EBT::S32M24::Port_Example_S32M244::generate::epc::Dio.xdm, category=SWCFG
          short-label=examples::EBT::S32M24::Port_Example_S32M244::generate::epc::Mcu.xdm, category=SWCFG
          short-label=examples::EBT::S32M24::Port_Example_S32M244::generate::epc::Port.xdm, category=SWCFG
          short-label=examples::EBT::S32M24::Port_Example_S32M244::generate::epc::Resource.xdm, category=SWCFG
          short-label=examples::EBT::S32M24::Port_Example_S32M244::include::check_example.h, category=SWHDR
          short-label=examples::EBT::S32M24::Port_Example_S32M244::src::main.c, category=SWSRC
          short-label=examples::EBT::S32M24::Port_Example_S32M244::TresosProject::Port_Example_S32M244::.prefs::preferences.xdm, category=SWCFG
          short-label=examples::EBT::S32M24::Port_Example_S32M244::TresosProject::Port_Example_S32M244::config::BaseNXP.xdm, category=SWCFG
          short-label=examples::EBT::S32M24::Port_Example_S32M244::TresosProject::Port_Example_S32M244::config::Dem.xdm, category=SWCFG
          short-label=examples::EBT::S32M24::Port_Example_S32M244::TresosProject::Port_Example_S32M244::config::Dio.xdm, category=SWCFG
          short-label=examples::EBT::S32M24::Port_Example_S32M244::TresosProject::Port_Example_S32M244::config::EcuC.xdm, category=SWCFG
          short-label=examples::EBT::S32M24::Port_Example_S32M244::TresosProject::Port_Example_S32M244::config::Mcu.xdm, category=SWCFG
          short-label=examples::EBT::S32M24::Port_Example_S32M244::TresosProject::Port_Example_S32M244::config::Port.xdm, category=SWCFG
          short-label=examples::EBT::S32M24::Port_Example_S32M244::TresosProject::Port_Example_S32M244::config::Resource.xdm, category=SWCFG
          short-label=examples::S32DS::S32K1::Port_Ci_Port_Ip_Example_S32K118::include::check_example.h, category=SWHDR
          short-label=examples::S32DS::S32K1::Port_Ci_Port_Ip_Example_S32K118::Project_Settings::Startup_Code::exceptions.c, category=SWSRC
          short-label=examples::S32DS::S32K1::Port_Ci_Port_Ip_Example_S32K118::Project_Settings::Startup_Code::nvic.c, category=SWSRC
          short-label=examples::S32DS::S32K1::Port_Ci_Port_Ip_Example_S32K118::Project_Settings::Startup_Code::startup.c, category=SWSRC
          short-label=examples::S32DS::S32K1::Port_Ci_Port_Ip_Example_S32K118::Project_Settings::Startup_Code::system.c, category=SWSRC
          short-label=examples::S32DS::S32K1::Port_Ci_Port_Ip_Example_S32K118::src::main.c, category=SWSRC
          short-label=examples::S32DS::S32K1::Port_Ci_Port_Ip_Example_S32K144::include::check_example.h, category=SWHDR
          short-label=examples::S32DS::S32K1::Port_Ci_Port_Ip_Example_S32K144::Project_Settings::Startup_Code::exceptions.c, category=SWSRC
          short-label=examples::S32DS::S32K1::Port_Ci_Port_Ip_Example_S32K144::Project_Settings::Startup_Code::nvic.c, category=SWSRC
          short-label=examples::S32DS::S32K1::Port_Ci_Port_Ip_Example_S32K144::Project_Settings::Startup_Code::startup.c, category=SWSRC
          short-label=examples::S32DS::S32K1::Port_Ci_Port_Ip_Example_S32K144::Project_Settings::Startup_Code::system.c, category=SWSRC
          short-label=examples::S32DS::S32K1::Port_Ci_Port_Ip_Example_S32K144::src::main.c, category=SWSRC
          short-label=examples::S32DS::S32K1::Port_Ci_Port_Ip_Example_S32K144W::include::check_example.h, category=SWHDR
          short-label=examples::S32DS::S32K1::Port_Ci_Port_Ip_Example_S32K144W::Project_Settings::Startup_Code::exceptions.c, category=SWSRC
          short-label=examples::S32DS::S32K1::Port_Ci_Port_Ip_Example_S32K144W::Project_Settings::Startup_Code::nvic.c, category=SWSRC
          short-label=examples::S32DS::S32K1::Port_Ci_Port_Ip_Example_S32K144W::Project_Settings::Startup_Code::startup.c, category=SWSRC
          short-label=examples::S32DS::S32K1::Port_Ci_Port_Ip_Example_S32K144W::Project_Settings::Startup_Code::system.c, category=SWSRC
          short-label=examples::S32DS::S32K1::Port_Ci_Port_Ip_Example_S32K144W::src::main.c, category=SWSRC
          short-label=examples::S32DS::S32K1::Port_Ci_Port_Ip_Example_S32K148::include::check_example.h, category=SWHDR
          short-label=examples::S32DS::S32K1::Port_Ci_Port_Ip_Example_S32K148::Project_Settings::Startup_Code::exceptions.c, category=SWSRC
          short-label=examples::S32DS::S32K1::Port_Ci_Port_Ip_Example_S32K148::Project_Settings::Startup_Code::nvic.c, category=SWSRC
          short-label=examples::S32DS::S32K1::Port_Ci_Port_Ip_Example_S32K148::Project_Settings::Startup_Code::startup.c, category=SWSRC
          short-label=examples::S32DS::S32K1::Port_Ci_Port_Ip_Example_S32K148::Project_Settings::Startup_Code::system.c, category=SWSRC
          short-label=examples::S32DS::S32K1::Port_Ci_Port_Ip_Example_S32K148::src::main.c, category=SWSRC
          short-label=examples::S32DS::S32K1::Port_Example_S32K118::include::check_example.h, category=SWHDR
          short-label=examples::S32DS::S32K1::Port_Example_S32K118::Project_Settings::Startup_Code::exceptions.c, category=SWSRC
          short-label=examples::S32DS::S32K1::Port_Example_S32K118::Project_Settings::Startup_Code::nvic.c, category=SWSRC
          short-label=examples::S32DS::S32K1::Port_Example_S32K118::Project_Settings::Startup_Code::startup.c, category=SWSRC
          short-label=examples::S32DS::S32K1::Port_Example_S32K118::Project_Settings::Startup_Code::system.c, category=SWSRC
          short-label=examples::S32DS::S32K1::Port_Example_S32K118::src::main.c, category=SWSRC
          short-label=examples::S32DS::S32K1::Port_Example_S32K144::include::check_example.h, category=SWHDR
          short-label=examples::S32DS::S32K1::Port_Example_S32K144::Project_Settings::Startup_Code::exceptions.c, category=SWSRC
          short-label=examples::S32DS::S32K1::Port_Example_S32K144::Project_Settings::Startup_Code::nvic.c, category=SWSRC
          short-label=examples::S32DS::S32K1::Port_Example_S32K144::Project_Settings::Startup_Code::startup.c, category=SWSRC
          short-label=examples::S32DS::S32K1::Port_Example_S32K144::Project_Settings::Startup_Code::system.c, category=SWSRC
          short-label=examples::S32DS::S32K1::Port_Example_S32K144::src::main.c, category=SWSRC
          short-label=examples::S32DS::S32K1::Port_Example_S32K144W::include::check_example.h, category=SWHDR
          short-label=examples::S32DS::S32K1::Port_Example_S32K144W::Project_Settings::Startup_Code::exceptions.c, category=SWSRC
          short-label=examples::S32DS::S32K1::Port_Example_S32K144W::Project_Settings::Startup_Code::nvic.c, category=SWSRC
          short-label=examples::S32DS::S32K1::Port_Example_S32K144W::Project_Settings::Startup_Code::startup.c, category=SWSRC
          short-label=examples::S32DS::S32K1::Port_Example_S32K144W::Project_Settings::Startup_Code::system.c, category=SWSRC
          short-label=examples::S32DS::S32K1::Port_Example_S32K144W::src::main.c, category=SWSRC
          short-label=examples::S32DS::S32K1::Port_Example_S32K148::include::check_example.h, category=SWHDR
          short-label=examples::S32DS::S32K1::Port_Example_S32K148::Project_Settings::Startup_Code::exceptions.c, category=SWSRC
          short-label=examples::S32DS::S32K1::Port_Example_S32K148::Project_Settings::Startup_Code::nvic.c, category=SWSRC
          short-label=examples::S32DS::S32K1::Port_Example_S32K148::Project_Settings::Startup_Code::startup.c, category=SWSRC
          short-label=examples::S32DS::S32K1::Port_Example_S32K148::Project_Settings::Startup_Code::system.c, category=SWSRC
          short-label=examples::S32DS::S32K1::Port_Example_S32K148::src::main.c, category=SWSRC
          short-label=examples::S32DS::S32M24::Port_Ci_Port_Ip_Example_S32M244::include::check_example.h, category=SWHDR
          short-label=examples::S32DS::S32M24::Port_Ci_Port_Ip_Example_S32M244::Project_Settings::Startup_Code::exceptions.c, category=SWSRC
          short-label=examples::S32DS::S32M24::Port_Ci_Port_Ip_Example_S32M244::Project_Settings::Startup_Code::nvic.c, category=SWSRC
          short-label=examples::S32DS::S32M24::Port_Ci_Port_Ip_Example_S32M244::Project_Settings::Startup_Code::startup.c, category=SWSRC
          short-label=examples::S32DS::S32M24::Port_Ci_Port_Ip_Example_S32M244::Project_Settings::Startup_Code::system.c, category=SWSRC
          short-label=examples::S32DS::S32M24::Port_Ci_Port_Ip_Example_S32M244::src::main.c, category=SWSRC
          short-label=examples::S32DS::S32M24::Port_Example_S32M244::include::check_example.h, category=SWHDR
          short-label=examples::S32DS::S32M24::Port_Example_S32M244::Project_Settings::Startup_Code::exceptions.c, category=SWSRC
          short-label=examples::S32DS::S32M24::Port_Example_S32M244::Project_Settings::Startup_Code::nvic.c, category=SWSRC
          short-label=examples::S32DS::S32M24::Port_Example_S32M244::Project_Settings::Startup_Code::startup.c, category=SWSRC
          short-label=examples::S32DS::S32M24::Port_Example_S32M244::Project_Settings::Startup_Code::system.c, category=SWSRC
          short-label=examples::S32DS::S32M24::Port_Example_S32M244::src::main.c, category=SWSRC
          short-label=include::Port.h, category=SWHDR
          short-label=include::Port_Ci_Port_Ip.h, category=SWHDR
          short-label=include::Port_Ci_Port_Ip_TrustedFunctions.h, category=SWHDR
          short-label=include::Port_Ci_Port_Ip_Types.h, category=SWHDR
          short-label=include::Port_Ipw.h, category=SWHDR
          short-label=src::Port.c, category=SWSRC
          short-label=src::Port_Ci_Port_Ip.c, category=SWSRC
          short-label=src::Port_Ipw.c, category=SWSRC
    compiler GCC_Compiler:
      name=GCC Compiler
      options=-mcpu=cortex-m4 -mcpu=cortex-m0plus -mthumb -mlittle-endian -mfpu=fpv4-sp-d16 -mfloat-abi=hard -mfpu=auto -mfloat-abi=soft -std=c99 -Os -ggdb3 -Wall -Wextra -pedantic -Wstrict-prototypes -Wundef -Wunused -Werror=implicit-function-declaration -Wsign-compare -Wdouble-promotion -fno-short-enums -funsigned-char -funsigned-bitfields -fomit-frame-pointer -fno-common -fstack-usage -fdump-ipa-all -c -DUSE_SW_VECTOR_MODE -DI_CACHE_ENABLE -DENABLE_FPU -DMCAL_ENABLE_USER_MODE_SUPPORT --sysroot=$(NEWLIB_DIR) -specs=nano.specs -specs=nosys.specs
      vendor=GCC Systems
      version=NXP GCC 10.2.0 20200723 (Build 1728 Revision g5963bc8)
    compiler GHS_Compiler:
      name=Green Hills
      options=-cpu=cortexm4 -cpu=cortexm0plus -thumb -fpu=vfpv4_d16 -fsingle -fsoft -C99 --ghstd=last -Osize --gnu_asm -dual_debug -G -keeptempfiles -Wimplicit-int -Wshadow -Wtrigraphs -Wundef --unsigned_chars --unsigned_fields --no_commons --no_exceptions --no_slash_comment --prototype_errors --incorrect_pragma_warnings -c -DUSE_SW_VECTOR_MODE -DI_CACHE_ENABLE -DENABLE_FPU -DMCAL_ENABLE_USER_MODE_SUPPORT
      vendor=Green Hills
      version=Green Hills Multi 7.1.6d / Compiler 2020.1.4
    compiler IAR_Compiler:
      name=IAR Compiler
      options=--cpu=Cortex-M4 --cpu=Cortex-M0+ --cpu_mode=thumb --endian=little --fpu=FPv4-SP --fpu=none -e -Ohz --debug --no_clustering --no_mem_idioms --no_explicit_zero_opt --require_prototypes --no_wrap_diagnostics --diag_suppress=Pa050 -DIAR -DUSE_SW_VECTOR_MODE -DI_CACHE_ENABLE -DENABLE_FPU -DMCAL_ENABLE_USER_MODE_SUPPORT
      vendor=IAR Systems
      version=IAR ANSI C/C++ Compiler V8.40.3.228/W32 for ARM Functional Safety
    generated-artifacts:
      8 x dependency on artifact:
        Port_Ci_Port_Ip_PBcfg_h: artifact-descriptor={short-label=generate_PB::include::Port_Ci_Port_Ip_PBcfg.h, category=SWHDR}, usages=EXECUTE
        Port_PBcfg_h: artifact-descriptor={short-label=generate_PB::include::Port_PBcfg.h, category=SWHDR}, usages=EXECUTE
        Port_Ci_Port_Ip_PBcfg_c: artifact-descriptor={short-label=generate_PB::src::Port_Ci_Port_Ip_PBcfg.c, category=SWSRC}, usages=EXECUTE
        Port_PBcfg_c: artifact-descriptor={short-label=generate_PB::src::Port_PBcfg.c, category=SWSRC}, usages=EXECUTE
        Port_Cfg_h: artifact-descriptor={short-label=generate_PC::include::Port_Cfg.h, category=SWHDR}, usages=COMPILE
        Port_Ci_Port_Ip_Cfg_h: artifact-descriptor={short-label=generate_PC::include::Port_Ci_Port_Ip_Cfg.h, category=SWHDR}, usages=COMPILE
        Port_Ci_Port_Ip_Defines_h: artifact-descriptor={short-label=generate_PC::include::Port_Ci_Port_Ip_Defines.h, category=SWHDR}, usages=COMPILE
        Port_Cfg_c: artifact-descriptor={short-label=generate_PC::src::Port_Cfg.c, category=SWSRC}, usages=COMPILE
    linker GCC_Linker: name=GCC Compiler, options=-Wl,-Map,filename -T linkerfile --entry=Reset_Handler -nostartfiles -mcpu=cortex-m4 -mcpu=cortex-m0plus -mthumb -mfpu=fpv4-sp-d16 -mfloat-abi=hard -mfpu=auto -mfloat-abi=soft -mlittle-endian -ggdb3 -lc -lm -lgcc -n --sysroot=$(NEWLIB_DIR) -specs=nano.specs -specs=nosys.specs, vendor=GCC Systems, version=NXP GCC 10.2.0 20200723 (Build 1728 Revision g5963bc8)
    linker GHS_Linker: name=Green Hills, options=-e Reset_Handler -T linker_script_file.ld -map -keepmap -Mn -delete -ignore_debug_references -Llibrary_path -larch -lstartup -lind_sd -lind_sf -v -keep=C40_Ip_AccessCode -nostartfiles, vendor=Green Hills, version=Green Hills Multi 7.1.6d / Compiler 2020.1.4
    linker IAR_Linker: name=IAR Compiler, options=--map filename --config linkerfile --cpu=Cortex-M4 --cpu=Cortex-M0+ --fpu=FPv4-SP --fpu=none --entry _start --enable_stack_usage --skip_dynamic_initialization --no_wrap_diagnostics, vendor=IAR Systems, version=IAR ANSI C/C++ Compiler V8.40.3.228/W32 for ARM Functional Safety
    resource consumption ResourceConsumption
      9 x memory section:
        PORT_CODE: alignment=UNSPECIFIED, sw-addrmethod=CODE, symbol=CODE
        PORT_CONFIG_DATA_16: alignment=16, sw-addrmethod=CONFIG_DATA, symbol=CONFIG_DATA_16
        PORT_CONFIG_DATA_32: alignment=32, sw-addrmethod=CONFIG_DATA, symbol=CONFIG_DATA_32
        PORT_CONFIG_DATA_8: alignment=8, sw-addrmethod=CONFIG_DATA, symbol=CONFIG_DATA_8
        PORT_CONFIG_DATA_UNSPECIFIED: alignment=UNSPECIFIED, sw-addrmethod=CONFIG_DATA, symbol=CONFIG_DATA_UNSPECIFIED
        PORT_CONST_16: alignment=16, sw-addrmethod=CONST, symbol=CONST_16
        PORT_CONST_32: alignment=32, sw-addrmethod=CONST, symbol=CONST_32
        PORT_VAR_CLEARED_16: alignment=16, sw-addrmethod=VAR_CLEARED, symbol=VAR_CLEARED_16
        PORT_VAR_CLEARED_UNSPECIFIED_NO_CACHEABLE: alignment=UNSPECIFIED, sw-addrmethod=VAR_CLEARED_NO_CACHEABLE, symbol=VAR_CLEARED_UNSPECIFIED_NO_CACHEABLE
