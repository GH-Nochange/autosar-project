AUTOSAR XML (schema 00050)
package /AUTOSAR_Qdec/BswModuleDescriptions
  bsw module description Qdec: module-id=255
    provided-entrys:
      Ftm_Qdec_Ip_CounterState
      Ftm_Qdec_Ip_DisableOverFlowNotification
      Ftm_Qdec_Ip_EnableOverFlowNotification
      Ftm_Qdec_Ip_GetState
      Ftm_Qdec_Ip_ResetState
      Ftm_Qdec_Ip_SetClockMode
      Ftm_Qdec_Ip_SetMode
      Qdec_CounterState
      Qdec_DeInit
      Qdec_DisableOverFlowNotification
      Qdec_EnableOverFlowNotification
      Qdec_GetState
      Qdec_Init
      Qdec_ResetState
      Qdec_SetClockMode
      Qdec_SetMode
      FTM_1_ISR
      FTM_2_ISR
    bsw internal behavior InternalBehavior_0
      7 x exclusive area:
        QDEC_EXCLUSIVE_AREA_{01..07}
      16 x bsw called entity:
        Ftm_Qdec_Ip_CounterState: can-enter-exclusive-area=QDEC_EXCLUSIVE_AREA_03, implemented-entry=Ftm_Qdec_Ip_CounterState
        Ftm_Qdec_Ip_DisableOverFlowNotification: can-enter-exclusive-area=QDEC_EXCLUSIVE_AREA_05, implemented-entry=Ftm_Qdec_Ip_DisableOverFlowNotification
        Ftm_Qdec_Ip_EnableOverFlowNotification: can-enter-exclusive-area=QDEC_EXCLUSIVE_AREA_06, implemented-entry=Ftm_Qdec_Ip_EnableOverFlowNotification
        Ftm_Qdec_Ip_GetState: can-enter-exclusive-area=QDEC_EXCLUSIVE_AREA_01, implemented-entry=Ftm_Qdec_Ip_GetState
        Ftm_Qdec_Ip_ResetState: can-enter-exclusive-area=QDEC_EXCLUSIVE_AREA_04, implemented-entry=Ftm_Qdec_Ip_ResetState
        Ftm_Qdec_Ip_SetClockMode: can-enter-exclusive-area=QDEC_EXCLUSIVE_AREA_02, implemented-entry=Ftm_Qdec_Ip_SetClockMode
        Ftm_Qdec_Ip_SetMode: can-enter-exclusive-area=QDEC_EXCLUSIVE_AREA_07, implemented-entry=Ftm_Qdec_Ip_SetMode
        Qdec_CounterState: can-enter-exclusive-area=QDEC_EXCLUSIVE_AREA_03, implemented-entry=Qdec_CounterState
        Qdec_DeInit: implemented-entry=Qdec_DeInit
        Qdec_DisableOverFlowNotification: can-enter-exclusive-area=QDEC_EXCLUSIVE_AREA_05, implemented-entry=Qdec_DisableOverFlowNotification
        Qdec_EnableOverFlowNotification: can-enter-exclusive-area=QDEC_EXCLUSIVE_AREA_06, implemented-entry=Qdec_EnableOverFlowNotification
        Qdec_GetState: can-enter-exclusive-area=QDEC_EXCLUSIVE_AREA_01, implemented-entry=Qdec_GetState
        Qdec_Init: implemented-entry=Qdec_Init
        Qdec_ResetState: can-enter-exclusive-area=QDEC_EXCLUSIVE_AREA_04, implemented-entry=Qdec_ResetState
        Qdec_SetClockMode: can-enter-exclusive-area=QDEC_EXCLUSIVE_AREA_02, implemented-entry=Qdec_SetClockMode
        Qdec_SetMode: can-enter-exclusive-area=QDEC_EXCLUSIVE_AREA_07, implemented-entry=Qdec_SetMode
      bsw interrupt entity FTM_1_ISR: implemented-entry=FTM_1_ISR, interrupt-category=CAT-2, interrupt-source=Hardware
      bsw interrupt entity FTM_2_ISR: implemented-entry=FTM_2_ISR, interrupt-category=CAT-2, interrupt-source=Hardware
package /AUTOSAR_Qdec/BswModuleEntrys
  18 x bsw module entry, all with is-synchronous=true, sw-service-impl-policy=STANDARD:
    Ftm_Qdec_Ip_CounterState: service-id=0x0c, is-reentrant=true, call-type=REGULAR, execution-context=UNSPECIFIED
    Ftm_Qdec_Ip_DisableOverFlowNotification: service-id=0x0e, is-reentrant=true, call-type=REGULAR, execution-context=UNSPECIFIED
    Ftm_Qdec_Ip_EnableOverFlowNotification: service-id=0x0f, is-reentrant=true, call-type=REGULAR, execution-context=UNSPECIFIED
    Ftm_Qdec_Ip_GetState: service-id=0x0a, is-reentrant=true, call-type=REGULAR, execution-context=UNSPECIFIED
    Ftm_Qdec_Ip_ResetState: service-id=0x0d, is-reentrant=true, call-type=REGULAR, execution-context=UNSPECIFIED
    Ftm_Qdec_Ip_SetClockMode: service-id=0x0b, is-reentrant=true, call-type=REGULAR, execution-context=UNSPECIFIED
    Ftm_Qdec_Ip_SetMode: service-id=0x10, is-reentrant=true, call-type=REGULAR, execution-context=UNSPECIFIED
    Qdec_CounterState: service-id=0x05, is-reentrant=true, call-type=REGULAR, execution-context=UNSPECIFIED
    Qdec_DeInit: service-id=0x02, is-reentrant=false, call-type=REGULAR, execution-context=UNSPECIFIED
    Qdec_DisableOverFlowNotification: service-id=0x07, is-reentrant=true, call-type=REGULAR, execution-context=UNSPECIFIED
    Qdec_EnableOverFlowNotification: service-id=0x08, is-reentrant=true, call-type=REGULAR, execution-context=UNSPECIFIED
    Qdec_GetState: service-id=0x03, is-reentrant=true, call-type=REGULAR, execution-context=UNSPECIFIED
    Qdec_Init: service-id=0x01, is-reentrant=false, call-type=REGULAR, execution-context=UNSPECIFIED
    Qdec_ResetState: service-id=0x06, is-reentrant=true, call-type=REGULAR, execution-context=UNSPECIFIED
    Qdec_SetClockMode: service-id=0x04, is-reentrant=false, call-type=REGULAR, execution-context=UNSPECIFIED
    Qdec_SetMode: service-id=0x09, is-reentrant=true, call-type=REGULAR, execution-context=UNSPECIFIED
    FTM_1_ISR: service-id=0, is-reentrant=false, call-type=INTERRUPT, execution-context=INTERRUPT-CAT-2
    FTM_2_ISR: service-id=0, is-reentrant=false, call-type=INTERRUPT, execution-context=INTERRUPT-CAT-2
package /Qdec_TS_T40D2M30I0R0/Implementations
  bsw implementation BswImplementation_0: programming-language=C, sw-version=3.0.0_QLP02, vendor-id=43, ar-release-version=4.7.0, behavior=InternalBehavior_0, vendor-specific-module-def=Qdec
    code-descriptors:
      code Files
        artifact-descriptors:
          short-label=config::Qdec.xdm, category=SWCFG
          short-label=doc::RTD_QDEC_IM.pdf, category=SWDOC
          short-label=doc::RTD_QDEC_UM.pdf, category=SWDOC
          short-label=EBT::Qdec.xdm, category=SWCFG
          short-label=examples::EBT::S32K1::Qdec_Example_S32K118::generate::epc::BaseNXP.xdm, category=SWCFG
          short-label=examples::EBT::S32K1::Qdec_Example_S32K118::generate::epc::EcuC.xdm, category=SWCFG
          short-label=examples::EBT::S32K1::Qdec_Example_S32K118::generate::epc::Mcu.xdm, category=SWCFG
          short-label=examples::EBT::S32K1::Qdec_Example_S32K118::generate::epc::Platform.xdm, category=SWCFG
          short-label=examples::EBT::S32K1::Qdec_Example_S32K118::generate::epc::Port.xdm, category=SWCFG
          short-label=examples::EBT::S32K1::Qdec_Example_S32K118::generate::epc::Qdec.xdm, category=SWCFG
          short-label=examples::EBT::S32K1::Qdec_Example_S32K118::generate::epc::Resource.xdm, category=SWCFG
          short-label=examples::EBT::S32K1::Qdec_Example_S32K118::include::check_example.h, category=SWHDR
          short-label=examples::EBT::S32K1::Qdec_Example_S32K118::src::main.c, category=SWSRC
          short-label=examples::EBT::S32K1::Qdec_Example_S32K118::TresosProject::Qdec_Example_S32K118::.prefs::preferences.xdm, category=SWCFG
          short-label=examples::EBT::S32K1::Qdec_Example_S32K118::TresosProject::Qdec_Example_S32K118::config::BaseNXP.xdm, category=SWCFG
          short-label=examples::EBT::S32K1::Qdec_Example_S32K118::TresosProject::Qdec_Example_S32K118::config::EcuC.xdm, category=SWCFG
          short-label=examples::EBT::S32K1::Qdec_Example_S32K118::TresosProject::Qdec_Example_S32K118::config::Mcu.xdm, category=SWCFG
          short-label=examples::EBT::S32K1::Qdec_Example_S32K118::TresosProject::Qdec_Example_S32K118::config::Platform.xdm, category=SWCFG
          short-label=examples::EBT::S32K1::Qdec_Example_S32K118::TresosProject::Qdec_Example_S32K118::config::Port.xdm, category=SWCFG
          short-label=examples::EBT::S32K1::Qdec_Example_S32K118::TresosProject::Qdec_Example_S32K118::config::Qdec.xdm, category=SWCFG
          short-label=examples::EBT::S32K1::Qdec_Example_S32K118::TresosProject::Qdec_Example_S32K118::config::Resource.xdm, category=SWCFG
          short-label=examples::EBT::S32K1::Qdec_Example_S32K144::generate::epc::BaseNXP.xdm, category=SWCFG
          short-label=examples::EBT::S32K1::Qdec_Example_S32K144::generate::epc::EcuC.xdm, category=SWCFG
          short-label=examples::EBT::S32K1::Qdec_Example_S32K144::generate::epc::Mcu.xdm, category=SWCFG
          short-label=examples::EBT::S32K1::Qdec_Example_S32K144::generate::epc::Platform.xdm, category=SWCFG
          short-label=examples::EBT::S32K1::Qdec_Example_S32K144::generate::epc::Port.xdm, category=SWCFG
          short-label=examples::EBT::S32K1::Qdec_Example_S32K144::generate::epc::Qdec.xdm, category=SWCFG
          short-label=examples::EBT::S32K1::Qdec_Example_S32K144::generate::epc::Resource.xdm, category=SWCFG
          short-label=examples::EBT::S32K1::Qdec_Example_S32K144::include::check_example.h, category=SWHDR
          short-label=examples::EBT::S32K1::Qdec_Example_S32K144::src::main.c, category=SWSRC
          short-label=examples::EBT::S32K1::Qdec_Example_S32K144::TresosProject::Qdec_Example_S32K144::.prefs::preferences.xdm, category=SWCFG
          short-label=examples::EBT::S32K1::Qdec_Example_S32K144::TresosProject::Qdec_Example_S32K144::config::BaseNXP.xdm, category=SWCFG
          short-label=examples::EBT::S32K1::Qdec_Example_S32K144::TresosProject::Qdec_Example_S32K144::config::EcuC.xdm, category=SWCFG
          short-label=examples::EBT::S32K1::Qdec_Example_S32K144::TresosProject::Qdec_Example_S32K144::config::Mcu.xdm, category=SWCFG
          short-label=examples::EBT::S32K1::Qdec_Example_S32K144::TresosProject::Qdec_Example_S32K144::config::Platform.xdm, category=SWCFG
          short-label=examples::EBT::S32K1::Qdec_Example_S32K144::TresosProject::Qdec_Example_S32K144::config::Port.xdm, category=SWCFG
          short-label=examples::EBT::S32K1::Qdec_Example_S32K144::TresosProject::Qdec_Example_S32K144::config::Qdec.xdm, category=SWCFG
          short-label=examples::EBT::S32K1::Qdec_Example_S32K144::TresosProject::Qdec_Example_S32K144::config::Resource.xdm, category=SWCFG
          short-label=examples::EBT::S32K1::Qdec_Example_S32K144W::generate::epc::BaseNXP.xdm, category=SWCFG
          short-label=examples::EBT::S32K1::Qdec_Example_S32K144W::generate::epc::EcuC.xdm, category=SWCFG
          short-label=examples::EBT::S32K1::Qdec_Example_S32K144W::generate::epc::Mcu.xdm, category=SWCFG
          short-label=examples::EBT::S32K1::Qdec_Example_S32K144W::generate::epc::Platform.xdm, category=SWCFG
          short-label=examples::EBT::S32K1::Qdec_Example_S32K144W::generate::epc::Port.xdm, category=SWCFG
          short-label=examples::EBT::S32K1::Qdec_Example_S32K144W::generate::epc::Qdec.xdm, category=SWCFG
          short-label=examples::EBT::S32K1::Qdec_Example_S32K144W::generate::epc::Resource.xdm, category=SWCFG
          short-label=examples::EBT::S32K1::Qdec_Example_S32K144W::include::check_example.h, category=SWHDR
          short-label=examples::EBT::S32K1::Qdec_Example_S32K144W::src::main.c, category=SWSRC
          short-label=examples::EBT::S32K1::Qdec_Example_S32K144W::TresosProject::Qdec_Example_S32K144W::.prefs::preferences.xdm, category=SWCFG
          short-label=examples::EBT::S32K1::Qdec_Example_S32K144W::TresosProject::Qdec_Example_S32K144W::config::BaseNXP.xdm, category=SWCFG
          short-label=examples::EBT::S32K1::Qdec_Example_S32K144W::TresosProject::Qdec_Example_S32K144W::config::EcuC.xdm, category=SWCFG
          short-label=examples::EBT::S32K1::Qdec_Example_S32K144W::TresosProject::Qdec_Example_S32K144W::config::Mcu.xdm, category=SWCFG
          short-label=examples::EBT::S32K1::Qdec_Example_S32K144W::TresosProject::Qdec_Example_S32K144W::config::Platform.xdm, category=SWCFG
          short-label=examples::EBT::S32K1::Qdec_Example_S32K144W::TresosProject::Qdec_Example_S32K144W::config::Port.xdm, category=SWCFG
          short-label=examples::EBT::S32K1::Qdec_Example_S32K144W::TresosProject::Qdec_Example_S32K144W::config::Qdec.xdm, category=SWCFG
          short-label=examples::EBT::S32K1::Qdec_Example_S32K144W::TresosProject::Qdec_Example_S32K144W::config::Resource.xdm, category=SWCFG
          short-label=examples::EBT::S32K1::Qdec_Example_S32K148::generate::epc::BaseNXP.xdm, category=SWCFG
          short-label=examples::EBT::S32K1::Qdec_Example_S32K148::generate::epc::EcuC.xdm, category=SWCFG
          short-label=examples::EBT::S32K1::Qdec_Example_S32K148::generate::epc::Mcu.xdm, category=SWCFG
          short-label=examples::EBT::S32K1::Qdec_Example_S32K148::generate::epc::Platform.xdm, category=SWCFG
          short-label=examples::EBT::S32K1::Qdec_Example_S32K148::generate::epc::Port.xdm, category=SWCFG
          short-label=examples::EBT::S32K1::Qdec_Example_S32K148::generate::epc::Qdec.xdm, category=SWCFG
          short-label=examples::EBT::S32K1::Qdec_Example_S32K148::generate::epc::Resource.xdm, category=SWCFG
          short-label=examples::EBT::S32K1::Qdec_Example_S32K148::include::check_example.h, category=SWHDR
          short-label=examples::EBT::S32K1::Qdec_Example_S32K148::src::main.c, category=SWSRC
          short-label=examples::EBT::S32K1::Qdec_Example_S32K148::TresosProject::Qdec_Example_S32K148::.prefs::preferences.xdm, category=SWCFG
          short-label=examples::EBT::S32K1::Qdec_Example_S32K148::TresosProject::Qdec_Example_S32K148::config::BaseNXP.xdm, category=SWCFG
          short-label=examples::EBT::S32K1::Qdec_Example_S32K148::TresosProject::Qdec_Example_S32K148::config::EcuC.xdm, category=SWCFG
          short-label=examples::EBT::S32K1::Qdec_Example_S32K148::TresosProject::Qdec_Example_S32K148::config::Mcu.xdm, category=SWCFG
          short-label=examples::EBT::S32K1::Qdec_Example_S32K148::TresosProject::Qdec_Example_S32K148::config::Platform.xdm, category=SWCFG
          short-label=examples::EBT::S32K1::Qdec_Example_S32K148::TresosProject::Qdec_Example_S32K148::config::Port.xdm, category=SWCFG
          short-label=examples::EBT::S32K1::Qdec_Example_S32K148::TresosProject::Qdec_Example_S32K148::config::Qdec.xdm, category=SWCFG
          short-label=examples::EBT::S32K1::Qdec_Example_S32K148::TresosProject::Qdec_Example_S32K148::config::Resource.xdm, category=SWCFG
          short-label=examples::S32DS::S32K1::Ftm_Qdec_Ip_Example_S32K118::include::check_example.h, category=SWHDR
          short-label=examples::S32DS::S32K1::Ftm_Qdec_Ip_Example_S32K118::Project_Settings::Startup_Code::exceptions.c, category=SWSRC
          short-label=examples::S32DS::S32K1::Ftm_Qdec_Ip_Example_S32K118::Project_Settings::Startup_Code::nvic.c, category=SWSRC
          short-label=examples::S32DS::S32K1::Ftm_Qdec_Ip_Example_S32K118::Project_Settings::Startup_Code::startup.c, category=SWSRC
          short-label=examples::S32DS::S32K1::Ftm_Qdec_Ip_Example_S32K118::Project_Settings::Startup_Code::system.c, category=SWSRC
          short-label=examples::S32DS::S32K1::Ftm_Qdec_Ip_Example_S32K118::src::main.c, category=SWSRC
          short-label=examples::S32DS::S32K1::Ftm_Qdec_Ip_Example_S32K144::include::check_example.h, category=SWHDR
          short-label=examples::S32DS::S32K1::Ftm_Qdec_Ip_Example_S32K144::Project_Settings::Startup_Code::exceptions.c, category=SWSRC
          short-label=examples::S32DS::S32K1::Ftm_Qdec_Ip_Example_S32K144::Project_Settings::Startup_Code::nvic.c, category=SWSRC
          short-label=examples::S32DS::S32K1::Ftm_Qdec_Ip_Example_S32K144::Project_Settings::Startup_Code::startup.c, category=SWSRC
          short-label=examples::S32DS::S32K1::Ftm_Qdec_Ip_Example_S32K144::Project_Settings::Startup_Code::system.c, category=SWSRC
          short-label=examples::S32DS::S32K1::Ftm_Qdec_Ip_Example_S32K144::src::main.c, category=SWSRC
          short-label=examples::S32DS::S32K1::Ftm_Qdec_Ip_Example_S32K144W::include::check_example.h, category=SWHDR
          short-label=examples::S32DS::S32K1::Ftm_Qdec_Ip_Example_S32K144W::Project_Settings::Startup_Code::exceptions.c, category=SWSRC
          short-label=examples::S32DS::S32K1::Ftm_Qdec_Ip_Example_S32K144W::Project_Settings::Startup_Code::nvic.c, category=SWSRC
          short-label=examples::S32DS::S32K1::Ftm_Qdec_Ip_Example_S32K144W::Project_Settings::Startup_Code::startup.c, category=SWSRC
          short-label=examples::S32DS::S32K1::Ftm_Qdec_Ip_Example_S32K144W::Project_Settings::Startup_Code::system.c, category=SWSRC
          short-label=examples::S32DS::S32K1::Ftm_Qdec_Ip_Example_S32K144W::src::main.c, category=SWSRC
          short-label=examples::S32DS::S32K1::Ftm_Qdec_Ip_Example_S32K148::include::check_example.h, category=SWHDR
          short-label=examples::S32DS::S32K1::Ftm_Qdec_Ip_Example_S32K148::Project_Settings::Startup_Code::exceptions.c, category=SWSRC
          short-label=examples::S32DS::S32K1::Ftm_Qdec_Ip_Example_S32K148::Project_Settings::Startup_Code::nvic.c, category=SWSRC
          short-label=examples::S32DS::S32K1::Ftm_Qdec_Ip_Example_S32K148::Project_Settings::Startup_Code::startup.c, category=SWSRC
          short-label=examples::S32DS::S32K1::Ftm_Qdec_Ip_Example_S32K148::Project_Settings::Startup_Code::system.c, category=SWSRC
          short-label=examples::S32DS::S32K1::Ftm_Qdec_Ip_Example_S32K148::src::main.c, category=SWSRC
          short-label=examples::S32DS::S32K1::Qdec_Example_S32K118::include::check_example.h, category=SWHDR
          short-label=examples::S32DS::S32K1::Qdec_Example_S32K118::Project_Settings::Startup_Code::exceptions.c, category=SWSRC
          short-label=examples::S32DS::S32K1::Qdec_Example_S32K118::Project_Settings::Startup_Code::nvic.c, category=SWSRC
          short-label=examples::S32DS::S32K1::Qdec_Example_S32K118::Project_Settings::Startup_Code::startup.c, category=SWSRC
          short-label=examples::S32DS::S32K1::Qdec_Example_S32K118::Project_Settings::Startup_Code::system.c, category=SWSRC
          short-label=examples::S32DS::S32K1::Qdec_Example_S32K118::src::main.c, category=SWSRC
          short-label=examples::S32DS::S32K1::Qdec_Example_S32K144::include::check_example.h, category=SWHDR
          short-label=examples::S32DS::S32K1::Qdec_Example_S32K144::Project_Settings::Startup_Code::exceptions.c, category=SWSRC
          short-label=examples::S32DS::S32K1::Qdec_Example_S32K144::Project_Settings::Startup_Code::nvic.c, category=SWSRC
          short-label=examples::S32DS::S32K1::Qdec_Example_S32K144::Project_Settings::Startup_Code::startup.c, category=SWSRC
          short-label=examples::S32DS::S32K1::Qdec_Example_S32K144::Project_Settings::Startup_Code::system.c, category=SWSRC
          short-label=examples::S32DS::S32K1::Qdec_Example_S32K144::src::main.c, category=SWSRC
          short-label=examples::S32DS::S32K1::Qdec_Example_S32K144W::include::check_example.h, category=SWHDR
          short-label=examples::S32DS::S32K1::Qdec_Example_S32K144W::Project_Settings::Startup_Code::exceptions.c, category=SWSRC
          short-label=examples::S32DS::S32K1::Qdec_Example_S32K144W::Project_Settings::Startup_Code::nvic.c, category=SWSRC
          short-label=examples::S32DS::S32K1::Qdec_Example_S32K144W::Project_Settings::Startup_Code::startup.c, category=SWSRC
          short-label=examples::S32DS::S32K1::Qdec_Example_S32K144W::Project_Settings::Startup_Code::system.c, category=SWSRC
          short-label=examples::S32DS::S32K1::Qdec_Example_S32K144W::src::main.c, category=SWSRC
          short-label=examples::S32DS::S32K1::Qdec_Example_S32K148::include::check_example.h, category=SWHDR
          short-label=examples::S32DS::S32K1::Qdec_Example_S32K148::Project_Settings::Startup_Code::exceptions.c, category=SWSRC
          short-label=examples::S32DS::S32K1::Qdec_Example_S32K148::Project_Settings::Startup_Code::nvic.c, category=SWSRC
          short-label=examples::S32DS::S32K1::Qdec_Example_S32K148::Project_Settings::Startup_Code::startup.c, category=SWSRC
          short-label=examples::S32DS::S32K1::Qdec_Example_S32K148::Project_Settings::Startup_Code::system.c, category=SWSRC
          short-label=examples::S32DS::S32K1::Qdec_Example_S32K148::src::main.c, category=SWSRC
          short-label=include::CDD_Qdec.h, category=SWHDR
          short-label=include::CDD_Qdec_Ipw.h, category=SWHDR
          short-label=include::CDD_Qdec_Ipw_Irq.h, category=SWHDR
          short-label=include::Ftm_Qdec_Ip.h, category=SWHDR
          short-label=include::Ftm_Qdec_Ip_Irq.h, category=SWHDR
          short-label=include::Ftm_Qdec_Ip_TrustedFunctions.h, category=SWHDR
          short-label=include::Ftm_Qdec_Ip_Types.h, category=SWHDR
          short-label=include::Qdec_EnvCfg.h, category=SWHDR
          short-label=include::Qdec_Ipw_Types.h, category=SWHDR
          short-label=include::Qdec_Types.h, category=SWHDR
          short-label=src::CDD_Qdec.c, category=SWSRC
          short-label=src::CDD_Qdec_Ipw.c, category=SWSRC
          short-label=src::Ftm_Qdec_Ip.c, category=SWSRC
          short-label=src::Ftm_Qdec_Ip_Irq.c, category=SWSRC
    compiler GCC_Compiler:
      name=GCC Compiler
      options=-mcpu=cortex-m4 -mcpu=cortex-m0plus -mthumb -mlittle-endian -mfpu=fpv4-sp-d16 -mfloat-abi=hard -mfpu=auto -mfloat-abi=soft -std=c99 -Os -ggdb3 -Wall -Wextra -pedantic -Wstrict-prototypes -Wundef -Wunused -Werror=implicit-function-declaration -Wsign-compare -Wdouble-promotion -fno-short-enums -funsigned-char -funsigned-bitfields -fomit-frame-pointer -fno-common -fstack-usage -fdump-ipa-all -c -DUSE_SW_VECTOR_MODE -DI_CACHE_ENABLE -DENABLE_FPU -DMCAL_ENABLE_USER_MODE_SUPPORT --sysroot=$(NEWLIB_DIR) -specs=nano.specs -specs=nosys.specs
      vendor=GCC Systems
      version=NXP GCC 10.2.0 20200723 (Build 1728 Revision g5963bc8)
    compiler GHS_Compiler:
      name=Green Hills
      options=-cpu=cortexm4 -cpu=cortexm0plus -thumb -fpu=vfpv4_d16 -fsingle -fsoft -C99 --ghstd=last -Osize --gnu_asm -dual_debug -G -keeptempfiles -Wimplicit-int -Wshadow -Wtrigraphs -Wundef --unsigned_chars --unsigned_fields --no_commons --no_exceptions --no_slash_comment --prototype_errors --incorrect_pragma_warnings -c -DUSE_SW_VECTOR_MODE -DI_CACHE_ENABLE -DENABLE_FPU -DMCAL_ENABLE_USER_MODE_SUPPORT
      vendor=Green Hills
      version=Green Hills Multi 7.1.6d / Compiler 2020.1.4
    compiler IAR_Compiler:
      name=IAR Compiler
      options=--cpu=Cortex-M4 --cpu=Cortex-M0+ --cpu_mode=thumb --endian=little --fpu=FPv4-SP --fpu=none -e -Ohz --debug --no_clustering --no_mem_idioms --no_explicit_zero_opt --require_prototypes --no_wrap_diagnostics --diag_suppress=Pa050 -DIAR -DUSE_SW_VECTOR_MODE -DI_CACHE_ENABLE -DENABLE_FPU -DMCAL_ENABLE_USER_MODE_SUPPORT
      vendor=IAR Systems
      version=IAR ANSI C/C++ Compiler V8.40.3.228/W32 for ARM Functional Safety
    generated-artifacts:
      9 x dependency on artifact:
        CDD_Qdec_Ipw_PBcfg_h: artifact-descriptor={short-label=generate_PB::include::CDD_Qdec_Ipw_PBcfg.h, category=SWHDR}, usages=EXECUTE
        CDD_Qdec_PBcfg_h: artifact-descriptor={short-label=generate_PB::include::CDD_Qdec_PBcfg.h, category=SWHDR}, usages=EXECUTE
        Ftm_Qdec_Ip_PBcfg_h: artifact-descriptor={short-label=generate_PB::include::Ftm_Qdec_Ip_PBcfg.h, category=SWHDR}, usages=EXECUTE
        CDD_Qdec_Ipw_PBcfg_c: artifact-descriptor={short-label=generate_PB::src::CDD_Qdec_Ipw_PBcfg.c, category=SWSRC}, usages=EXECUTE
        CDD_Qdec_PBcfg_c: artifact-descriptor={short-label=generate_PB::src::CDD_Qdec_PBcfg.c, category=SWSRC}, usages=EXECUTE
        Ftm_Qdec_Ip_PBcfg_c: artifact-descriptor={short-label=generate_PB::src::Ftm_Qdec_Ip_PBcfg.c, category=SWSRC}, usages=EXECUTE
        CDD_Qdec_Cfg_h: artifact-descriptor={short-label=generate_PC::include::CDD_Qdec_Cfg.h, category=SWHDR}, usages=COMPILE
        Ftm_Qdec_Ip_Cfg_h: artifact-descriptor={short-label=generate_PC::include::Ftm_Qdec_Ip_Cfg.h, category=SWHDR}, usages=COMPILE
        Ftm_Qdec_Ip_CfgDefines_h: artifact-descriptor={short-label=generate_PC::include::Ftm_Qdec_Ip_CfgDefines.h, category=SWHDR}, usages=COMPILE
    linker GCC_Linker: name=GCC Compiler, options=-Wl,-Map,filename -T linkerfile --entry=Reset_Handler -nostartfiles -mcpu=cortex-m4 -mcpu=cortex-m0plus -mthumb -mfpu=fpv4-sp-d16 -mfloat-abi=hard -mfpu=auto -mfloat-abi=soft -mlittle-endian -ggdb3 -lc -lm -lgcc -n --sysroot=$(NEWLIB_DIR) -specs=nano.specs -specs=nosys.specs, vendor=GCC Systems, version=NXP GCC 10.2.0 20200723 (Build 1728 Revision g5963bc8)
    linker GHS_Linker: name=Green Hills, options=-e Reset_Handler -T linker_script_file.ld -map -keepmap -Mn -delete -ignore_debug_references -Llibrary_path -larch -lstartup -lind_sd -lind_sf -v -keep=C40_Ip_AccessCode -nostartfiles, vendor=Green Hills, version=Green Hills Multi 7.1.6d / Compiler 2020.1.4
    linker IAR_Linker: name=IAR Compiler, options=--map filename --config linkerfile --cpu=Cortex-M4 --cpu=Cortex-M0+ --fpu=FPv4-SP --fpu=none --entry _start --enable_stack_usage --skip_dynamic_initialization --no_wrap_diagnostics, vendor=IAR Systems, version=IAR ANSI C/C++ Compiler V8.40.3.228/W32 for ARM Functional Safety
    resource consumption ResourceConsumption
      7 x memory section:
        QDEC_CODE: alignment=UNSPECIFIED, sw-addrmethod=CODE, symbol=CODE
        QDEC_CONFIG_DATA_UNSPECIFIED: alignment=UNSPECIFIED, sw-addrmethod=CONFIG_DATA, symbol=CONFIG_DATA_UNSPECIFIED
        QDEC_CONFIG_DATA_UNSPECIFIED_NO_CACHEABLE: alignment=UNSPECIFIED, sw-addrmethod=CONFIG_DATA_NO_CACHEABLE, symbol=CONFIG_DATA_UNSPECIFIED_NO_CACHEABLE
        QDEC_CONST_UNSPECIFIED: alignment=UNSPECIFIED, sw-addrmethod=CONST, symbol=CONST_UNSPECIFIED
        QDEC_VAR_CLEARED_BOOLEAN_NO_CACHEABLE: alignment=BOOLEAN, sw-addrmethod=VAR_CLEARED_NO_CACHEABLE, symbol=VAR_CLEARED_BOOLEAN_NO_CACHEABLE
        QDEC_VAR_CLEARED_UNSPECIFIED_NO_CACHEABLE: alignment=UNSPECIFIED, sw-addrmethod=VAR_CLEARED_NO_CACHEABLE, symbol=VAR_CLEARED_UNSPECIFIED_NO_CACHEABLE
        QDEC_VAR_INIT_UNSPECIFIED_NO_CACHEABLE: alignment=UNSPECIFIED, sw-addrmethod=VAR_INIT_NO_CACHEABLE, symbol=VAR_INIT_UNSPECIFIED_NO_CACHEABLE
