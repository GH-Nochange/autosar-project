AUTOSAR XML (schema 00050)
package /AUTOSAR_BaseNXP/BswModuleDescriptions
  bsw module description BaseNXP: module-id=0, provided-entrys=[OsIf_GetCounter, OsIf_GetElapsed, OsIf_Init, OsIf_MicrosToTicks, OsIf_SetTimerFrequency]
    bsw internal behavior InternalBehavior_0
      5 x bsw called entity:
        OsIf_GetCounter: implemented-entry=OsIf_GetCounter
        OsIf_GetElapsed: implemented-entry=OsIf_GetElapsed
        OsIf_Init: implemented-entry=OsIf_Init
        OsIf_MicrosToTicks: implemented-entry=OsIf_MicrosToTicks
        OsIf_SetTimerFrequency: implemented-entry=OsIf_SetTimerFrequency
package /AUTOSAR_BaseNXP/BswModuleEntrys
  5 x bsw module entry, all with is-synchronous=true, call-type=REGULAR, execution-context=UNSPECIFIED, sw-service-impl-policy=STANDARD:
    OsIf_GetCounter: service-id=0x02, is-reentrant=true
    OsIf_GetElapsed: service-id=0x03, is-reentrant=true
    OsIf_Init: service-id=0x01, is-reentrant=false
    OsIf_MicrosToTicks: service-id=0x05, is-reentrant=true
    OsIf_SetTimerFrequency: service-id=0x04, is-reentrant=true
package /BaseNXP_TS_T40D2M30I0R0/Implementations
  bsw implementation BswImplementation_0: programming-language=C, sw-version=3.0.0_QLP02, vendor-id=43, ar-release-version=4.7.0, behavior=InternalBehavior_0, vendor-specific-module-def=BaseNXP
    code-descriptors:
      code Files
        artifact-descriptors:
          short-label=config::Base.xdm, category=SWCFG
          short-label=config::BaseNXP.xdm, category=SWCFG
          short-label=doc::howto::HOWTO_Port_An_S32DS_Example_To_Use_Another_Compiler.pdf, category=SWDOC
          short-label=doc::RTD_BASENXP_IM.pdf, category=SWDOC
          short-label=doc::RTD_BASENXP_UM.pdf, category=SWDOC
          short-label=header::S32K116.h, category=SWHDR
          short-label=header::S32K116_ADC.h, category=SWHDR
          short-label=header::S32K116_AIPS.h, category=SWHDR
          short-label=header::S32K116_CMP.h, category=SWHDR
          short-label=header::S32K116_CMU.h, category=SWHDR
          short-label=header::S32K116_COMMON.h, category=SWHDR
          short-label=header::S32K116_CRC.h, category=SWHDR
          short-label=header::S32K116_DMA.h, category=SWHDR
          short-label=header::S32K116_DMAMUX.h, category=SWHDR
          short-label=header::S32K116_EIM.h, category=SWHDR
          short-label=header::S32K116_ERM.h, category=SWHDR
          short-label=header::S32K116_FLEXCAN.h, category=SWHDR
          short-label=header::S32K116_FLEXIO.h, category=SWHDR
          short-label=header::S32K116_FTFC.h, category=SWHDR
          short-label=header::S32K116_FTM.h, category=SWHDR
          short-label=header::S32K116_GPIO.h, category=SWHDR
          short-label=header::S32K116_LMEM.h, category=SWHDR
          short-label=header::S32K116_LPI2C.h, category=SWHDR
          short-label=header::S32K116_LPIT.h, category=SWHDR
          short-label=header::S32K116_LPSPI.h, category=SWHDR
          short-label=header::S32K116_LPTMR.h, category=SWHDR
          short-label=header::S32K116_LPUART.h, category=SWHDR
          short-label=header::S32K116_MCM.h, category=SWHDR
          short-label=header::S32K116_MPU.h, category=SWHDR
          short-label=header::S32K116_MSCM.h, category=SWHDR
          short-label=header::S32K116_MTB_DWT.h, category=SWHDR
          short-label=header::S32K116_NVIC.h, category=SWHDR
          short-label=header::S32K116_PCC.h, category=SWHDR
          short-label=header::S32K116_PDB.h, category=SWHDR
          short-label=header::S32K116_PMC.h, category=SWHDR
          short-label=header::S32K116_PORT.h, category=SWHDR
          short-label=header::S32K116_RCM.h, category=SWHDR
          short-label=header::S32K116_RTC.h, category=SWHDR
          short-label=header::S32K116_SCB.h, category=SWHDR
          short-label=header::S32K116_SCG.h, category=SWHDR
          short-label=header::S32K116_SIM.h, category=SWHDR
          short-label=header::S32K116_SMC.h, category=SWHDR
          short-label=header::S32K116_SYSTICK.h, category=SWHDR
          short-label=header::S32K116_TRGMUX.h, category=SWHDR
          short-label=header::S32K116_WDOG.h, category=SWHDR
          short-label=header::S32K118.h, category=SWHDR
          short-label=header::S32K118_ADC.h, category=SWHDR
          short-label=header::S32K118_AIPS.h, category=SWHDR
          short-label=header::S32K118_CMP.h, category=SWHDR
          short-label=header::S32K118_CMU.h, category=SWHDR
          short-label=header::S32K118_COMMON.h, category=SWHDR
          short-label=header::S32K118_CRC.h, category=SWHDR
          short-label=header::S32K118_DMA.h, category=SWHDR
          short-label=header::S32K118_DMAMUX.h, category=SWHDR
          short-label=header::S32K118_EIM.h, category=SWHDR
          short-label=header::S32K118_ERM.h, category=SWHDR
          short-label=header::S32K118_FLEXCAN.h, category=SWHDR
          short-label=header::S32K118_FLEXIO.h, category=SWHDR
          short-label=header::S32K118_FTFC.h, category=SWHDR
          short-label=header::S32K118_FTM.h, category=SWHDR
          short-label=header::S32K118_GPIO.h, category=SWHDR
          short-label=header::S32K118_LMEM.h, category=SWHDR
          short-label=header::S32K118_LPI2C.h, category=SWHDR
          short-label=header::S32K118_LPIT.h, category=SWHDR
          short-label=header::S32K118_LPSPI.h, category=SWHDR
          short-label=header::S32K118_LPTMR.h, category=SWHDR
          short-label=header::S32K118_LPUART.h, category=SWHDR
          short-label=header::S32K118_MCM.h, category=SWHDR
          short-label=header::S32K118_MPU.h, category=SWHDR
          short-label=header::S32K118_MSCM.h, category=SWHDR
          short-label=header::S32K118_MTB_DWT.h, category=SWHDR
          short-label=header::S32K118_NVIC.h, category=SWHDR
          short-label=header::S32K118_PCC.h, category=SWHDR
          short-label=header::S32K118_PDB.h, category=SWHDR
          short-label=header::S32K118_PMC.h, category=SWHDR
          short-label=header::S32K118_PORT.h, category=SWHDR
          short-label=header::S32K118_RCM.h, category=SWHDR
          short-label=header::S32K118_RTC.h, category=SWHDR
          short-label=header::S32K118_SCB.h, category=SWHDR
          short-label=header::S32K118_SCG.h, category=SWHDR
          short-label=header::S32K118_SIM.h, category=SWHDR
          short-label=header::S32K118_SMC.h, category=SWHDR
          short-label=header::S32K118_SYSTICK.h, category=SWHDR
          short-label=header::S32K118_TRGMUX.h, category=SWHDR
          short-label=header::S32K118_WDOG.h, category=SWHDR
          short-label=header::S32K142.h, category=SWHDR
          short-label=header::S32K142W.h, category=SWHDR
          short-label=header::S32K142W_ADC.h, category=SWHDR
          short-label=header::S32K142W_AIPS.h, category=SWHDR
          short-label=header::S32K142W_CMP.h, category=SWHDR
          short-label=header::S32K142W_COMMON.h, category=SWHDR
          short-label=header::S32K142W_CRC.h, category=SWHDR
          short-label=header::S32K142W_DMA.h, category=SWHDR
          short-label=header::S32K142W_DMAMUX.h, category=SWHDR
          short-label=header::S32K142W_EIM.h, category=SWHDR
          short-label=header::S32K142W_ERM.h, category=SWHDR
          short-label=header::S32K142W_EWM.h, category=SWHDR
          short-label=header::S32K142W_FLEXCAN.h, category=SWHDR
          short-label=header::S32K142W_FLEXIO.h, category=SWHDR
          short-label=header::S32K142W_FTFM.h, category=SWHDR
          short-label=header::S32K142W_FTM.h, category=SWHDR
          short-label=header::S32K142W_GPIO.h, category=SWHDR
          short-label=header::S32K142W_LMEM.h, category=SWHDR
          short-label=header::S32K142W_LPI2C.h, category=SWHDR
          short-label=header::S32K142W_LPIT.h, category=SWHDR
          short-label=header::S32K142W_LPSPI.h, category=SWHDR
          short-label=header::S32K142W_LPTMR.h, category=SWHDR
          short-label=header::S32K142W_LPUART.h, category=SWHDR
          short-label=header::S32K142W_MCM.h, category=SWHDR
          short-label=header::S32K142W_MPU.h, category=SWHDR
          short-label=header::S32K142W_MSCM.h, category=SWHDR
          short-label=header::S32K142W_NVIC.h, category=SWHDR
          short-label=header::S32K142W_PCC.h, category=SWHDR
          short-label=header::S32K142W_PDB.h, category=SWHDR
          short-label=header::S32K142W_PMC.h, category=SWHDR
          short-label=header::S32K142W_PORT.h, category=SWHDR
          short-label=header::S32K142W_RCM.h, category=SWHDR
          short-label=header::S32K142W_RTC.h, category=SWHDR
          short-label=header::S32K142W_SCB.h, category=SWHDR
          short-label=header::S32K142W_SCG.h, category=SWHDR
          short-label=header::S32K142W_SIM.h, category=SWHDR
          short-label=header::S32K142W_SMC.h, category=SWHDR
          short-label=header::S32K142W_SYSTICK.h, category=SWHDR
          short-label=header::S32K142W_TRGMUX.h, category=SWHDR
          short-label=header::S32K142W_WDOG.h, category=SWHDR
          short-label=header::S32K142_ADC.h, category=SWHDR
          short-label=header::S32K142_AIPS.h, category=SWHDR
          short-label=header::S32K142_CMP.h, category=SWHDR
          short-label=header::S32K142_COMMON.h, category=SWHDR
          short-label=header::S32K142_CRC.h, category=SWHDR
          short-label=header::S32K142_DMA.h, category=SWHDR
          short-label=header::S32K142_DMAMUX.h, category=SWHDR
          short-label=header::S32K142_EIM.h, category=SWHDR
          short-label=header::S32K142_ERM.h, category=SWHDR
          short-label=header::S32K142_EWM.h, category=SWHDR
          short-label=header::S32K142_FLEXCAN.h, category=SWHDR
          short-label=header::S32K142_FLEXIO.h, category=SWHDR
          short-label=header::S32K142_FTFC.h, category=SWHDR
          short-label=header::S32K142_FTM.h, category=SWHDR
          short-label=header::S32K142_GPIO.h, category=SWHDR
          short-label=header::S32K142_LMEM.h, category=SWHDR
          short-label=header::S32K142_LPI2C.h, category=SWHDR
          short-label=header::S32K142_LPIT.h, category=SWHDR
          short-label=header::S32K142_LPSPI.h, category=SWHDR
          short-label=header::S32K142_LPTMR.h, category=SWHDR
          short-label=header::S32K142_LPUART.h, category=SWHDR
          short-label=header::S32K142_MCM.h, category=SWHDR
          short-label=header::S32K142_MPU.h, category=SWHDR
          short-label=header::S32K142_MSCM.h, category=SWHDR
          short-label=header::S32K142_NVIC.h, category=SWHDR
          short-label=header::S32K142_PCC.h, category=SWHDR
          short-label=header::S32K142_PDB.h, category=SWHDR
          short-label=header::S32K142_PMC.h, category=SWHDR
          short-label=header::S32K142_PORT.h, category=SWHDR
          short-label=header::S32K142_RCM.h, category=SWHDR
          short-label=header::S32K142_RTC.h, category=SWHDR
          short-label=header::S32K142_SCB.h, category=SWHDR
          short-label=header::S32K142_SCG.h, category=SWHDR
          short-label=header::S32K142_SIM.h, category=SWHDR
          short-label=header::S32K142_SMC.h, category=SWHDR
          short-label=header::S32K142_SYSTICK.h, category=SWHDR
          short-label=header::S32K142_TRGMUX.h, category=SWHDR
          short-label=header::S32K142_WDOG.h, category=SWHDR
          short-label=header::S32K144.h, category=SWHDR
          short-label=header::S32K144W.h, category=SWHDR
          short-label=header::S32K144W_ADC.h, category=SWHDR
          short-label=header::S32K144W_AIPS.h, category=SWHDR
          short-label=header::S32K144W_CMP.h, category=SWHDR
          short-label=header::S32K144W_COMMON.h, category=SWHDR
          short-label=header::S32K144W_CRC.h, category=SWHDR
          short-label=header::S32K144W_DMA.h, category=SWHDR
          short-label=header::S32K144W_DMAMUX.h, category=SWHDR
          short-label=header::S32K144W_EIM.h, category=SWHDR
          short-label=header::S32K144W_ERM.h, category=SWHDR
          short-label=header::S32K144W_EWM.h, category=SWHDR
          short-label=header::S32K144W_FLEXCAN.h, category=SWHDR
          short-label=header::S32K144W_FLEXIO.h, category=SWHDR
          short-label=header::S32K144W_FTFM.h, category=SWHDR
          short-label=header::S32K144W_FTM.h, category=SWHDR
          short-label=header::S32K144W_GPIO.h, category=SWHDR
          short-label=header::S32K144W_LMEM.h, category=SWHDR
          short-label=header::S32K144W_LPI2C.h, category=SWHDR
          short-label=header::S32K144W_LPIT.h, category=SWHDR
          short-label=header::S32K144W_LPSPI.h, category=SWHDR
          short-label=header::S32K144W_LPTMR.h, category=SWHDR
          short-label=header::S32K144W_LPUART.h, category=SWHDR
          short-label=header::S32K144W_MCM.h, category=SWHDR
          short-label=header::S32K144W_MPU.h, category=SWHDR
          short-label=header::S32K144W_MSCM.h, category=SWHDR
          short-label=header::S32K144W_NVIC.h, category=SWHDR
          short-label=header::S32K144W_PCC.h, category=SWHDR
          short-label=header::S32K144W_PDB.h, category=SWHDR
          short-label=header::S32K144W_PMC.h, category=SWHDR
          short-label=header::S32K144W_PORT.h, category=SWHDR
          short-label=header::S32K144W_RCM.h, category=SWHDR
          short-label=header::S32K144W_RTC.h, category=SWHDR
          short-label=header::S32K144W_SCB.h, category=SWHDR
          short-label=header::S32K144W_SCG.h, category=SWHDR
          short-label=header::S32K144W_SIM.h, category=SWHDR
          short-label=header::S32K144W_SMC.h, category=SWHDR
          short-label=header::S32K144W_SYSTICK.h, category=SWHDR
          short-label=header::S32K144W_TRGMUX.h, category=SWHDR
          short-label=header::S32K144W_WDOG.h, category=SWHDR
          short-label=header::S32K144_ADC.h, category=SWHDR
          short-label=header::S32K144_AIPS.h, category=SWHDR
          short-label=header::S32K144_CMP.h, category=SWHDR
          short-label=header::S32K144_COMMON.h, category=SWHDR
          short-label=header::S32K144_CRC.h, category=SWHDR
          short-label=header::S32K144_DMA.h, category=SWHDR
          short-label=header::S32K144_DMAMUX.h, category=SWHDR
          short-label=header::S32K144_EIM.h, category=SWHDR
          short-label=header::S32K144_ERM.h, category=SWHDR
          short-label=header::S32K144_EWM.h, category=SWHDR
          short-label=header::S32K144_FLEXCAN.h, category=SWHDR
          short-label=header::S32K144_FLEXIO.h, category=SWHDR
          short-label=header::S32K144_FTFC.h, category=SWHDR
          short-label=header::S32K144_FTM.h, category=SWHDR
          short-label=header::S32K144_GPIO.h, category=SWHDR
          short-label=header::S32K144_LMEM.h, category=SWHDR
          short-label=header::S32K144_LPI2C.h, category=SWHDR
          short-label=header::S32K144_LPIT.h, category=SWHDR
          short-label=header::S32K144_LPSPI.h, category=SWHDR
          short-label=header::S32K144_LPTMR.h, category=SWHDR
          short-label=header::S32K144_LPUART.h, category=SWHDR
          short-label=header::S32K144_MCM.h, category=SWHDR
          short-label=header::S32K144_MPU.h, category=SWHDR
          short-label=header::S32K144_MSCM.h, category=SWHDR
          short-label=header::S32K144_NVIC.h, category=SWHDR
          short-label=header::S32K144_PCC.h, category=SWHDR
          short-label=header::S32K144_PDB.h, category=SWHDR
          short-label=header::S32K144_PMC.h, category=SWHDR
          short-label=header::S32K144_PORT.h, category=SWHDR
          short-label=header::S32K144_RCM.h, category=SWHDR
          short-label=header::S32K144_RTC.h, category=SWHDR
          short-label=header::S32K144_SCB.h, category=SWHDR
          short-label=header::S32K144_SCG.h, category=SWHDR
          short-label=header::S32K144_SIM.h, category=SWHDR
          short-label=header::S32K144_SMC.h, category=SWHDR
          short-label=header::S32K144_SYSTICK.h, category=SWHDR
          short-label=header::S32K144_TRGMUX.h, category=SWHDR
          short-label=header::S32K144_WDOG.h, category=SWHDR
          short-label=header::S32K146.h, category=SWHDR
          short-label=header::S32K146_ADC.h, category=SWHDR
          short-label=header::S32K146_AIPS.h, category=SWHDR
          short-label=header::S32K146_CMP.h, category=SWHDR
          short-label=header::S32K146_COMMON.h, category=SWHDR
          short-label=header::S32K146_CRC.h, category=SWHDR
          short-label=header::S32K146_DMA.h, category=SWHDR
          short-label=header::S32K146_DMAMUX.h, category=SWHDR
          short-label=header::S32K146_EIM.h, category=SWHDR
          short-label=header::S32K146_ERM.h, category=SWHDR
          short-label=header::S32K146_EWM.h, category=SWHDR
          short-label=header::S32K146_FLEXCAN.h, category=SWHDR
          short-label=header::S32K146_FLEXIO.h, category=SWHDR
          short-label=header::S32K146_FTFC.h, category=SWHDR
          short-label=header::S32K146_FTM.h, category=SWHDR
          short-label=header::S32K146_GPIO.h, category=SWHDR
          short-label=header::S32K146_LMEM.h, category=SWHDR
          short-label=header::S32K146_LPI2C.h, category=SWHDR
          short-label=header::S32K146_LPIT.h, category=SWHDR
          short-label=header::S32K146_LPSPI.h, category=SWHDR
          short-label=header::S32K146_LPTMR.h, category=SWHDR
          short-label=header::S32K146_LPUART.h, category=SWHDR
          short-label=header::S32K146_MCM.h, category=SWHDR
          short-label=header::S32K146_MPU.h, category=SWHDR
          short-label=header::S32K146_MSCM.h, category=SWHDR
          short-label=header::S32K146_NVIC.h, category=SWHDR
          short-label=header::S32K146_PCC.h, category=SWHDR
          short-label=header::S32K146_PDB.h, category=SWHDR
          short-label=header::S32K146_PMC.h, category=SWHDR
          short-label=header::S32K146_PORT.h, category=SWHDR
          short-label=header::S32K146_RCM.h, category=SWHDR
          short-label=header::S32K146_RTC.h, category=SWHDR
          short-label=header::S32K146_SCB.h, category=SWHDR
          short-label=header::S32K146_SCG.h, category=SWHDR
          short-label=header::S32K146_SIM.h, category=SWHDR
          short-label=header::S32K146_SMC.h, category=SWHDR
          short-label=header::S32K146_SYSTICK.h, category=SWHDR
          short-label=header::S32K146_TRGMUX.h, category=SWHDR
          short-label=header::S32K146_WDOG.h, category=SWHDR
          short-label=header::S32K148.h, category=SWHDR
          short-label=header::S32K148_ADC.h, category=SWHDR
          short-label=header::S32K148_AIPS.h, category=SWHDR
          short-label=header::S32K148_CMP.h, category=SWHDR
          short-label=header::S32K148_COMMON.h, category=SWHDR
          short-label=header::S32K148_CRC.h, category=SWHDR
          short-label=header::S32K148_DMA.h, category=SWHDR
          short-label=header::S32K148_DMAMUX.h, category=SWHDR
          short-label=header::S32K148_EIM.h, category=SWHDR
          short-label=header::S32K148_ENET.h, category=SWHDR
          short-label=header::S32K148_ERM.h, category=SWHDR
          short-label=header::S32K148_EWM.h, category=SWHDR
          short-label=header::S32K148_FLEXCAN.h, category=SWHDR
          short-label=header::S32K148_FLEXIO.h, category=SWHDR
          short-label=header::S32K148_FTFC.h, category=SWHDR
          short-label=header::S32K148_FTM.h, category=SWHDR
          short-label=header::S32K148_GPIO.h, category=SWHDR
          short-label=header::S32K148_LMEM.h, category=SWHDR
          short-label=header::S32K148_LPI2C.h, category=SWHDR
          short-label=header::S32K148_LPIT.h, category=SWHDR
          short-label=header::S32K148_LPSPI.h, category=SWHDR
          short-label=header::S32K148_LPTMR.h, category=SWHDR
          short-label=header::S32K148_LPUART.h, category=SWHDR
          short-label=header::S32K148_MCM.h, category=SWHDR
          short-label=header::S32K148_MPU.h, category=SWHDR
          short-label=header::S32K148_MSCM.h, category=SWHDR
          short-label=header::S32K148_NVIC.h, category=SWHDR
          short-label=header::S32K148_PCC.h, category=SWHDR
          short-label=header::S32K148_PDB.h, category=SWHDR
          short-label=header::S32K148_PMC.h, category=SWHDR
          short-label=header::S32K148_PORT.h, category=SWHDR
          short-label=header::S32K148_QUADSPI.h, category=SWHDR
          short-label=header::S32K148_RCM.h, category=SWHDR
          short-label=header::S32K148_RTC.h, category=SWHDR
          short-label=header::S32K148_SAI.h, category=SWHDR
          short-label=header::S32K148_SCB.h, category=SWHDR
          short-label=header::S32K148_SCG.h, category=SWHDR
          short-label=header::S32K148_SIM.h, category=SWHDR
          short-label=header::S32K148_SMC.h, category=SWHDR
          short-label=header::S32K148_SYSTICK.h, category=SWHDR
          short-label=header::S32K148_TRGMUX.h, category=SWHDR
          short-label=header::S32K148_WDOG.h, category=SWHDR
          short-label=header::S32M24x.h, category=SWHDR
          short-label=header::S32M24x_ADC.h, category=SWHDR
          short-label=header::S32M24x_AEC_AE.h, category=SWHDR
          short-label=header::S32M24x_AIPS.h, category=SWHDR
          short-label=header::S32M24x_CMP.h, category=SWHDR
          short-label=header::S32M24x_COMMON.h, category=SWHDR
          short-label=header::S32M24x_CRC.h, category=SWHDR
          short-label=header::S32M24x_DMA.h, category=SWHDR
          short-label=header::S32M24x_DMAMUX.h, category=SWHDR
          short-label=header::S32M24x_DPGA_AE.h, category=SWHDR
          short-label=header::S32M24x_EIM.h, category=SWHDR
          short-label=header::S32M24x_ERM.h, category=SWHDR
          short-label=header::S32M24x_EWM.h, category=SWHDR
          short-label=header::S32M24x_FLEXCAN.h, category=SWHDR
          short-label=header::S32M24x_FLEXIO.h, category=SWHDR
          short-label=header::S32M24x_FTFC.h, category=SWHDR
          short-label=header::S32M24x_FTFM.h, category=SWHDR
          short-label=header::S32M24x_FTM.h, category=SWHDR
          short-label=header::S32M24x_GDU_AE.h, category=SWHDR
          short-label=header::S32M24x_GPIO.h, category=SWHDR
          short-label=header::S32M24x_HVI_AE.h, category=SWHDR
          short-label=header::S32M24x_LMEM.h, category=SWHDR
          short-label=header::S32M24x_LPI2C.h, category=SWHDR
          short-label=header::S32M24x_LPIT.h, category=SWHDR
          short-label=header::S32M24x_LPSPI.h, category=SWHDR
          short-label=header::S32M24x_LPTMR.h, category=SWHDR
          short-label=header::S32M24x_LPUART.h, category=SWHDR
          short-label=header::S32M24x_MCM.h, category=SWHDR
          short-label=header::S32M24x_MEM_OTP_AE.h, category=SWHDR
          short-label=header::S32M24x_MPU.h, category=SWHDR
          short-label=header::S32M24x_MSCM.h, category=SWHDR
          short-label=header::S32M24x_NVIC.h, category=SWHDR
          short-label=header::S32M24x_PCC.h, category=SWHDR
          short-label=header::S32M24x_PDB.h, category=SWHDR
          short-label=header::S32M24x_PMC.h, category=SWHDR
          short-label=header::S32M24x_PMC_142.h, category=SWHDR
          short-label=header::S32M24x_PMC_AE.h, category=SWHDR
          short-label=header::S32M24x_PORT.h, category=SWHDR
          short-label=header::S32M24x_RCM.h, category=SWHDR
          short-label=header::S32M24x_RTC.h, category=SWHDR
          short-label=header::S32M24x_SCB.h, category=SWHDR
          short-label=header::S32M24x_SCG.h, category=SWHDR
          short-label=header::S32M24x_SIM.h, category=SWHDR
          short-label=header::S32M24x_SMC.h, category=SWHDR
          short-label=header::S32M24x_SYSTICK.h, category=SWHDR
          short-label=header::S32M24x_TRGMUX.h, category=SWHDR
          short-label=header::S32M24x_WDOG.h, category=SWHDR
          short-label=include::Adc_MemMap.h, category=SWHDR
          short-label=include::Ae_MemMap.h, category=SWHDR
          short-label=include::BaseNXP.h, category=SWHDR
          short-label=include::BaseNXP_MemMap.h, category=SWHDR
          short-label=include::BasicTypes.h, category=SWHDR
          short-label=include::CanIf_MemMap.h, category=SWHDR
          short-label=include::CanTrcv_43_AE_MemMap.h, category=SWHDR
          short-label=include::CanTrcv_43_tja1145a_MemMap.h, category=SWHDR
          short-label=include::Can_43_FLEXCAN_MemMap.h, category=SWHDR
          short-label=include::Can_43_LLCE_MemMap.h, category=SWHDR
          short-label=include::Can_GeneralTypes.h, category=SWHDR
          short-label=include::Can_MemMap.h, category=SWHDR
          short-label=include::Compiler.h, category=SWHDR
          short-label=include::CompilerDefinition.h, category=SWHDR
          short-label=include::Compiler_Cfg.h, category=SWHDR
          short-label=include::ComStackTypes.h, category=SWHDR
          short-label=include::ComStack_Cfg.h, category=SWHDR
          short-label=include::ComStack_Types.h, category=SWHDR
          short-label=include::Crc_MemMap.h, category=SWHDR
          short-label=include::Crypto_43_CSEC_MemMap.h, category=SWHDR
          short-label=include::Crypto_MemMap.h, category=SWHDR
          short-label=include::Csec_MemMap.h, category=SWHDR
          short-label=include::Cxpi_MemMap.h, category=SWHDR
          short-label=include::Dem_MemMap.h, category=SWHDR
          short-label=include::Det_MemMap.h, category=SWHDR
          short-label=include::Devassert.h, category=SWHDR
          short-label=include::Dio_MemMap.h, category=SWHDR
          short-label=include::Dpga_MemMap.h, category=SWHDR
          short-label=include::Ecum_MemMap.h, category=SWHDR
          short-label=include::Eep_MemMap.h, category=SWHDR
          short-label=include::EthSwitch_43_SJA1105P_MemMap.h, category=SWHDR
          short-label=include::EthSwt_43_SJA11XX_MemMap.h, category=SWHDR
          short-label=include::EthTrcv_43_PHY_MemMap.h, category=SWHDR
          short-label=include::EthTrcv_43_TJA110X_MemMap.h, category=SWHDR
          short-label=include::Eth_43_ENET_MemMap.h, category=SWHDR
          short-label=include::Eth_43_PFE_MemMap.h, category=SWHDR
          short-label=include::Eth_GeneralTypes.h, category=SWHDR
          short-label=include::Eth_MemMap.h, category=SWHDR
          short-label=include::Fee_MemMap.h, category=SWHDR
          short-label=include::Fls_MemMap.h, category=SWHDR
          short-label=include::Fr_43_LLCE_MemMap.h, category=SWHDR
          short-label=include::Fr_GeneralTypes.h, category=SWHDR
          short-label=include::Fr_MemMap.h, category=SWHDR
          short-label=include::Gdu_MemMap.h, category=SWHDR
          short-label=include::Gpt_MemMap.h, category=SWHDR
          short-label=include::I2c_MemMap.h, category=SWHDR
          short-label=include::I2s_MemMap.h, category=SWHDR
          short-label=include::Icu_MemMap.h, category=SWHDR
          short-label=include::IpVersionMacros.h, category=SWHDR
          short-label=include::Iseled_MemMap.h, category=SWHDR
          short-label=include::LinTrcv_43_AE_MemMap.h, category=SWHDR
          short-label=include::Lin_43_LLCE_MemMap.h, category=SWHDR
          short-label=include::Lin_43_LPUART_FLEXIO_MemMap.h, category=SWHDR
          short-label=include::Lin_GeneralTypes.h, category=SWHDR
          short-label=include::Lin_MemMap.h, category=SWHDR
          short-label=include::Mcal.h, category=SWHDR
          short-label=include::Mcem_MemMap.h, category=SWHDR
          short-label=include::Mcl_MemMap.h, category=SWHDR
          short-label=include::Mcu_MemMap.h, category=SWHDR
          short-label=include::MemAcc_GeneralTypes.h, category=SWHDR
          short-label=include::MemAcc_MemMap.h, category=SWHDR
          short-label=include::Mem_43_EEP_MemMap.h, category=SWHDR
          short-label=include::Mem_43_EXFLS_MemMap.h, category=SWHDR
          short-label=include::Mem_43_INFLS_MemMap.h, category=SWHDR
          short-label=include::Ocotp_MemMap.h, category=SWHDR
          short-label=include::Ocu_MemMap.h, category=SWHDR
          short-label=include::OsIf.h, category=SWHDR
          short-label=include::OsIf_Cfg_TypesDef.h, category=SWHDR
          short-label=include::OsIf_DeviceRegisters.h, category=SWHDR
          short-label=include::OsIf_Internal.h, category=SWHDR
          short-label=include::OsIf_Interrupts.h, category=SWHDR
          short-label=include::OsIf_Software_Semaphore.h, category=SWHDR
          short-label=include::OsIf_Timer_Custom.h, category=SWHDR
          short-label=include::OsIf_Timer_System.h, category=SWHDR
          short-label=include::OsIf_Timer_System_Internal_Systick.h, category=SWHDR
          short-label=include::OsIf_TrustedFunctions.h, category=SWHDR
          short-label=include::PlatformTypes.h, category=SWHDR
          short-label=include::Platform_MemMap.h, category=SWHDR
          short-label=include::Platform_Types.h, category=SWHDR
          short-label=include::Pmic_MemMap.h, category=SWHDR
          short-label=include::Port_MemMap.h, category=SWHDR
          short-label=include::Pwm_MemMap.h, category=SWHDR
          short-label=include::Qdec_MemMap.h, category=SWHDR
          short-label=include::RegLockMacros.h, category=SWHDR
          short-label=include::Reg_eSys.h, category=SWHDR
          short-label=include::Rm_MemMap.h, category=SWHDR
          short-label=include::Rte_MemMap.h, category=SWHDR
          short-label=include::Sbc_fs26_MemMap.h, category=SWHDR
          short-label=include::Sent_MemMap.h, category=SWHDR
          short-label=include::Spi_MemMap.h, category=SWHDR
          short-label=include::StandardTypes.h, category=SWHDR
          short-label=include::Std_Types.h, category=SWHDR
          short-label=include::Uart_MemMap.h, category=SWHDR
          short-label=include::Wdg_43_fs26_MemMap.h, category=SWHDR
          short-label=include::Wdg_MemMap.h, category=SWHDR
          short-label=src::OsIf_Interrupts.c, category=SWSRC
          short-label=src::OsIf_Software_Semaphore.c, category=SWSRC
          short-label=src::OsIf_Timer.c, category=SWSRC
          short-label=src::OsIf_Timer_System.c, category=SWSRC
          short-label=src::OsIf_Timer_System_Internal_Systick.c, category=SWSRC
          short-label=wizard_data::main.c, category=SWSRC
          short-label=wizard_data::modules.h, category=SWHDR
          short-label=wizard_data::OsIf_Cfg.c, category=SWSRC
          short-label=wizard_data::s32k116::Clock_Ip_Cfg.c, category=SWSRC
          short-label=wizard_data::s32k116::Clock_Ip_Cfg.h, category=SWHDR
          short-label=wizard_data::s32k116::Clock_Ip_Cfg_Defines.h, category=SWHDR
          short-label=wizard_data::s32k116::DeviceDefinition.h, category=SWHDR
          short-label=wizard_data::s32k116::OsIf_ArchCfg.h, category=SWHDR
          short-label=wizard_data::s32k116::OsIf_Cfg.h, category=SWHDR
          short-label=wizard_data::s32k116::Port_Ci_Port_Ip_Cfg.c, category=SWSRC
          short-label=wizard_data::s32k116::Port_Ci_Port_Ip_Cfg.h, category=SWHDR
          short-label=wizard_data::s32k116::Port_Ci_Port_Ip_Defines.h, category=SWHDR
          short-label=wizard_data::s32k118::Clock_Ip_Cfg.c, category=SWSRC
          short-label=wizard_data::s32k118::Clock_Ip_Cfg.h, category=SWHDR
          short-label=wizard_data::s32k118::Clock_Ip_Cfg_Defines.h, category=SWHDR
          short-label=wizard_data::s32k118::DeviceDefinition.h, category=SWHDR
          short-label=wizard_data::s32k118::OsIf_ArchCfg.h, category=SWHDR
          short-label=wizard_data::s32k118::OsIf_Cfg.h, category=SWHDR
          short-label=wizard_data::s32k118::Port_Ci_Port_Ip_Cfg.c, category=SWSRC
          short-label=wizard_data::s32k118::Port_Ci_Port_Ip_Cfg.h, category=SWHDR
          short-label=wizard_data::s32k118::Port_Ci_Port_Ip_Defines.h, category=SWHDR
          short-label=wizard_data::s32k11x::Soc_Ips.h, category=SWHDR
          short-label=wizard_data::s32k142::Clock_Ip_Cfg.c, category=SWSRC
          short-label=wizard_data::s32k142::Clock_Ip_Cfg.h, category=SWHDR
          short-label=wizard_data::s32k142::Clock_Ip_Cfg_Defines.h, category=SWHDR
          short-label=wizard_data::s32k142::DeviceDefinition.h, category=SWHDR
          short-label=wizard_data::s32k142::OsIf_ArchCfg.h, category=SWHDR
          short-label=wizard_data::s32k142::OsIf_Cfg.h, category=SWHDR
          short-label=wizard_data::s32k142::Port_Ci_Port_Ip_Cfg.c, category=SWSRC
          short-label=wizard_data::s32k142::Port_Ci_Port_Ip_Cfg.h, category=SWHDR
          short-label=wizard_data::s32k142::Port_Ci_Port_Ip_Defines.h, category=SWHDR
          short-label=wizard_data::s32k142w::Clock_Ip_Cfg.c, category=SWSRC
          short-label=wizard_data::s32k142w::Clock_Ip_Cfg.h, category=SWHDR
          short-label=wizard_data::s32k142w::Clock_Ip_Cfg_Defines.h, category=SWHDR
          short-label=wizard_data::s32k142w::DeviceDefinition.h, category=SWHDR
          short-label=wizard_data::s32k142w::OsIf_ArchCfg.h, category=SWHDR
          short-label=wizard_data::s32k142w::OsIf_Cfg.h, category=SWHDR
          short-label=wizard_data::s32k142w::Port_Ci_Port_Ip_Cfg.c, category=SWSRC
          short-label=wizard_data::s32k142w::Port_Ci_Port_Ip_Cfg.h, category=SWHDR
          short-label=wizard_data::s32k142w::Port_Ci_Port_Ip_Defines.h, category=SWHDR
          short-label=wizard_data::s32k144::Clock_Ip_Cfg.c, category=SWSRC
          short-label=wizard_data::s32k144::Clock_Ip_Cfg.h, category=SWHDR
          short-label=wizard_data::s32k144::Clock_Ip_Cfg_Defines.h, category=SWHDR
          short-label=wizard_data::s32k144::DeviceDefinition.h, category=SWHDR
          short-label=wizard_data::s32k144::OsIf_ArchCfg.h, category=SWHDR
          short-label=wizard_data::s32k144::OsIf_Cfg.h, category=SWHDR
          short-label=wizard_data::s32k144::Port_Ci_Port_Ip_Cfg.c, category=SWSRC
          short-label=wizard_data::s32k144::Port_Ci_Port_Ip_Cfg.h, category=SWHDR
          short-label=wizard_data::s32k144::Port_Ci_Port_Ip_Defines.h, category=SWHDR
          short-label=wizard_data::s32k144w::Clock_Ip_Cfg.c, category=SWSRC
          short-label=wizard_data::s32k144w::Clock_Ip_Cfg.h, category=SWHDR
          short-label=wizard_data::s32k144w::Clock_Ip_Cfg_Defines.h, category=SWHDR
          short-label=wizard_data::s32k144w::DeviceDefinition.h, category=SWHDR
          short-label=wizard_data::s32k144w::OsIf_ArchCfg.h, category=SWHDR
          short-label=wizard_data::s32k144w::OsIf_Cfg.h, category=SWHDR
          short-label=wizard_data::s32k144w::Port_Ci_Port_Ip_Cfg.c, category=SWSRC
          short-label=wizard_data::s32k144w::Port_Ci_Port_Ip_Cfg.h, category=SWHDR
          short-label=wizard_data::s32k144w::Port_Ci_Port_Ip_Defines.h, category=SWHDR
          short-label=wizard_data::s32k146::Clock_Ip_Cfg.c, category=SWSRC
          short-label=wizard_data::s32k146::Clock_Ip_Cfg.h, category=SWHDR
          short-label=wizard_data::s32k146::Clock_Ip_Cfg_Defines.h, category=SWHDR
          short-label=wizard_data::s32k146::DeviceDefinition.h, category=SWHDR
          short-label=wizard_data::s32k146::OsIf_ArchCfg.h, category=SWHDR
          short-label=wizard_data::s32k146::OsIf_Cfg.h, category=SWHDR
          short-label=wizard_data::s32k146::Port_Ci_Port_Ip_Cfg.c, category=SWSRC
          short-label=wizard_data::s32k146::Port_Ci_Port_Ip_Cfg.h, category=SWHDR
          short-label=wizard_data::s32k146::Port_Ci_Port_Ip_Defines.h, category=SWHDR
          short-label=wizard_data::s32k148::Clock_Ip_Cfg.c, category=SWSRC
          short-label=wizard_data::s32k148::Clock_Ip_Cfg.h, category=SWHDR
          short-label=wizard_data::s32k148::Clock_Ip_Cfg_Defines.h, category=SWHDR
          short-label=wizard_data::s32k148::DeviceDefinition.h, category=SWHDR
          short-label=wizard_data::s32k148::OsIf_ArchCfg.h, category=SWHDR
          short-label=wizard_data::s32k148::OsIf_Cfg.h, category=SWHDR
          short-label=wizard_data::s32k148::Port_Ci_Port_Ip_Cfg.c, category=SWSRC
          short-label=wizard_data::s32k148::Port_Ci_Port_Ip_Cfg.h, category=SWHDR
          short-label=wizard_data::s32k148::Port_Ci_Port_Ip_Defines.h, category=SWHDR
          short-label=wizard_data::s32k14x::Soc_Ips.h, category=SWHDR
          short-label=wizard_data::s32m241::Clock_Ip_Cfg.c, category=SWSRC
          short-label=wizard_data::s32m241::Clock_Ip_Cfg.h, category=SWHDR
          short-label=wizard_data::s32m241::Clock_Ip_Cfg_Defines.h, category=SWHDR
          short-label=wizard_data::s32m241::DeviceDefinition.h, category=SWHDR
          short-label=wizard_data::s32m241::OsIf_ArchCfg.h, category=SWHDR
          short-label=wizard_data::s32m241::OsIf_Cfg.h, category=SWHDR
          short-label=wizard_data::s32m241::Port_Ci_Port_Ip_Cfg.c, category=SWSRC
          short-label=wizard_data::s32m241::Port_Ci_Port_Ip_Cfg.h, category=SWHDR
          short-label=wizard_data::s32m241::Port_Ci_Port_Ip_Defines.h, category=SWHDR
          short-label=wizard_data::s32m242::Clock_Ip_Cfg.c, category=SWSRC
          short-label=wizard_data::s32m242::Clock_Ip_Cfg.h, category=SWHDR
          short-label=wizard_data::s32m242::Clock_Ip_Cfg_Defines.h, category=SWHDR
          short-label=wizard_data::s32m242::DeviceDefinition.h, category=SWHDR
          short-label=wizard_data::s32m242::OsIf_ArchCfg.h, category=SWHDR
          short-label=wizard_data::s32m242::OsIf_Cfg.h, category=SWHDR
          short-label=wizard_data::s32m242::Port_Ci_Port_Ip_Cfg.c, category=SWSRC
          short-label=wizard_data::s32m242::Port_Ci_Port_Ip_Cfg.h, category=SWHDR
          short-label=wizard_data::s32m242::Port_Ci_Port_Ip_Defines.h, category=SWHDR
          short-label=wizard_data::s32m243::Clock_Ip_Cfg.c, category=SWSRC
          short-label=wizard_data::s32m243::Clock_Ip_Cfg.h, category=SWHDR
          short-label=wizard_data::s32m243::Clock_Ip_Cfg_Defines.h, category=SWHDR
          short-label=wizard_data::s32m243::DeviceDefinition.h, category=SWHDR
          short-label=wizard_data::s32m243::OsIf_ArchCfg.h, category=SWHDR
          short-label=wizard_data::s32m243::OsIf_Cfg.h, category=SWHDR
          short-label=wizard_data::s32m243::Port_Ci_Port_Ip_Cfg.c, category=SWSRC
          short-label=wizard_data::s32m243::Port_Ci_Port_Ip_Cfg.h, category=SWHDR
          short-label=wizard_data::s32m243::Port_Ci_Port_Ip_Defines.h, category=SWHDR
          short-label=wizard_data::s32m244::Clock_Ip_Cfg.c, category=SWSRC
          short-label=wizard_data::s32m244::Clock_Ip_Cfg.h, category=SWHDR
          short-label=wizard_data::s32m244::Clock_Ip_Cfg_Defines.h, category=SWHDR
          short-label=wizard_data::s32m244::DeviceDefinition.h, category=SWHDR
          short-label=wizard_data::s32m244::OsIf_ArchCfg.h, category=SWHDR
          short-label=wizard_data::s32m244::OsIf_Cfg.h, category=SWHDR
          short-label=wizard_data::s32m244::Port_Ci_Port_Ip_Cfg.c, category=SWSRC
          short-label=wizard_data::s32m244::Port_Ci_Port_Ip_Cfg.h, category=SWHDR
          short-label=wizard_data::s32m244::Port_Ci_Port_Ip_Defines.h, category=SWHDR
    compiler GCC_Compiler:
      name=GCC Compiler
      options=-mcpu=cortex-m4 -mcpu=cortex-m0plus -mthumb -mlittle-endian -mfpu=fpv4-sp-d16 -mfloat-abi=hard -mfpu=auto -mfloat-abi=soft -std=c99 -Os -ggdb3 -Wall -Wextra -pedantic -Wstrict-prototypes -Wundef -Wunused -Werror=implicit-function-declaration -Wsign-compare -Wdouble-promotion -fno-short-enums -funsigned-char -funsigned-bitfields -fomit-frame-pointer -fno-common -fstack-usage -fdump-ipa-all -c -DUSE_SW_VECTOR_MODE -DI_CACHE_ENABLE -DENABLE_FPU -DMCAL_ENABLE_USER_MODE_SUPPORT --sysroot=$(NEWLIB_DIR) -specs=nano.specs -specs=nosys.specs
      vendor=GCC Systems
      version=NXP GCC 10.2.0 20200723 (Build 1728 Revision g5963bc8)
    compiler GHS_Compiler:
      name=Green Hills
      options=-cpu=cortexm4 -cpu=cortexm0plus -thumb -fpu=vfpv4_d16 -fsingle -fsoft -C99 --ghstd=last -Osize --gnu_asm -dual_debug -G -keeptempfiles -Wimplicit-int -Wshadow -Wtrigraphs -Wundef --unsigned_chars --unsigned_fields --no_commons --no_exceptions --no_slash_comment --prototype_errors --incorrect_pragma_warnings -c -DUSE_SW_VECTOR_MODE -DI_CACHE_ENABLE -DENABLE_FPU -DMCAL_ENABLE_USER_MODE_SUPPORT
      vendor=Green Hills
      version=Green Hills Multi 7.1.6d / Compiler 2020.1.4
    compiler IAR_Compiler:
      name=IAR Compiler
      options=--cpu=Cortex-M4 --cpu=Cortex-M0+ --cpu_mode=thumb --endian=little --fpu=FPv4-SP --fpu=none -e -Ohz --debug --no_clustering --no_mem_idioms --no_explicit_zero_opt --require_prototypes --no_wrap_diagnostics --diag_suppress=Pa050 -DIAR -DUSE_SW_VECTOR_MODE -DI_CACHE_ENABLE -DENABLE_FPU -DMCAL_ENABLE_USER_MODE_SUPPORT
      vendor=IAR Systems
      version=IAR ANSI C/C++ Compiler V8.40.3.228/W32 for ARM Functional Safety
    generated-artifacts:
      6 x dependency on artifact, all with usages=COMPILE:
        DeviceDefinition_h: artifact-descriptor={short-label=generate_PC::include::DeviceDefinition.h, category=SWHDR}
        modules_h: artifact-descriptor={short-label=generate_PC::include::modules.h, category=SWHDR}
        OsIf_ArchCfg_h: artifact-descriptor={short-label=generate_PC::include::OsIf_ArchCfg.h, category=SWHDR}
        OsIf_Cfg_h: artifact-descriptor={short-label=generate_PC::include::OsIf_Cfg.h, category=SWHDR}
        Soc_Ips_h: artifact-descriptor={short-label=generate_PC::include::Soc_Ips.h, category=SWHDR}
        OsIf_Cfg_c: artifact-descriptor={short-label=generate_PC::src::OsIf_Cfg.c, category=SWSRC}
    linker GCC_Linker: name=GCC Compiler, options=-Wl,-Map,filename -T linkerfile --entry=Reset_Handler -nostartfiles -mcpu=cortex-m4 -mcpu=cortex-m0plus -mthumb -mfpu=fpv4-sp-d16 -mfloat-abi=hard -mfpu=auto -mfloat-abi=soft -mlittle-endian -ggdb3 -lc -lm -lgcc -n --sysroot=$(NEWLIB_DIR) -specs=nano.specs -specs=nosys.specs, vendor=GCC Systems, version=NXP GCC 10.2.0 20200723 (Build 1728 Revision g5963bc8)
    linker GHS_Linker: name=Green Hills, options=-e Reset_Handler -T linker_script_file.ld -map -keepmap -Mn -delete -ignore_debug_references -Llibrary_path -larch -lstartup -lind_sd -lind_sf -v -keep=C40_Ip_AccessCode -nostartfiles, vendor=Green Hills, version=Green Hills Multi 7.1.6d / Compiler 2020.1.4
    linker IAR_Linker: name=IAR Compiler, options=--map filename --config linkerfile --cpu=Cortex-M4 --cpu=Cortex-M0+ --fpu=FPv4-SP --fpu=none --entry _start --enable_stack_usage --skip_dynamic_initialization --no_wrap_diagnostics, vendor=IAR Systems, version=IAR ANSI C/C++ Compiler V8.40.3.228/W32 for ARM Functional Safety
    resource consumption ResourceConsumption
      5 x memory section:
        BASENXP_CODE: alignment=UNSPECIFIED, sw-addrmethod=CODE, symbol=CODE
        BASENXP_CONFIG_DATA_UNSPECIFIED: alignment=UNSPECIFIED, sw-addrmethod=CONFIG_DATA, symbol=CONFIG_DATA_UNSPECIFIED
        BASENXP_VAR_CLEARED_32: alignment=32, sw-addrmethod=VAR_CLEARED, symbol=VAR_CLEARED_32
        BASENXP_VAR_CLEARED_BOOLEAN: alignment=BOOLEAN, sw-addrmethod=VAR_CLEARED, symbol=VAR_CLEARED_BOOLEAN
        BASENXP_VAR_CLEARED_UNSPECIFIED: alignment=UNSPECIFIED, sw-addrmethod=VAR_CLEARED, symbol=VAR_CLEARED_UNSPECIFIED
