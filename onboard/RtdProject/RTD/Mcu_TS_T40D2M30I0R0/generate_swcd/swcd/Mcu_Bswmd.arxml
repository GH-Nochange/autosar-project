AUTOSAR XML (schema 00050)
package /AUTOSAR_Mcu/BswModuleDescriptions
  bsw module description Mcu: module-id=101
    provided-entrys:
      Mcu_DisableCmu
      Mcu_DistributePllClock
      Mcu_GetClockFrequency
      Mcu_GetPllStatus
      Mcu_GetPowerModeState
      Mcu_GetResetRawValue
      Mcu_GetResetReason
      Mcu_GetVersionInfo
      Mcu_Init
      Mcu_InitClock
      Mcu_InitRamSection
      Mcu_PerformReset
      Mcu_SRAMRetentionConfig
      Mcu_SetMode
      Mcu_SleepOnExit
      Mcu_PMC_SCG_CMU_Isr
      Power_Ip_PMC_AE_VoltageDetectHvdOnVdd_ISR
      Power_Ip_PMC_AE_VoltageDetectHvdOnVddintVdd15_ISR
      Power_Ip_PMC_AE_VoltageDetectLvdOnVddc_ISR
      Power_Ip_PMC_AE_VoltageDetectLvdOnVls_ISR
      Power_Ip_PMC_LowVoltage_ISR
      Power_Ip_PMC_TemperatureError_ISR
      Power_Ip_RCM_AlternateResetIsr
    bsw internal behavior InternalBehavior_0
      exclusive area MCU_EXCLUSIVE_AREA_00
      exclusive area MCU_EXCLUSIVE_AREA_01
      15 x bsw called entity:
        Mcu_DisableCmu: can-enter-exclusive-area=MCU_EXCLUSIVE_AREA_01, implemented-entry=Mcu_DisableCmu
        Mcu_DistributePllClock: implemented-entry=Mcu_DistributePllClock
        Mcu_GetClockFrequency: implemented-entry=Mcu_GetClockFrequency
        Mcu_GetPllStatus: implemented-entry=Mcu_GetPllStatus
        Mcu_GetPowerModeState: implemented-entry=Mcu_GetPowerModeState
        Mcu_GetResetRawValue: implemented-entry=Mcu_GetResetRawValue
        Mcu_GetResetReason: implemented-entry=Mcu_GetResetReason
        Mcu_GetVersionInfo: implemented-entry=Mcu_GetVersionInfo
        Mcu_Init: implemented-entry=Mcu_Init
        Mcu_InitClock: implemented-entry=Mcu_InitClock
        Mcu_InitRamSection: implemented-entry=Mcu_InitRamSection
        Mcu_PerformReset: implemented-entry=Mcu_PerformReset
        Mcu_SRAMRetentionConfig: implemented-entry=Mcu_SRAMRetentionConfig
        Mcu_SetMode: can-enter-exclusive-area=MCU_EXCLUSIVE_AREA_00, implemented-entry=Mcu_SetMode
        Mcu_SleepOnExit: implemented-entry=Mcu_SleepOnExit
      8 x bsw interrupt entity, all with interrupt-category=CAT-2, interrupt-source=Hardware:
        Mcu_PMC_SCG_CMU_Isr: implemented-entry=Mcu_PMC_SCG_CMU_Isr
        Power_Ip_PMC_AE_VoltageDetectHvdOnVdd_ISR: implemented-entry=Power_Ip_PMC_AE_VoltageDetectHvdOnVdd_ISR
        Power_Ip_PMC_AE_VoltageDetectHvdOnVddintVdd15_ISR: implemented-entry=Power_Ip_PMC_AE_VoltageDetectHvdOnVddintVdd15_ISR
        Power_Ip_PMC_AE_VoltageDetectLvdOnVddc_ISR: implemented-entry=Power_Ip_PMC_AE_VoltageDetectLvdOnVddc_ISR
        Power_Ip_PMC_AE_VoltageDetectLvdOnVls_ISR: implemented-entry=Power_Ip_PMC_AE_VoltageDetectLvdOnVls_ISR
        Power_Ip_PMC_LowVoltage_ISR: implemented-entry=Power_Ip_PMC_LowVoltage_ISR
        Power_Ip_PMC_TemperatureError_ISR: implemented-entry=Power_Ip_PMC_TemperatureError_ISR
        Power_Ip_RCM_AlternateResetIsr: implemented-entry=Power_Ip_RCM_AlternateResetIsr
package /AUTOSAR_Mcu/BswModuleEntrys
  23 x bsw module entry, all with is-synchronous=true, sw-service-impl-policy=STANDARD:
    Mcu_DisableCmu: service-id=0x17, is-reentrant=true, call-type=REGULAR, execution-context=UNSPECIFIED
    Mcu_DistributePllClock: service-id=0x03, is-reentrant=false, call-type=REGULAR, execution-context=UNSPECIFIED
    Mcu_GetClockFrequency: service-id=0x19, is-reentrant=true, call-type=REGULAR, execution-context=UNSPECIFIED
    Mcu_GetPllStatus: service-id=0x04, is-reentrant=true, call-type=REGULAR, execution-context=UNSPECIFIED
    Mcu_GetPowerModeState: service-id=0x0e, is-reentrant=true, call-type=REGULAR, execution-context=UNSPECIFIED
    Mcu_GetResetRawValue: service-id=0x06, is-reentrant=true, call-type=REGULAR, execution-context=UNSPECIFIED
    Mcu_GetResetReason: service-id=0x05, is-reentrant=true, call-type=REGULAR, execution-context=UNSPECIFIED
    Mcu_GetVersionInfo: service-id=0x09, is-reentrant=true, call-type=REGULAR, execution-context=UNSPECIFIED
    Mcu_Init: service-id=0x00, is-reentrant=false, call-type=REGULAR, execution-context=UNSPECIFIED
    Mcu_InitClock: service-id=0x02, is-reentrant=false, call-type=REGULAR, execution-context=UNSPECIFIED
    Mcu_InitRamSection: service-id=0x01, is-reentrant=false, call-type=REGULAR, execution-context=UNSPECIFIED
    Mcu_PerformReset: service-id=0x07, is-reentrant=false, call-type=REGULAR, execution-context=UNSPECIFIED
    Mcu_SRAMRetentionConfig: service-id=0x1b, is-reentrant=true, call-type=REGULAR, execution-context=UNSPECIFIED
    Mcu_SetMode: service-id=0x08, is-reentrant=true, call-type=REGULAR, execution-context=UNSPECIFIED
    Mcu_SleepOnExit: service-id=0x1a, is-reentrant=true, call-type=REGULAR, execution-context=UNSPECIFIED
    Mcu_PMC_SCG_CMU_Isr: service-id=0, is-reentrant=false, call-type=INTERRUPT, execution-context=INTERRUPT-CAT-2
    Power_Ip_PMC_AE_VoltageDetectHvdOnVdd_ISR: service-id=0, is-reentrant=false, call-type=INTERRUPT, execution-context=INTERRUPT-CAT-2
    Power_Ip_PMC_AE_VoltageDetectHvdOnVddintVdd15_ISR: service-id=0, is-reentrant=false, call-type=INTERRUPT, execution-context=INTERRUPT-CAT-2
    Power_Ip_PMC_AE_VoltageDetectLvdOnVddc_ISR: service-id=0, is-reentrant=false, call-type=INTERRUPT, execution-context=INTERRUPT-CAT-2
    Power_Ip_PMC_AE_VoltageDetectLvdOnVls_ISR: service-id=0, is-reentrant=false, call-type=INTERRUPT, execution-context=INTERRUPT-CAT-2
    Power_Ip_PMC_LowVoltage_ISR: service-id=0, is-reentrant=false, call-type=INTERRUPT, execution-context=INTERRUPT-CAT-2
    Power_Ip_PMC_TemperatureError_ISR: service-id=0, is-reentrant=false, call-type=INTERRUPT, execution-context=INTERRUPT-CAT-2
    Power_Ip_RCM_AlternateResetIsr: service-id=0, is-reentrant=false, call-type=INTERRUPT, execution-context=INTERRUPT-CAT-2
package /Mcu_TS_T40D2M30I0R0/Implementations
  bsw implementation BswImplementation_0: programming-language=C, sw-version=3.0.0_QLP02, vendor-id=43, ar-release-version=4.7.0, behavior=InternalBehavior_0, preconfigured-configuration=McuPreConfiguration, vendor-specific-module-def=Mcu
    code-descriptors:
      code Files
        artifact-descriptors:
          short-label=config::Mcu.xdm, category=SWCFG
          short-label=config_ext::McuPreConfiguration.xdm, category=SWCFG
          short-label=doc::RTD_MCU_IM.pdf, category=SWDOC
          short-label=doc::RTD_MCU_UM.pdf, category=SWDOC
          short-label=examples::EBT::S32K1::Mcu_Example_S32K118::generate::epc::BaseNXP.xdm, category=SWCFG
          short-label=examples::EBT::S32K1::Mcu_Example_S32K118::generate::epc::Dem.xdm, category=SWCFG
          short-label=examples::EBT::S32K1::Mcu_Example_S32K118::generate::epc::Mcu.xdm, category=SWCFG
          short-label=examples::EBT::S32K1::Mcu_Example_S32K118::generate::epc::Platform.xdm, category=SWCFG
          short-label=examples::EBT::S32K1::Mcu_Example_S32K118::generate::epc::Resource.xdm, category=SWCFG
          short-label=examples::EBT::S32K1::Mcu_Example_S32K118::include::check_example.h, category=SWHDR
          short-label=examples::EBT::S32K1::Mcu_Example_S32K118::src::main.c, category=SWSRC
          short-label=examples::EBT::S32K1::Mcu_Example_S32K118::TresosProject::Mcu_Example_S32K118::.prefs::preferences.xdm, category=SWCFG
          short-label=examples::EBT::S32K1::Mcu_Example_S32K118::TresosProject::Mcu_Example_S32K118::config::BaseNXP.xdm, category=SWCFG
          short-label=examples::EBT::S32K1::Mcu_Example_S32K118::TresosProject::Mcu_Example_S32K118::config::Dem.xdm, category=SWCFG
          short-label=examples::EBT::S32K1::Mcu_Example_S32K118::TresosProject::Mcu_Example_S32K118::config::EcuC.xdm, category=SWCFG
          short-label=examples::EBT::S32K1::Mcu_Example_S32K118::TresosProject::Mcu_Example_S32K118::config::Mcu.xdm, category=SWCFG
          short-label=examples::EBT::S32K1::Mcu_Example_S32K118::TresosProject::Mcu_Example_S32K118::config::Platform.xdm, category=SWCFG
          short-label=examples::EBT::S32K1::Mcu_Example_S32K118::TresosProject::Mcu_Example_S32K118::config::Resource.xdm, category=SWCFG
          short-label=examples::EBT::S32K1::Mcu_Example_S32K144::generate::epc::BaseNXP.xdm, category=SWCFG
          short-label=examples::EBT::S32K1::Mcu_Example_S32K144::generate::epc::Dem.xdm, category=SWCFG
          short-label=examples::EBT::S32K1::Mcu_Example_S32K144::generate::epc::Mcu.xdm, category=SWCFG
          short-label=examples::EBT::S32K1::Mcu_Example_S32K144::generate::epc::Platform.xdm, category=SWCFG
          short-label=examples::EBT::S32K1::Mcu_Example_S32K144::generate::epc::Resource.xdm, category=SWCFG
          short-label=examples::EBT::S32K1::Mcu_Example_S32K144::include::check_example.h, category=SWHDR
          short-label=examples::EBT::S32K1::Mcu_Example_S32K144::src::main.c, category=SWSRC
          short-label=examples::EBT::S32K1::Mcu_Example_S32K144::TresosProject::Mcu_Example_S32K144::.prefs::preferences.xdm, category=SWCFG
          short-label=examples::EBT::S32K1::Mcu_Example_S32K144::TresosProject::Mcu_Example_S32K144::config::BaseNXP.xdm, category=SWCFG
          short-label=examples::EBT::S32K1::Mcu_Example_S32K144::TresosProject::Mcu_Example_S32K144::config::Dem.xdm, category=SWCFG
          short-label=examples::EBT::S32K1::Mcu_Example_S32K144::TresosProject::Mcu_Example_S32K144::config::EcuC.xdm, category=SWCFG
          short-label=examples::EBT::S32K1::Mcu_Example_S32K144::TresosProject::Mcu_Example_S32K144::config::Mcu.xdm, category=SWCFG
          short-label=examples::EBT::S32K1::Mcu_Example_S32K144::TresosProject::Mcu_Example_S32K144::config::Platform.xdm, category=SWCFG
          short-label=examples::EBT::S32K1::Mcu_Example_S32K144::TresosProject::Mcu_Example_S32K144::config::Resource.xdm, category=SWCFG
          short-label=examples::EBT::S32K1::Mcu_Example_S32K144W::generate::epc::BaseNXP.xdm, category=SWCFG
          short-label=examples::EBT::S32K1::Mcu_Example_S32K144W::generate::epc::Dem.xdm, category=SWCFG
          short-label=examples::EBT::S32K1::Mcu_Example_S32K144W::generate::epc::Mcu.xdm, category=SWCFG
          short-label=examples::EBT::S32K1::Mcu_Example_S32K144W::generate::epc::Platform.xdm, category=SWCFG
          short-label=examples::EBT::S32K1::Mcu_Example_S32K144W::generate::epc::Resource.xdm, category=SWCFG
          short-label=examples::EBT::S32K1::Mcu_Example_S32K144W::include::check_example.h, category=SWHDR
          short-label=examples::EBT::S32K1::Mcu_Example_S32K144W::src::main.c, category=SWSRC
          short-label=examples::EBT::S32K1::Mcu_Example_S32K144W::TresosProject::Mcu_Example_S32K144W::.prefs::preferences.xdm, category=SWCFG
          short-label=examples::EBT::S32K1::Mcu_Example_S32K144W::TresosProject::Mcu_Example_S32K144W::config::BaseNXP.xdm, category=SWCFG
          short-label=examples::EBT::S32K1::Mcu_Example_S32K144W::TresosProject::Mcu_Example_S32K144W::config::Dem.xdm, category=SWCFG
          short-label=examples::EBT::S32K1::Mcu_Example_S32K144W::TresosProject::Mcu_Example_S32K144W::config::EcuC.xdm, category=SWCFG
          short-label=examples::EBT::S32K1::Mcu_Example_S32K144W::TresosProject::Mcu_Example_S32K144W::config::Mcu.xdm, category=SWCFG
          short-label=examples::EBT::S32K1::Mcu_Example_S32K144W::TresosProject::Mcu_Example_S32K144W::config::Platform.xdm, category=SWCFG
          short-label=examples::EBT::S32K1::Mcu_Example_S32K144W::TresosProject::Mcu_Example_S32K144W::config::Resource.xdm, category=SWCFG
          short-label=examples::EBT::S32K1::Mcu_Example_S32K148::generate::epc::BaseNXP.xdm, category=SWCFG
          short-label=examples::EBT::S32K1::Mcu_Example_S32K148::generate::epc::Dem.xdm, category=SWCFG
          short-label=examples::EBT::S32K1::Mcu_Example_S32K148::generate::epc::Mcu.xdm, category=SWCFG
          short-label=examples::EBT::S32K1::Mcu_Example_S32K148::generate::epc::Platform.xdm, category=SWCFG
          short-label=examples::EBT::S32K1::Mcu_Example_S32K148::generate::epc::Resource.xdm, category=SWCFG
          short-label=examples::EBT::S32K1::Mcu_Example_S32K148::include::check_example.h, category=SWHDR
          short-label=examples::EBT::S32K1::Mcu_Example_S32K148::src::main.c, category=SWSRC
          short-label=examples::EBT::S32K1::Mcu_Example_S32K148::TresosProject::Mcu_Example_S32K148::.prefs::preferences.xdm, category=SWCFG
          short-label=examples::EBT::S32K1::Mcu_Example_S32K148::TresosProject::Mcu_Example_S32K148::config::BaseNXP.xdm, category=SWCFG
          short-label=examples::EBT::S32K1::Mcu_Example_S32K148::TresosProject::Mcu_Example_S32K148::config::Dem.xdm, category=SWCFG
          short-label=examples::EBT::S32K1::Mcu_Example_S32K148::TresosProject::Mcu_Example_S32K148::config::EcuC.xdm, category=SWCFG
          short-label=examples::EBT::S32K1::Mcu_Example_S32K148::TresosProject::Mcu_Example_S32K148::config::Mcu.xdm, category=SWCFG
          short-label=examples::EBT::S32K1::Mcu_Example_S32K148::TresosProject::Mcu_Example_S32K148::config::Platform.xdm, category=SWCFG
          short-label=examples::EBT::S32K1::Mcu_Example_S32K148::TresosProject::Mcu_Example_S32K148::config::Resource.xdm, category=SWCFG
          short-label=examples::EBT::S32M24::Mcu_Example_S32M244::generate::epc::BaseNXP.xdm, category=SWCFG
          short-label=examples::EBT::S32M24::Mcu_Example_S32M244::generate::epc::Dem.xdm, category=SWCFG
          short-label=examples::EBT::S32M24::Mcu_Example_S32M244::generate::epc::Mcu.xdm, category=SWCFG
          short-label=examples::EBT::S32M24::Mcu_Example_S32M244::generate::epc::Platform.xdm, category=SWCFG
          short-label=examples::EBT::S32M24::Mcu_Example_S32M244::generate::epc::Resource.xdm, category=SWCFG
          short-label=examples::EBT::S32M24::Mcu_Example_S32M244::include::check_example.h, category=SWHDR
          short-label=examples::EBT::S32M24::Mcu_Example_S32M244::src::main.c, category=SWSRC
          short-label=examples::EBT::S32M24::Mcu_Example_S32M244::TresosProject::Mcu_Example_S32M244::.prefs::preferences.xdm, category=SWCFG
          short-label=examples::EBT::S32M24::Mcu_Example_S32M244::TresosProject::Mcu_Example_S32M244::config::BaseNXP.xdm, category=SWCFG
          short-label=examples::EBT::S32M24::Mcu_Example_S32M244::TresosProject::Mcu_Example_S32M244::config::Dem.xdm, category=SWCFG
          short-label=examples::EBT::S32M24::Mcu_Example_S32M244::TresosProject::Mcu_Example_S32M244::config::EcuC.xdm, category=SWCFG
          short-label=examples::EBT::S32M24::Mcu_Example_S32M244::TresosProject::Mcu_Example_S32M244::config::Mcu.xdm, category=SWCFG
          short-label=examples::EBT::S32M24::Mcu_Example_S32M244::TresosProject::Mcu_Example_S32M244::config::Platform.xdm, category=SWCFG
          short-label=examples::EBT::S32M24::Mcu_Example_S32M244::TresosProject::Mcu_Example_S32M244::config::Resource.xdm, category=SWCFG
          short-label=examples::S32DS::S32K1::Clock_Ip_Example_S32K118::include::check_example.h, category=SWHDR
          short-label=examples::S32DS::S32K1::Clock_Ip_Example_S32K118::Project_Settings::Startup_Code::exceptions.c, category=SWSRC
          short-label=examples::S32DS::S32K1::Clock_Ip_Example_S32K118::Project_Settings::Startup_Code::nvic.c, category=SWSRC
          short-label=examples::S32DS::S32K1::Clock_Ip_Example_S32K118::Project_Settings::Startup_Code::startup.c, category=SWSRC
          short-label=examples::S32DS::S32K1::Clock_Ip_Example_S32K118::Project_Settings::Startup_Code::system.c, category=SWSRC
          short-label=examples::S32DS::S32K1::Clock_Ip_Example_S32K118::src::main.c, category=SWSRC
          short-label=examples::S32DS::S32K1::Clock_Ip_Example_S32K144::include::check_example.h, category=SWHDR
          short-label=examples::S32DS::S32K1::Clock_Ip_Example_S32K144::Project_Settings::Startup_Code::exceptions.c, category=SWSRC
          short-label=examples::S32DS::S32K1::Clock_Ip_Example_S32K144::Project_Settings::Startup_Code::nvic.c, category=SWSRC
          short-label=examples::S32DS::S32K1::Clock_Ip_Example_S32K144::Project_Settings::Startup_Code::startup.c, category=SWSRC
          short-label=examples::S32DS::S32K1::Clock_Ip_Example_S32K144::Project_Settings::Startup_Code::system.c, category=SWSRC
          short-label=examples::S32DS::S32K1::Clock_Ip_Example_S32K144::src::main.c, category=SWSRC
          short-label=examples::S32DS::S32K1::Clock_Ip_Example_S32K144W::include::check_example.h, category=SWHDR
          short-label=examples::S32DS::S32K1::Clock_Ip_Example_S32K144W::Project_Settings::Startup_Code::exceptions.c, category=SWSRC
          short-label=examples::S32DS::S32K1::Clock_Ip_Example_S32K144W::Project_Settings::Startup_Code::nvic.c, category=SWSRC
          short-label=examples::S32DS::S32K1::Clock_Ip_Example_S32K144W::Project_Settings::Startup_Code::startup.c, category=SWSRC
          short-label=examples::S32DS::S32K1::Clock_Ip_Example_S32K144W::Project_Settings::Startup_Code::system.c, category=SWSRC
          short-label=examples::S32DS::S32K1::Clock_Ip_Example_S32K144W::src::main.c, category=SWSRC
          short-label=examples::S32DS::S32K1::Clock_Ip_Example_S32K148::include::check_example.h, category=SWHDR
          short-label=examples::S32DS::S32K1::Clock_Ip_Example_S32K148::Project_Settings::Startup_Code::exceptions.c, category=SWSRC
          short-label=examples::S32DS::S32K1::Clock_Ip_Example_S32K148::Project_Settings::Startup_Code::nvic.c, category=SWSRC
          short-label=examples::S32DS::S32K1::Clock_Ip_Example_S32K148::Project_Settings::Startup_Code::startup.c, category=SWSRC
          short-label=examples::S32DS::S32K1::Clock_Ip_Example_S32K148::Project_Settings::Startup_Code::system.c, category=SWSRC
          short-label=examples::S32DS::S32K1::Clock_Ip_Example_S32K148::src::main.c, category=SWSRC
          short-label=examples::S32DS::S32K1::Mcu_Example_S32K118::include::check_example.h, category=SWHDR
          short-label=examples::S32DS::S32K1::Mcu_Example_S32K118::Project_Settings::Startup_Code::exceptions.c, category=SWSRC
          short-label=examples::S32DS::S32K1::Mcu_Example_S32K118::Project_Settings::Startup_Code::nvic.c, category=SWSRC
          short-label=examples::S32DS::S32K1::Mcu_Example_S32K118::Project_Settings::Startup_Code::startup.c, category=SWSRC
          short-label=examples::S32DS::S32K1::Mcu_Example_S32K118::Project_Settings::Startup_Code::system.c, category=SWSRC
          short-label=examples::S32DS::S32K1::Mcu_Example_S32K118::src::main.c, category=SWSRC
          short-label=examples::S32DS::S32K1::Mcu_Example_S32K144::include::check_example.h, category=SWHDR
          short-label=examples::S32DS::S32K1::Mcu_Example_S32K144::Project_Settings::Startup_Code::exceptions.c, category=SWSRC
          short-label=examples::S32DS::S32K1::Mcu_Example_S32K144::Project_Settings::Startup_Code::nvic.c, category=SWSRC
          short-label=examples::S32DS::S32K1::Mcu_Example_S32K144::Project_Settings::Startup_Code::startup.c, category=SWSRC
          short-label=examples::S32DS::S32K1::Mcu_Example_S32K144::Project_Settings::Startup_Code::system.c, category=SWSRC
          short-label=examples::S32DS::S32K1::Mcu_Example_S32K144::src::main.c, category=SWSRC
          short-label=examples::S32DS::S32K1::Mcu_Example_S32K144W::include::check_example.h, category=SWHDR
          short-label=examples::S32DS::S32K1::Mcu_Example_S32K144W::Project_Settings::Startup_Code::exceptions.c, category=SWSRC
          short-label=examples::S32DS::S32K1::Mcu_Example_S32K144W::Project_Settings::Startup_Code::nvic.c, category=SWSRC
          short-label=examples::S32DS::S32K1::Mcu_Example_S32K144W::Project_Settings::Startup_Code::startup.c, category=SWSRC
          short-label=examples::S32DS::S32K1::Mcu_Example_S32K144W::Project_Settings::Startup_Code::system.c, category=SWSRC
          short-label=examples::S32DS::S32K1::Mcu_Example_S32K144W::src::main.c, category=SWSRC
          short-label=examples::S32DS::S32K1::Mcu_Example_S32K148::include::check_example.h, category=SWHDR
          short-label=examples::S32DS::S32K1::Mcu_Example_S32K148::Project_Settings::Startup_Code::exceptions.c, category=SWSRC
          short-label=examples::S32DS::S32K1::Mcu_Example_S32K148::Project_Settings::Startup_Code::nvic.c, category=SWSRC
          short-label=examples::S32DS::S32K1::Mcu_Example_S32K148::Project_Settings::Startup_Code::startup.c, category=SWSRC
          short-label=examples::S32DS::S32K1::Mcu_Example_S32K148::Project_Settings::Startup_Code::system.c, category=SWSRC
          short-label=examples::S32DS::S32K1::Mcu_Example_S32K148::src::main.c, category=SWSRC
          short-label=examples::S32DS::S32K1::Power_Ip_Example_S32K118::include::check_example.h, category=SWHDR
          short-label=examples::S32DS::S32K1::Power_Ip_Example_S32K118::Project_Settings::Startup_Code::exceptions.c, category=SWSRC
          short-label=examples::S32DS::S32K1::Power_Ip_Example_S32K118::Project_Settings::Startup_Code::nvic.c, category=SWSRC
          short-label=examples::S32DS::S32K1::Power_Ip_Example_S32K118::Project_Settings::Startup_Code::startup.c, category=SWSRC
          short-label=examples::S32DS::S32K1::Power_Ip_Example_S32K118::Project_Settings::Startup_Code::system.c, category=SWSRC
          short-label=examples::S32DS::S32K1::Power_Ip_Example_S32K118::src::main.c, category=SWSRC
          short-label=examples::S32DS::S32K1::Power_Ip_Example_S32K144::include::check_example.h, category=SWHDR
          short-label=examples::S32DS::S32K1::Power_Ip_Example_S32K144::Project_Settings::Startup_Code::exceptions.c, category=SWSRC
          short-label=examples::S32DS::S32K1::Power_Ip_Example_S32K144::Project_Settings::Startup_Code::nvic.c, category=SWSRC
          short-label=examples::S32DS::S32K1::Power_Ip_Example_S32K144::Project_Settings::Startup_Code::startup.c, category=SWSRC
          short-label=examples::S32DS::S32K1::Power_Ip_Example_S32K144::Project_Settings::Startup_Code::system.c, category=SWSRC
          short-label=examples::S32DS::S32K1::Power_Ip_Example_S32K144::src::main.c, category=SWSRC
          short-label=examples::S32DS::S32K1::Power_Ip_Example_S32K144W::include::check_example.h, category=SWHDR
          short-label=examples::S32DS::S32K1::Power_Ip_Example_S32K144W::Project_Settings::Startup_Code::exceptions.c, category=SWSRC
          short-label=examples::S32DS::S32K1::Power_Ip_Example_S32K144W::Project_Settings::Startup_Code::nvic.c, category=SWSRC
          short-label=examples::S32DS::S32K1::Power_Ip_Example_S32K144W::Project_Settings::Startup_Code::startup.c, category=SWSRC
          short-label=examples::S32DS::S32K1::Power_Ip_Example_S32K144W::Project_Settings::Startup_Code::system.c, category=SWSRC
          short-label=examples::S32DS::S32K1::Power_Ip_Example_S32K144W::src::main.c, category=SWSRC
          short-label=examples::S32DS::S32K1::Power_Ip_Example_S32K148::include::check_example.h, category=SWHDR
          short-label=examples::S32DS::S32K1::Power_Ip_Example_S32K148::Project_Settings::Startup_Code::exceptions.c, category=SWSRC
          short-label=examples::S32DS::S32K1::Power_Ip_Example_S32K148::Project_Settings::Startup_Code::nvic.c, category=SWSRC
          short-label=examples::S32DS::S32K1::Power_Ip_Example_S32K148::Project_Settings::Startup_Code::startup.c, category=SWSRC
          short-label=examples::S32DS::S32K1::Power_Ip_Example_S32K148::Project_Settings::Startup_Code::system.c, category=SWSRC
          short-label=examples::S32DS::S32K1::Power_Ip_Example_S32K148::src::main.c, category=SWSRC
          short-label=examples::S32DS::S32M24::Clock_Ip_Example_S32M244::include::check_example.h, category=SWHDR
          short-label=examples::S32DS::S32M24::Clock_Ip_Example_S32M244::Project_Settings::Startup_Code::exceptions.c, category=SWSRC
          short-label=examples::S32DS::S32M24::Clock_Ip_Example_S32M244::Project_Settings::Startup_Code::nvic.c, category=SWSRC
          short-label=examples::S32DS::S32M24::Clock_Ip_Example_S32M244::Project_Settings::Startup_Code::startup.c, category=SWSRC
          short-label=examples::S32DS::S32M24::Clock_Ip_Example_S32M244::Project_Settings::Startup_Code::system.c, category=SWSRC
          short-label=examples::S32DS::S32M24::Clock_Ip_Example_S32M244::src::main.c, category=SWSRC
          short-label=examples::S32DS::S32M24::Mcu_Example_S32M244::include::check_example.h, category=SWHDR
          short-label=examples::S32DS::S32M24::Mcu_Example_S32M244::Project_Settings::Startup_Code::exceptions.c, category=SWSRC
          short-label=examples::S32DS::S32M24::Mcu_Example_S32M244::Project_Settings::Startup_Code::nvic.c, category=SWSRC
          short-label=examples::S32DS::S32M24::Mcu_Example_S32M244::Project_Settings::Startup_Code::startup.c, category=SWSRC
          short-label=examples::S32DS::S32M24::Mcu_Example_S32M244::Project_Settings::Startup_Code::system.c, category=SWSRC
          short-label=examples::S32DS::S32M24::Mcu_Example_S32M244::src::main.c, category=SWSRC
          short-label=examples::S32DS::S32M24::Power_Ip_Example_S32M244::include::check_example.h, category=SWHDR
          short-label=examples::S32DS::S32M24::Power_Ip_Example_S32M244::Project_Settings::Startup_Code::exceptions.c, category=SWSRC
          short-label=examples::S32DS::S32M24::Power_Ip_Example_S32M244::Project_Settings::Startup_Code::nvic.c, category=SWSRC
          short-label=examples::S32DS::S32M24::Power_Ip_Example_S32M244::Project_Settings::Startup_Code::startup.c, category=SWSRC
          short-label=examples::S32DS::S32M24::Power_Ip_Example_S32M244::Project_Settings::Startup_Code::system.c, category=SWSRC
          short-label=examples::S32DS::S32M24::Power_Ip_Example_S32M244::src::main.c, category=SWSRC
          short-label=include::Clock_Ip.h, category=SWHDR
          short-label=include::Clock_Ip_Private.h, category=SWHDR
          short-label=include::Clock_Ip_Specific.h, category=SWHDR
          short-label=include::Clock_Ip_TrustedFunctions.h, category=SWHDR
          short-label=include::Clock_Ip_Types.h, category=SWHDR
          short-label=include::Mcu.h, category=SWHDR
          short-label=include::Mcu_Dem_Wrapper.h, category=SWHDR
          short-label=include::Mcu_EnvCfg.h, category=SWHDR
          short-label=include::Mcu_Ipw.h, category=SWHDR
          short-label=include::Mcu_Ipw_Types.h, category=SWHDR
          short-label=include::Power_Ip.h, category=SWHDR
          short-label=include::Power_Ip_AEC.h, category=SWHDR
          short-label=include::Power_Ip_AEC_Types.h, category=SWHDR
          short-label=include::Power_Ip_CortexM4.h, category=SWHDR
          short-label=include::Power_Ip_PMC.h, category=SWHDR
          short-label=include::Power_Ip_PMC_Types.h, category=SWHDR
          short-label=include::Power_Ip_Private.h, category=SWHDR
          short-label=include::Power_Ip_RCM.h, category=SWHDR
          short-label=include::Power_Ip_RCM_Types.h, category=SWHDR
          short-label=include::Power_Ip_SIM.h, category=SWHDR
          short-label=include::Power_Ip_SMC.h, category=SWHDR
          short-label=include::Power_Ip_SMC_Types.h, category=SWHDR
          short-label=include::Power_Ip_TrustedFunctions.h, category=SWHDR
          short-label=include::Power_Ip_Types.h, category=SWHDR
          short-label=include::Ram_Ip.h, category=SWHDR
          short-label=include::Ram_Ip_Types.h, category=SWHDR
          short-label=src::Clock_Ip.c, category=SWSRC
          short-label=src::Clock_Ip_Data.c, category=SWSRC
          short-label=src::Clock_Ip_Divider.c, category=SWSRC
          short-label=src::Clock_Ip_DividerTrigger.c, category=SWSRC
          short-label=src::Clock_Ip_ExtOsc.c, category=SWSRC
          short-label=src::Clock_Ip_FracDiv.c, category=SWSRC
          short-label=src::Clock_Ip_Frequency.c, category=SWSRC
          short-label=src::Clock_Ip_Gate.c, category=SWSRC
          short-label=src::Clock_Ip_IntOsc.c, category=SWSRC
          short-label=src::Clock_Ip_Irq.c, category=SWSRC
          short-label=src::Clock_Ip_Monitor.c, category=SWSRC
          short-label=src::Clock_Ip_Pll.c, category=SWSRC
          short-label=src::Clock_Ip_ProgFreqSwitch.c, category=SWSRC
          short-label=src::Clock_Ip_Selector.c, category=SWSRC
          short-label=src::Clock_Ip_Specific.c, category=SWSRC
          short-label=src::Mcu.c, category=SWSRC
          short-label=src::Mcu_Dem_Wrapper.c, category=SWSRC
          short-label=src::Mcu_Ipw.c, category=SWSRC
          short-label=src::Power_Ip.c, category=SWSRC
          short-label=src::Power_Ip_AEC.c, category=SWSRC
          short-label=src::Power_Ip_CortexM4.c, category=SWSRC
          short-label=src::Power_Ip_PMC.c, category=SWSRC
          short-label=src::Power_Ip_PMC_Irq.c, category=SWSRC
          short-label=src::Power_Ip_Private.c, category=SWSRC
          short-label=src::Power_Ip_RCM.c, category=SWSRC
          short-label=src::Power_Ip_RCM_Irq.c, category=SWSRC
          short-label=src::Power_Ip_SIM.c, category=SWSRC
          short-label=src::Power_Ip_SMC.c, category=SWSRC
          short-label=src::Ram_Ip.c, category=SWSRC
    compiler GCC_Compiler:
      name=GCC Compiler
      options=-mcpu=cortex-m4 -mcpu=cortex-m0plus -mthumb -mlittle-endian -mfpu=fpv4-sp-d16 -mfloat-abi=hard -mfpu=auto -mfloat-abi=soft -std=c99 -Os -ggdb3 -Wall -Wextra -pedantic -Wstrict-prototypes -Wundef -Wunused -Werror=implicit-function-declaration -Wsign-compare -Wdouble-promotion -fno-short-enums -funsigned-char -funsigned-bitfields -fomit-frame-pointer -fno-common -fstack-usage -fdump-ipa-all -c -DUSE_SW_VECTOR_MODE -DI_CACHE_ENABLE -DENABLE_FPU -DMCAL_ENABLE_USER_MODE_SUPPORT --sysroot=$(NEWLIB_DIR) -specs=nano.specs -specs=nosys.specs
      vendor=GCC Systems
      version=NXP GCC 10.2.0 20200723 (Build 1728 Revision g5963bc8)
    compiler GHS_Compiler:
      name=Green Hills
      options=-cpu=cortexm4 -cpu=cortexm0plus -thumb -fpu=vfpv4_d16 -fsingle -fsoft -C99 --ghstd=last -Osize --gnu_asm -dual_debug -G -keeptempfiles -Wimplicit-int -Wshadow -Wtrigraphs -Wundef --unsigned_chars --unsigned_fields --no_commons --no_exceptions --no_slash_comment --prototype_errors --incorrect_pragma_warnings -c -DUSE_SW_VECTOR_MODE -DI_CACHE_ENABLE -DENABLE_FPU -DMCAL_ENABLE_USER_MODE_SUPPORT
      vendor=Green Hills
      version=Green Hills Multi 7.1.6d / Compiler 2020.1.4
    compiler IAR_Compiler:
      name=IAR Compiler
      options=--cpu=Cortex-M4 --cpu=Cortex-M0+ --cpu_mode=thumb --endian=little --fpu=FPv4-SP --fpu=none -e -Ohz --debug --no_clustering --no_mem_idioms --no_explicit_zero_opt --require_prototypes --no_wrap_diagnostics --diag_suppress=Pa050 -DIAR -DUSE_SW_VECTOR_MODE -DI_CACHE_ENABLE -DENABLE_FPU -DMCAL_ENABLE_USER_MODE_SUPPORT
      vendor=IAR Systems
      version=IAR ANSI C/C++ Compiler V8.40.3.228/W32 for ARM Functional Safety
    generated-artifacts:
      19 x dependency on artifact:
        Clock_Ip_PBcfg_h: artifact-descriptor={short-label=generate_PB::include::Clock_Ip_PBcfg.h, category=SWHDR}, usages=EXECUTE
        Mcu_PBcfg_h: artifact-descriptor={short-label=generate_PB::include::Mcu_PBcfg.h, category=SWHDR}, usages=EXECUTE
        Power_Ip_PBcfg_h: artifact-descriptor={short-label=generate_PB::include::Power_Ip_PBcfg.h, category=SWHDR}, usages=EXECUTE
        Ram_Ip_PBcfg_h: artifact-descriptor={short-label=generate_PB::include::Ram_Ip_PBcfg.h, category=SWHDR}, usages=EXECUTE
        Clock_Ip_PBcfg_c: artifact-descriptor={short-label=generate_PB::src::Clock_Ip_PBcfg.c, category=SWSRC}, usages=EXECUTE
        Mcu_PBcfg_c: artifact-descriptor={short-label=generate_PB::src::Mcu_PBcfg.c, category=SWSRC}, usages=EXECUTE
        Power_Ip_PBcfg_c: artifact-descriptor={short-label=generate_PB::src::Power_Ip_PBcfg.c, category=SWSRC}, usages=EXECUTE
        Ram_Ip_PBcfg_c: artifact-descriptor={short-label=generate_PB::src::Ram_Ip_PBcfg.c, category=SWSRC}, usages=EXECUTE
        Clock_Ip_Cfg_h: artifact-descriptor={short-label=generate_PC::include::Clock_Ip_Cfg.h, category=SWHDR}, usages=COMPILE
        Clock_Ip_Cfg_Defines_h: artifact-descriptor={short-label=generate_PC::include::Clock_Ip_Cfg_Defines.h, category=SWHDR}, usages=COMPILE
        Mcu_Cfg_h: artifact-descriptor={short-label=generate_PC::include::Mcu_Cfg.h, category=SWHDR}, usages=COMPILE
        Power_Ip_Cfg_h: artifact-descriptor={short-label=generate_PC::include::Power_Ip_Cfg.h, category=SWHDR}, usages=COMPILE
        Power_Ip_Cfg_Defines_h: artifact-descriptor={short-label=generate_PC::include::Power_Ip_Cfg_Defines.h, category=SWHDR}, usages=COMPILE
        Ram_Ip_Cfg_h: artifact-descriptor={short-label=generate_PC::include::Ram_Ip_Cfg.h, category=SWHDR}, usages=COMPILE
        Ram_Ip_Cfg_Defines_h: artifact-descriptor={short-label=generate_PC::include::Ram_Ip_Cfg_Defines.h, category=SWHDR}, usages=COMPILE
        Clock_Ip_Cfg_c: artifact-descriptor={short-label=generate_PC::src::Clock_Ip_Cfg.c, category=SWSRC}, usages=COMPILE
        Mcu_Cfg_c: artifact-descriptor={short-label=generate_PC::src::Mcu_Cfg.c, category=SWSRC}, usages=COMPILE
        Power_Ip_Cfg_c: artifact-descriptor={short-label=generate_PC::src::Power_Ip_Cfg.c, category=SWSRC}, usages=COMPILE
        Ram_Ip_Cfg_c: artifact-descriptor={short-label=generate_PC::src::Ram_Ip_Cfg.c, category=SWSRC}, usages=COMPILE
    linker GCC_Linker: name=GCC Compiler, options=-Wl,-Map,filename -T linkerfile --entry=Reset_Handler -nostartfiles -mcpu=cortex-m4 -mcpu=cortex-m0plus -mthumb -mfpu=fpv4-sp-d16 -mfloat-abi=hard -mfpu=auto -mfloat-abi=soft -mlittle-endian -ggdb3 -lc -lm -lgcc -n --sysroot=$(NEWLIB_DIR) -specs=nano.specs -specs=nosys.specs, vendor=GCC Systems, version=NXP GCC 10.2.0 20200723 (Build 1728 Revision g5963bc8)
    linker GHS_Linker: name=Green Hills, options=-e Reset_Handler -T linker_script_file.ld -map -keepmap -Mn -delete -ignore_debug_references -Llibrary_path -larch -lstartup -lind_sd -lind_sf -v -keep=C40_Ip_AccessCode -nostartfiles, vendor=Green Hills, version=Green Hills Multi 7.1.6d / Compiler 2020.1.4
    linker IAR_Linker: name=IAR Compiler, options=--map filename --config linkerfile --cpu=Cortex-M4 --cpu=Cortex-M0+ --fpu=FPv4-SP --fpu=none --entry _start --enable_stack_usage --skip_dynamic_initialization --no_wrap_diagnostics, vendor=IAR Systems, version=IAR ANSI C/C++ Compiler V8.40.3.228/W32 for ARM Functional Safety
    resource consumption ResourceConsumption
      13 x memory section:
        MCU_CODE: alignment=UNSPECIFIED, sw-addrmethod=CODE, symbol=CODE
        MCU_CONFIG_DATA_UNSPECIFIED: alignment=UNSPECIFIED, sw-addrmethod=CONFIG_DATA, symbol=CONFIG_DATA_UNSPECIFIED
        MCU_CONST_16: alignment=16, sw-addrmethod=CONST, symbol=CONST_16
        MCU_CONST_32: alignment=32, sw-addrmethod=CONST, symbol=CONST_32
        MCU_CONST_8: alignment=8, sw-addrmethod=CONST, symbol=CONST_8
        MCU_CONST_UNSPECIFIED: alignment=UNSPECIFIED, sw-addrmethod=CONST, symbol=CONST_UNSPECIFIED
        MCU_VAR_CLEARED_32: alignment=32, sw-addrmethod=VAR_CLEARED, symbol=VAR_CLEARED_32
        MCU_VAR_CLEARED_8: alignment=8, sw-addrmethod=VAR_CLEARED, symbol=VAR_CLEARED_8
        MCU_VAR_CLEARED_BOOLEAN: alignment=BOOLEAN, sw-addrmethod=VAR_CLEARED, symbol=VAR_CLEARED_BOOLEAN
        MCU_VAR_CLEARED_UNSPECIFIED: alignment=UNSPECIFIED, sw-addrmethod=VAR_CLEARED, symbol=VAR_CLEARED_UNSPECIFIED
        MCU_VAR_INIT_32: alignment=32, sw-addrmethod=VAR_INIT, symbol=VAR_INIT_32
        MCU_VAR_INIT_BOOLEAN: alignment=BOOLEAN, sw-addrmethod=VAR_INIT, symbol=VAR_INIT_BOOLEAN
        MCU_VAR_INIT_UNSPECIFIED: alignment=UNSPECIFIED, sw-addrmethod=VAR_INIT, symbol=VAR_INIT_UNSPECIFIED
